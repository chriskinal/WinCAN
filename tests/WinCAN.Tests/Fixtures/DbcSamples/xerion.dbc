VERSION ""

NS_ :

BS_:
BU_: xerion outback
BO_ 216999964 curve: 8 outback
   SG_ outbackcurve : 23|16@0+ (1,0) [0|1] "" xerion

BO_ 419365647 xerionMsg34: 8 xerion
   SG_ steering : 0|1@0+ (1,0) [0|1] "" xerion
   SG_ wheelanglesensor : 15|16@0+ (1,0) [0|1] "" Vector__XXX

BA_DEF_ BO_ "GenMsgBackgroundColor" STRING ;
BA_DEF_ BO_ "GenMsgForegroundColor" STRING ;
BA_DEF_ BO_ "filterlabeling" INT 0 0;
BA_DEF_DEF_ "GenMsgBackgroundColor" "#ffffff";
BA_DEF_DEF_ "GenMsgForegroundColor" "#000000";
BA_DEF_DEF_ "filterlabeling" 1;
CM_ BU_ xerion "Default node if none specified";
VAL_ 419365647 steering 0 "off" 1 "on";
