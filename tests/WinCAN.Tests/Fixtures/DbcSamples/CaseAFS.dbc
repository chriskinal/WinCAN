VERSION ""

NS_ :

BS_:
BU_: CaseValve
BO_ 2360125960 Valve: 8 CaseValve
   SG_ Curve : 0|16@1+ (1,-8032) [0|1] "" CaseValve

BA_DEF_ BO_ "GenMsgBackgroundColor" STRING ;
BA_DEF_ BO_ "GenMsgForegroundColor" STRING ;
BA_DEF_ BO_ "filterlabeling" INT 0 0;
BA_DEF_DEF_ "GenMsgBackgroundColor" "#2d2d2d";
BA_DEF_DEF_ "GenMsgForegroundColor" "#ffffff";
BA_DEF_DEF_ "filterlabeling" 1;
BA_ "GenMsgForegroundColor" BO_ 2360125960 "#000000";
