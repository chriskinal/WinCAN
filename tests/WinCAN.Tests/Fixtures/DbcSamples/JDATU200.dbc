VERSION ""

NS_ :

BS_:
BU_: JD ATU200
BO_ 2566912787 JD_ATU200: 8 JD ATU200
   SG_ JD_ATU200_Steer_Curve? : 24|16@1+ (1,0) [0|1] "" JD ATU200

BA_DEF_ BO_ "GenMsgBackgroundColor" STRING ;
BA_DEF_ BO_ "GenMsgForegroundColor" STRING ;
BA_DEF_ BO_ "filterlabeling" INT 0 0;
BA_DEF_DEF_ "GenMsgBackgroundColor" "#ffffff";
BA_DEF_DEF_ "GenMsgForegroundColor" "#000000";
BA_DEF_DEF_ "filterlabeling" 1;
VAL_ 2566912787 JD_ATU200_Steer_Curve? 0 "";
