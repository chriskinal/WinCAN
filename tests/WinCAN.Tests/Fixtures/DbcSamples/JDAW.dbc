VERSION ""

NS_ :

BS_:
BU_: JDAW
BO_ 2360209436 Steering_Curve: 8 JDAW
   SG_ Curve : 0|16@1+ (1,-32128) [0|1] "" Vector__XXX

BO_ 2314732060 COG_and_SOG_Rapid_Update: 8 JDAW
   SG_ COG_and_SOG_Rapid_UpdateSig423 : 1|1@0+ (1,0) [0|1] "" Vector__XXX

BO_ 2314732316 Position_Delta_High_Precision_Rapid_Update: 8 JDAW
   SG_ Position_Delta_High_Precision_Rapid_UpdateSig93 : 1|1@0+ (1,0) [0|1] "" Vector__XXX

BO_ 2381841692 GNSS_Position_Data: 8 JDAW
   SG_ Latitude : 0|32@1+ (0.0078,-200) [0|1] "degrees" Vector__XXX
   SG_ Longitude : 32|32@1+ (0.0078125,-200) [0|1] "degrees" Vector__XXX

BO_ 2381842716 Local_Time_Offset: 8 JDAW
   SG_ Local_Time_OffsetSig352 : 1|1@0+ (1,0) [0|1] "" Vector__XXX

BO_ 2381906716 Cross_Track_Error: 8 JDAW
   SG_ Cross_Track_ErrorSig327 : 1|1@0+ (1,0) [0|1] "" Vector__XXX

BO_ 2566730268 JDECU_Diagnostic_Protocol: 8 JDAW
   SG_ JDAWECU_Diagnostic_ProtocolSig417 : 1|1@0+ (1,0) [0|1] "" Vector__XXX

BO_ 2650620444 ISOBUS_Compliance_Certification: 8 JDAW

CM_ BU_ JDAW "Default node if none specified";
BA_DEF_ BO_ "GenMsgBackgroundColor" STRING ;
BA_DEF_ BO_ "GenMsgForegroundColor" STRING ;
BA_DEF_ BO_ "matchingcriteria" INT 0 0;
BA_DEF_ BO_ "filterlabeling" INT 0 0;
BA_DEF_ BO_ "matchingcriteria" INT 0 0;
BA_DEF_ BO_ "filterlabeling" INT 0 0;
BA_DEF_ BO_ "matchingcriteria" INT 0 0;
BA_DEF_ BO_ "filterlabeling" INT 0 0;
BA_DEF_ BO_ "matchingcriteria" INT 0 0;
BA_DEF_ BO_ "filterlabeling" INT 0 0;
BA_DEF_ BO_ "matchingcriteria" INT 0 0;
BA_DEF_ BO_ "filterlabeling" INT 0 0;
BA_DEF_DEF_ "GenMsgBackgroundColor" "#ffffff";
BA_DEF_DEF_ "GenMsgForegroundColor" "#000000";
BA_DEF_DEF_ "matchingcriteria" 1;
BA_DEF_DEF_ "filterlabeling" 1;
BA_DEF_DEF_ "matchingcriteria" 1;
BA_DEF_DEF_ "filterlabeling" 1;
