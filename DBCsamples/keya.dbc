VERSION ""

NS_ :

BS_:
BU_: Keya
BO_ 2239758337 Keya_response: 8 Keya
   SG_ Current : 63|8@0+ (1,0) [0|1] "" Vector__XXX
   SG_ Speed_set_response : 0|16@1+ (1,0) [0|1] "" Vector__XXX

BO_ 2248146945 Keya_Command: 8 Keya
   SG_ Command : 7|32@0+ (1,0) [0|1] "" Vector__XXX
   SG_ Value : 39|16@0- (1,0) [0|1] "" Keya

BO_ 2264924161 Heartbeat: 8 Keya
   SG_ Current_Sensing : 52|1@0- (1,0) [0|1] "" Vector__XXX
   SG_ NA : 61|1@0- (1,0) [0|1] "" Vector__XXX
   SG_ E2PROM : 59|1@0+ (1,0) [0|1] "" Vector__XXX
   SG_ Electrical_Angle : 7|16@0+ (1,0) [0|1] "" Keya
   SG_ Hall_Failure : 51|1@0- (1,0) [0|1] "" Vector__XXX
   SG_ Hardware_Protection : 58|1@0+ (1,0) [0|1] "" Vector__XXX
   SG_ UnderVoltage : 60|1@0+ (1,0) [0|1] "" Vector__XXX
   SG_ Less_Phase : 48|1@0- (1,0) [0|1] "" Vector__XXX
   SG_ Mode_Failure : 63|1@1+ (1,0) [0|1] "" Vector__XXX
   SG_ Motor_Current : 39|16@0- (1,0) [0|1] "" Vector__XXX
   SG_ Motor_Speed : 23|16@0- (1,0) [0|1] "" Vector__XXX
   SG_ Motor_Stall : 49|1@0- (1,0) [0|1] "" Vector__XXX
   SG_ Motor_Stalled : 55|1@0- (1,0) [0|1] "" Vector__XXX
   SG_ No_CAN_Steer_Command : 54|1@0- (1,0) [0|1] "" Vector__XXX
   SG_ No_RS232_Steer_Command : 53|1@0- (1,0) [0|1] "" Vector__XXX
   SG_ Over_Voltage : 57|1@0+ (1,0) [0|1] "" Vector__XXX
   SG_ Over_current : 63|1@0- (1,0) [0|1] "" Vector__XXX
   SG_ Reserved : 50|1@0- (1,0) [0|1] "" Vector__XXX

BO_ 2147484033 ConfigResponse: 8 Keya

BO_ 2248148369 KeyConfig: 8 Keya

BA_DEF_ BO_ "GenMsgBackgroundColor" STRING ;
BA_DEF_ BO_ "GenMsgForegroundColor" STRING ;
BA_DEF_ BO_ "matchingcriteria" INT 0 0;
BA_DEF_ BO_ "filterlabeling" INT 0 0;
BA_DEF_ BO_ "matchingcriteria" INT 0 0;
BA_DEF_ BO_ "filterlabeling" INT 0 0;
BA_DEF_ BO_ "matchingcriteria" INT 0 0;
BA_DEF_ BO_ "filterlabeling" INT 0 0;
BA_DEF_ BO_ "matchingcriteria" INT 0 0;
BA_DEF_ BO_ "filterlabeling" INT 0 0;
BA_DEF_ BO_ "matchingcriteria" INT 0 0;
BA_DEF_ BO_ "filterlabeling" INT 0 0;
BA_DEF_ BO_ "matchingcriteria" INT 0 0;
BA_DEF_ BO_ "filterlabeling" INT 0 0;
BA_DEF_ BO_ "matchingcriteria" INT 0 0;
BA_DEF_ BO_ "filterlabeling" INT 0 0;
BA_DEF_ BO_ "matchingcriteria" INT 0 0;
BA_DEF_ BO_ "filterlabeling" INT 0 0;
BA_DEF_ BO_ "matchingcriteria" INT 0 0;
BA_DEF_ BO_ "filterlabeling" INT 0 0;
BA_DEF_DEF_ "GenMsgBackgroundColor" "#ffffff";
BA_DEF_DEF_ "GenMsgForegroundColor" "#000000";
BA_DEF_DEF_ "matchingcriteria" 1;
BA_DEF_DEF_ "filterlabeling" 1;
BA_DEF_DEF_ "matchingcriteria" 1;
BA_DEF_DEF_ "filterlabeling" 1;
VAL_ 2248146945 Command 65535 "" 588062721 "Enable" 587997185 "Disable" 587341825 "SetPosition" 587210753 "SetSpeed" 0 "";
