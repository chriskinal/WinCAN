VERSION ""

NS_ :

BS_:

BU_:
VAL_TABLE_ SEHS_FMI 31 "0x1F - Condition exists" 30 "0x1E - Stuck Closed" 29 "0x1D - Stuck Open" 28 "0x1C - Not in neutral at Power-up" 27 "0x1B - Unable to return to neutral" 26 "0x1A - No steering" 25 "0x19 - Signal crosscheck failed" 24 "0x18 - Reserved" 23 "0x17 - Unintended Steering" 22 "0x16 - Message missing" 21 "0x15 - Data drifted low" 20 "0x14 - Data drifted high" 19 "0x13 - Received network data in error" 18 "0x12 - Data valid, but below normal operating range - Moderately severe level" 17 "0x11 - Data valid, but below normal operating range - Least severe level" 16 "0x10 - Data valid, but above normal operating range - Moderately severe level" 15 "0x0F - Data valid, but above normal operating range - Least severe level" 14 "0x0E - Special instructions" 13 "0x0D - Out of calibration" 12 "0x0C - Bad intelligent device or component" 11 "0x0B - Unknown root-cause" 10 "0x0A - Abnormal rate of change" 9 "0x09 - Abnormal update rate" 8 "0x08 - Abnormal frequency or pulse width or period" 7 "0x07 - Mechanical system not responding or out of adjustement" 6 "0x06 - Current above normal or grounded circuit" 5 "0x05 - Current below normal or open circuit" 4 "0x04 - Voltage below normal or short-circuit to low source" 3 "0x03 - Voltage above normal or short-circuit to high source" 2 "0x02 - Data erratic, intermittent or incorrect" 1 "0x01 - Data valid, but below normal operational range - Most severe level" 0 "0x00 - Data valid, but above normal operational range - Most severe level" ;

BO_ 3221225472 VECTOR__INDEPENDENT_SIG_MSG: 0 Vector__XXX
 SG_ IMD_status_crosscheck : 0|8@1- (1,0) [0|0] "" Vector__XXX
 SG_ Auxiliary_steering_device_Joysti : 0|8@1- (1,0) [0|0] "" Vector__XXX
 SG_ Aux_steering_device_Joystick_tri : 0|8@1- (1,0) [0|0] "" Vector__XXX
 SG_ Invalid_sensor_configuration : 0|8@1- (1,0) [0|0] "" Vector__XXX
 SG_ Invalid_sensor_configuration : 0|8@1- (1,0) [0|0] "" Vector__XXX
 SG_ Incompatible_Bootloader : 0|8@1- (1,0) [0|0] "" Vector__XXX
 SG_ PVED_CLS_Spare_part : 0|8@1- (1,0) [0|0] "" Vector__XXX
 SG_ Software_Mismatch : 0|8@1- (1,0) [0|0] "" Vector__XXX
 SG_ Road_Switch_Res_Monitoring : 0|8@1- (1,0) [0|0] "" Vector__XXX
 SG_ EEP_Auto_Caliber_Config_sect : 0|8@1- (1,0) [0|0] "" Vector__XXX
 SG_ EEPROM_AUX_config : 0|8@1- (1,0) [0|0] "" Vector__XXX
 SG_ EEPROM_STW_config : 0|8@1- (1,0) [0|0] "" Vector__XXX
 SG_ EEPROM_GPS_config : 0|8@1- (1,0) [0|0] "" Vector__XXX
 SG_ EEPROM_Vehicle_geometry : 0|8@1- (1,0) [0|0] "" Vector__XXX
 SG_ EEPROM_Peripherals_config : 0|8@1- (1,0) [0|0] "" Vector__XXX
 SG_ EEP_Anal_Sensor_Caliber_data : 0|8@1- (1,0) [0|0] "" Vector__XXX
 SG_ EEP_CAN_WAS_Caliber_data : 0|8@1- (1,0) [0|0] "" Vector__XXX
 SG_ EEPROM_Valve_Calibration_data : 0|8@1- (1,0) [0|0] "" Vector__XXX
 SG_ EEPROM_SEHS_FDA : 0|8@1- (1,0) [0|0] "" Vector__XXX
 SG_ EEPROM_Hydraulic_config : 0|8@1- (1,0) [0|0] "" Vector__XXX
 SG_ EEPROM_Internal_monitoring : 0|8@1- (1,0) [0|0] "" Vector__XXX
 SG_ EEPROM_SEHS_Protocol_data : 0|8@1- (1,0) [0|0] "" Vector__XXX
 SG_ Aux_str_dev_Joystick_position_cr : 0|8@1- (1,0) [0|0] "" Vector__XXX
 SG_ Aux_str_dev_Str_ang_vel_croschck : 0|8@1- (1,0) [0|0] "" Vector__XXX
 SG_ STW_sensor_Speed_crosscheck : 0|8@1- (1,0) [0|0] "" Vector__XXX
 SG_ Soft_Error : 0|8@1- (1,0) [0|0] "" Vector__XXX
 SG_ WAS_CAN_Sensor : 0|8@1- (1,0) [0|0] "" Vector__XXX
 SG_ MMI_flag_crosscheck : 0|8@1- (1,0) [0|0] "" Vector__XXX
 SG_ Application_state_crosscheck : 0|8@1- (1,0) [0|0] "" Vector__XXX
 SG_ Auxiliary_Steering_device_Steeri : 0|8@1- (1,0) [0|0] "" Vector__XXX
 SG_ STW_sensor_Position_crosscheck : 0|8@1- (1,0) [0|0] "" Vector__XXX
 SG_ Vehicle_Speed_sensor_speed_cross : 0|8@1- (1,0) [0|0] "" Vector__XXX
 SG_ Wheel_angle_crosscheck : 0|8@1- (1,0) [0|0] "" Vector__XXX
 SG_ EH_Mainspool_Position_crosscheck : 0|8@1- (1,0) [0|0] "" Vector__XXX
 SG_ Flow_command_crosscheck : 0|8@1- (1,0) [0|0] "" Vector__XXX
 SG_ LVDT_calculation : 0|8@1- (1,0) [0|0] "" Vector__XXX
 SG_ PSM_task : 0|8@1- (1,0) [0|0] "" Vector__XXX
 SG_ EEPROM_Diagnostic_sectors : 0|8@1- (1,0) [0|0] "" Vector__XXX
 SG_ EEPROM_configuration_sectors : 0|8@1- (1,0) [0|0] "" Vector__XXX
 SG_ Program_sequence_monitoring : 0|8@1- (1,0) [0|0] "" Vector__XXX
 SG_ SVC_Parameters : 0|8@1- (1,0) [0|0] "" Vector__XXX
 SG_ Interpolation : 0|8@1- (1,0) [0|0] "" Vector__XXX
 SG_ Too_many_errors : 0|8@1- (1,0) [0|0] "" Vector__XXX
 SG_ I2C_communication : 0|8@1- (1,0) [0|0] "" Vector__XXX
 SG_ Variable_truncation : 0|8@1- (1,0) [0|0] "" Vector__XXX
 SG_ Flash_test : 0|8@1- (1,0) [0|0] "" Vector__XXX
 SG_ Division_by_zero : 0|8@1- (1,0) [0|0] "" Vector__XXX
 SG_ Software_initialisation : 0|8@1- (1,0) [0|0] "" Vector__XXX
 SG_ EEPROM_VPS_Data : 0|8@1- (1,0) [0|0] "" Vector__XXX
 SG_ RAM_Test : 0|8@1- (1,0) [0|0] "" Vector__XXX
 SG_ SPI_communication : 0|8@1- (1,0) [0|0] "" Vector__XXX
 SG_ LVDT_demod_B : 0|8@1- (1,0) [0|0] "" Vector__XXX
 SG_ LVDT_demod_A : 0|8@1- (1,0) [0|0] "" Vector__XXX
 SG_ GND_level : 0|8@1- (1,0) [0|0] "" Vector__XXX
 SG_ Vref_generation : 0|8@1- (1,0) [0|0] "" Vector__XXX
 SG_ LVDT_Sinus_signal : 0|8@1- (1,0) [0|0] "" Vector__XXX
 SG_ EEPROM : 0|8@1- (1,0) [0|0] "" Vector__XXX
 SG_ CAN_Bus : 0|8@1- (1,0) [0|0] "" Vector__XXX
 SG_ Plus_5V : 0|8@1- (1,0) [0|0] "" Vector__XXX
 SG_ Overvoltage_supervisor : 0|8@1- (1,0) [0|0] "" Vector__XXX
 SG_ Coils_Supply_Switch : 0|8@1- (1,0) [0|0] "" Vector__XXX
 SG_ Cut_off_solenoid : 0|8@1- (1,0) [0|0] "" Vector__XXX
 SG_ Demanded_safe_state : 0|8@1- (1,0) [0|0] "" Vector__XXX
 SG_ Reserved : 0|8@1- (1,0) [0|0] "" Vector__XXX
 SG_ Safe_On_Road_Monitoring : 0|8@1- (1,0) [0|0] "" Vector__XXX
 SG_ Fault_Detection_Algorithm_Monito : 0|8@1- (1,0) [0|0] "" Vector__XXX
 SG_ EH_main_spool_monitoring : 0|8@1- (1,0) [0|0] "" Vector__XXX
 SG_ Vehicle_speed_triggered_EH_Steer : 0|8@1- (1,0) [0|0] "" Vector__XXX
 SG_ Auxiliary_steering_device : 0|8@1- (1,0) [0|0] "" Vector__XXX
 SG_ MMI : 0|8@1- (1,0) [0|0] "" Vector__XXX
 SG_ Vehicle_speed_sensor : 0|8@1- (1,0) [0|0] "" Vector__XXX
 SG_ SASA_Steering_sensor : 0|8@1- (1,0) [0|0] "" Vector__XXX
 SG_ Cut_off_supply : 0|8@1- (1,0) [0|0] "" Vector__XXX
 SG_ Sensor_5V : 0|8@1- (1,0) [0|0] "" Vector__XXX
 SG_ Vbat : 0|8@1- (1,0) [0|0] "" Vector__XXX
 SG_ Temperature_Sensor : 0|8@1- (1,0) [0|0] "" Vector__XXX
 SG_ Reserved : 0|8@1- (1,0) [0|0] "" Vector__XXX
 SG_ Analogue_sensor_connected_to_AD2 : 0|8@1- (1,0) [0|0] "" Vector__XXX
 SG_ Analogue_sensor_connected_to_AD1 : 0|8@1- (1,0) [0|0] "" Vector__XXX

CM_ "21-Aug-2017 : PVED-CLS SPN & FMI list V 2.33";
CM_ BO_ 3221225472 "This is a message for not used signals, created by Vector CANdb++ DBC OLE DB Provider.";
BA_DEF_ SG_  "SigType" ENUM  "Default","Range","RangeSigned","ASCII","Discrete","Control","ReferencePGN","DTC","StringDelimiter","StringLength","StringLengthControl";
BA_DEF_ SG_  "GenSigEVName" STRING ;
BA_DEF_ SG_  "GenSigILSupport" ENUM  "No","Yes";
BA_DEF_ SG_  "GenSigSendType" ENUM  "Cyclic","OnWrite","OnWriteWithRepetition","OnChange","OnChangeWithRepetition","IfActive","IfActiveWithRepetition","NoSigSendType";
BA_DEF_ BO_  "GenMsgILSupport" ENUM  "No","Yes";
BA_DEF_ BU_  "NmStationAddress" INT 0 255;
BA_DEF_ BO_  "GenMsgSendType" ENUM  "cyclic","NotUsed","IfActive","NotUsed","NotUsed","NotUsed","NotUsed","NotUsed","noMsgSendType";
BA_DEF_ BO_  "GenMsgRequestable" INT 0 1;
BA_DEF_ SG_  "SPN" INT 0 524287;
BA_DEF_  "DBName" STRING ;
BA_DEF_  "BusType" STRING ;
BA_DEF_  "ProtocolType" STRING ;
BA_DEF_ BO_  "VFrameFormat" ENUM  "StandardCAN","ExtendedCAN","reserved","J1939PG";
BA_DEF_ SG_  "SystemSignalLongSymbol" STRING ;
BA_DEF_DEF_  "SigType" "Default";
BA_DEF_DEF_  "GenSigEVName" "Env@Nodename_@Signame";
BA_DEF_DEF_  "GenSigILSupport" "No";
BA_DEF_DEF_  "GenSigSendType" "NoSigSendType";
BA_DEF_DEF_  "GenMsgILSupport" "Yes";
BA_DEF_DEF_  "NmStationAddress" 254;
BA_DEF_DEF_  "GenMsgSendType" "noMsgSendType";
BA_DEF_DEF_  "GenMsgRequestable" 1;
BA_DEF_DEF_  "SPN" 0;
BA_DEF_DEF_  "DBName" "";
BA_DEF_DEF_  "BusType" "CAN";
BA_DEF_DEF_  "ProtocolType" "J1939";
BA_DEF_DEF_  "VFrameFormat" "J1939PG";
BA_DEF_DEF_  "SystemSignalLongSymbol" "";
BA_ "DBName" "PVED_CLS_Error_Codes";
BA_ "SPN" SG_ 3221225472 IMD_status_crosscheck 520249;
BA_ "SPN" SG_ 3221225472 Auxiliary_steering_device_Joysti 520248;
BA_ "SystemSignalLongSymbol" SG_ 3221225472 Auxiliary_steering_device_Joysti "Auxiliary_steering_device_Joystick_enable_signal_crosscheck";
BA_ "SPN" SG_ 3221225472 Aux_steering_device_Joystick_tri 520247;
BA_ "SystemSignalLongSymbol" SG_ 3221225472 Aux_steering_device_Joystick_tri "Aux_steering_device_Joystick_trim_value_crosscheck";
BA_ "SPN" SG_ 3221225472 Invalid_sensor_configuration 520246;
BA_ "GenSigILSupport" SG_ 3221225472 Invalid_sensor_configuration 1;
BA_ "SPN" SG_ 3221225472 Incompatible_Bootloader 1562;
BA_ "GenSigILSupport" SG_ 3221225472 Incompatible_Bootloader 1;
BA_ "SPN" SG_ 3221225472 PVED_CLS_Spare_part 520240;
BA_ "GenSigILSupport" SG_ 3221225472 Software_Mismatch 1;
BA_ "SPN" SG_ 3221225472 Software_Mismatch 1563;
BA_ "SPN" SG_ 3221225472 Road_Switch_Res_Monitoring 520207;
BA_ "SPN" SG_ 3221225472 EEP_Auto_Caliber_Config_sect 520245;
BA_ "SPN" SG_ 3221225472 EEPROM_AUX_config 520244;
BA_ "SPN" SG_ 3221225472 EEPROM_STW_config 520243;
BA_ "SPN" SG_ 3221225472 EEPROM_GPS_config 520242;
BA_ "SPN" SG_ 3221225472 EEPROM_Vehicle_geometry 520241;
BA_ "SPN" SG_ 3221225472 EEPROM_Peripherals_config 520237;
BA_ "SPN" SG_ 3221225472 EEP_Anal_Sensor_Caliber_data 520236;
BA_ "SPN" SG_ 3221225472 EEP_CAN_WAS_Caliber_data 520235;
BA_ "SPN" SG_ 3221225472 EEPROM_Valve_Calibration_data 520234;
BA_ "SPN" SG_ 3221225472 EEPROM_SEHS_FDA 520233;
BA_ "SPN" SG_ 3221225472 EEPROM_Hydraulic_config 520232;
BA_ "SPN" SG_ 3221225472 EEPROM_Internal_monitoring 520239;
BA_ "SPN" SG_ 3221225472 EEPROM_SEHS_Protocol_data 520238;
BA_ "GenSigILSupport" SG_ 3221225472 Aux_str_dev_Joystick_position_cr 1;
BA_ "SPN" SG_ 3221225472 Aux_str_dev_Joystick_position_cr 520231;
BA_ "SystemSignalLongSymbol" SG_ 3221225472 Aux_str_dev_Joystick_position_cr "Aux_str_dev_Joystick_position_crosscheck";
BA_ "GenSigILSupport" SG_ 3221225472 Aux_str_dev_Str_ang_vel_croschck 1;
BA_ "SPN" SG_ 3221225472 Aux_str_dev_Str_ang_vel_croschck 520230;
BA_ "GenSigILSupport" SG_ 3221225472 STW_sensor_Speed_crosscheck 1;
BA_ "SPN" SG_ 3221225472 STW_sensor_Speed_crosscheck 520227;
BA_ "SPN" SG_ 3221225472 Soft_Error 520229;
BA_ "SPN" SG_ 3221225472 WAS_CAN_Sensor 520228;
BA_ "SPN" SG_ 3221225472 MMI_flag_crosscheck 520224;
BA_ "GenSigILSupport" SG_ 3221225472 MMI_flag_crosscheck 1;
BA_ "SigType" SG_ 3221225472 Application_state_crosscheck 7;
BA_ "SPN" SG_ 3221225472 Application_state_crosscheck 520219;
BA_ "GenSigILSupport" SG_ 3221225472 Application_state_crosscheck 1;
BA_ "SPN" SG_ 3221225472 Auxiliary_Steering_device_Steeri 520218;
BA_ "GenSigILSupport" SG_ 3221225472 Auxiliary_Steering_device_Steeri 1;
BA_ "SystemSignalLongSymbol" SG_ 3221225472 Auxiliary_Steering_device_Steeri "Auxiliary_Steering_device_Steering_angle_crosscheck";
BA_ "SPN" SG_ 3221225472 STW_sensor_Position_crosscheck 520217;
BA_ "GenSigILSupport" SG_ 3221225472 STW_sensor_Position_crosscheck 1;
BA_ "SPN" SG_ 3221225472 Vehicle_Speed_sensor_speed_cross 520216;
BA_ "GenSigILSupport" SG_ 3221225472 Vehicle_Speed_sensor_speed_cross 1;
BA_ "SystemSignalLongSymbol" SG_ 3221225472 Vehicle_Speed_sensor_speed_cross "Vehicle_Speed_sensor_speed_crosscheck";
BA_ "SPN" SG_ 3221225472 Wheel_angle_crosscheck 520215;
BA_ "GenSigILSupport" SG_ 3221225472 Wheel_angle_crosscheck 1;
BA_ "SPN" SG_ 3221225472 EH_Mainspool_Position_crosscheck 520225;
BA_ "GenSigILSupport" SG_ 3221225472 EH_Mainspool_Position_crosscheck 1;
BA_ "SPN" SG_ 3221225472 Flow_command_crosscheck 520214;
BA_ "GenSigILSupport" SG_ 3221225472 Flow_command_crosscheck 1;
BA_ "SPN" SG_ 3221225472 LVDT_calculation 520583;
BA_ "GenSigILSupport" SG_ 3221225472 LVDT_calculation 1;
BA_ "SPN" SG_ 3221225472 PSM_task 298965;
BA_ "GenSigILSupport" SG_ 3221225472 PSM_task 1;
BA_ "SPN" SG_ 3221225472 EEPROM_Diagnostic_sectors 520576;
BA_ "GenSigILSupport" SG_ 3221225472 EEPROM_Diagnostic_sectors 1;
BA_ "SPN" SG_ 3221225472 EEPROM_configuration_sectors 520578;
BA_ "GenSigILSupport" SG_ 3221225472 EEPROM_configuration_sectors 1;
BA_ "SPN" SG_ 3221225472 Program_sequence_monitoring 298966;
BA_ "GenSigILSupport" SG_ 3221225472 Program_sequence_monitoring 1;
BA_ "SPN" SG_ 3221225472 SVC_Parameters 520577;
BA_ "GenSigILSupport" SG_ 3221225472 SVC_Parameters 1;
BA_ "SPN" SG_ 3221225472 Interpolation 298968;
BA_ "GenSigILSupport" SG_ 3221225472 Interpolation 1;
BA_ "SPN" SG_ 3221225472 Too_many_errors 520592;
BA_ "GenSigILSupport" SG_ 3221225472 Too_many_errors 1;
BA_ "SPN" SG_ 3221225472 I2C_communication 299001;
BA_ "GenSigILSupport" SG_ 3221225472 I2C_communication 1;
BA_ "SPN" SG_ 3221225472 Variable_truncation 299002;
BA_ "GenSigILSupport" SG_ 3221225472 Variable_truncation 1;
BA_ "SPN" SG_ 3221225472 Flash_test 628;
BA_ "GenSigILSupport" SG_ 3221225472 Flash_test 1;
BA_ "SPN" SG_ 3221225472 Division_by_zero 299004;
BA_ "GenSigILSupport" SG_ 3221225472 Division_by_zero 1;
BA_ "SPN" SG_ 3221225472 Software_initialisation 299005;
BA_ "GenSigILSupport" SG_ 3221225472 Software_initialisation 1;
BA_ "SPN" SG_ 3221225472 EEPROM_VPS_Data 520579;
BA_ "GenSigILSupport" SG_ 3221225472 EEPROM_VPS_Data 1;
BA_ "SPN" SG_ 3221225472 RAM_Test 1557;
BA_ "GenSigILSupport" SG_ 3221225472 RAM_Test 1;
BA_ "SPN" SG_ 3221225472 SPI_communication 520213;
BA_ "GenSigILSupport" SG_ 3221225472 SPI_communication 1;
BA_ "SPN" SG_ 3221225472 LVDT_demod_B 520589;
BA_ "GenSigILSupport" SG_ 3221225472 LVDT_demod_B 1;
BA_ "SPN" SG_ 3221225472 LVDT_demod_A 520588;
BA_ "GenSigILSupport" SG_ 3221225472 LVDT_demod_A 1;
BA_ "SPN" SG_ 3221225472 GND_level 520586;
BA_ "GenSigILSupport" SG_ 3221225472 GND_level 1;
BA_ "SPN" SG_ 3221225472 Vref_generation 520585;
BA_ "GenSigILSupport" SG_ 3221225472 Vref_generation 1;
BA_ "SPN" SG_ 3221225472 LVDT_Sinus_signal 520212;
BA_ "GenSigILSupport" SG_ 3221225472 LVDT_Sinus_signal 1;
BA_ "SPN" SG_ 3221225472 EEPROM 299029;
BA_ "GenSigILSupport" SG_ 3221225472 EEPROM 1;
BA_ "SPN" SG_ 3221225472 CAN_Bus 298967;
BA_ "GenSigILSupport" SG_ 3221225472 CAN_Bus 1;
BA_ "SPN" SG_ 3221225472 Plus_5V 520582;
BA_ "GenSigILSupport" SG_ 3221225472 Plus_5V 1;
BA_ "SPN" SG_ 3221225472 Overvoltage_supervisor 520211;
BA_ "GenSigILSupport" SG_ 3221225472 Overvoltage_supervisor 1;
BA_ "SPN" SG_ 3221225472 Coils_Supply_Switch 299023;
BA_ "GenSigILSupport" SG_ 3221225472 Coils_Supply_Switch 1;
BA_ "SPN" SG_ 3221225472 Cut_off_solenoid 520210;
BA_ "GenSigILSupport" SG_ 3221225472 Cut_off_solenoid 1;
BA_ "SPN" SG_ 3221225472 Demanded_safe_state 520208;
BA_ "GenSigILSupport" SG_ 3221225472 Demanded_safe_state 1;
BA_ "SPN" SG_ 3221225472 Reserved 520194;
BA_ "GenSigILSupport" SG_ 3221225472 Reserved 1;
BA_ "SPN" SG_ 3221225472 Safe_On_Road_Monitoring 520206;
BA_ "GenSigILSupport" SG_ 3221225472 Safe_On_Road_Monitoring 1;
BA_ "SPN" SG_ 3221225472 Fault_Detection_Algorithm_Monito 520205;
BA_ "GenSigILSupport" SG_ 3221225472 Fault_Detection_Algorithm_Monito 1;
BA_ "SystemSignalLongSymbol" SG_ 3221225472 Fault_Detection_Algorithm_Monito "Fault_Detection_Algorithm_Monitoring";
BA_ "SigType" SG_ 3221225472 EH_main_spool_monitoring 7;
BA_ "SPN" SG_ 3221225472 EH_main_spool_monitoring 520204;
BA_ "GenSigILSupport" SG_ 3221225472 EH_main_spool_monitoring 1;
BA_ "SPN" SG_ 3221225472 Vehicle_speed_triggered_EH_Steer 520203;
BA_ "GenSigILSupport" SG_ 3221225472 Vehicle_speed_triggered_EH_Steer 1;
BA_ "SystemSignalLongSymbol" SG_ 3221225472 Vehicle_speed_triggered_EH_Steer "Vehicle_speed_triggered_EH_Steering_shut_off";
BA_ "SPN" SG_ 3221225472 Auxiliary_steering_device 520202;
BA_ "GenSigILSupport" SG_ 3221225472 Auxiliary_steering_device 1;
BA_ "SPN" SG_ 3221225472 MMI 520201;
BA_ "GenSigILSupport" SG_ 3221225472 MMI 1;
BA_ "SPN" SG_ 3221225472 Vehicle_speed_sensor 520200;
BA_ "GenSigILSupport" SG_ 3221225472 Vehicle_speed_sensor 1;
BA_ "SPN" SG_ 3221225472 SASA_Steering_sensor 520199;
BA_ "GenSigILSupport" SG_ 3221225472 SASA_Steering_sensor 1;
BA_ "SPN" SG_ 3221225472 Cut_off_supply 520198;
BA_ "GenSigILSupport" SG_ 3221225472 Cut_off_supply 1;
BA_ "SPN" SG_ 3221225472 Sensor_5V 520197;
BA_ "GenSigILSupport" SG_ 3221225472 Sensor_5V 1;
BA_ "SPN" SG_ 3221225472 Vbat 627;
BA_ "GenSigILSupport" SG_ 3221225472 Vbat 1;
BA_ "SPN" SG_ 3221225472 Temperature_Sensor 520195;
BA_ "GenSigILSupport" SG_ 3221225472 Temperature_Sensor 1;
BA_ "SPN" SG_ 3221225472 Analogue_sensor_connected_to_AD2 520193;
BA_ "GenSigILSupport" SG_ 3221225472 Analogue_sensor_connected_to_AD2 1;
BA_ "SPN" SG_ 3221225472 Analogue_sensor_connected_to_AD1 520192;
BA_ "GenSigILSupport" SG_ 3221225472 Analogue_sensor_connected_to_AD1 1;
VAL_ 3221225472 IMD_status_crosscheck 31 "0x1F - Condition exists" 30 "0x1E - Stuck Closed" 29 "0x1D - Stuck Open" 28 "0x1C - Not in neutral at Power-up" 27 "0x1B - Unable to return to neutral" 26 "0x1A - No steering" 25 "0x19 - Signal crosscheck failed" 24 "0x18 - Reserved" 23 "0x17 - Unintended Steering" 22 "0x16 - Message missing" 21 "0x15 - Data drifted low" 20 "0x14 - Data drifted high" 19 "0x13 - Received network data in error" 18 "0x12 - Data valid, but below normal operating range - Moderately severe level" 17 "0x11 - Data valid, but below normal operating range - Least severe level" 16 "0x10 - Data valid, but above normal operating range - Moderately severe level" 15 "0x0F - Data valid, but above normal operating range - Least severe level" 14 "0x0E - Special instructions" 13 "0x0D - Out of calibration" 12 "0x0C - Bad intelligent device or component" 11 "0x0B - Unknown root-cause" 10 "0x0A - Abnormal rate of change" 9 "0x09 - Abnormal update rate" 8 "0x08 - Abnormal frequency or pulse width or period" 7 "0x07 - Mechanical system not responding or out of adjustement" 6 "0x06 - Current above normal or grounded circuit" 5 "0x05 - Current below normal or open circuit" 4 "0x04 - Voltage below normal or short-circuit to low source" 3 "0x03 - Voltage above normal or short-circuit to high source" 2 "0x02 - Data erratic, intermittent or incorrect" 1 "0x01 - Data valid, but below normal operational range - Most severe level" 0 "0x00 - Data valid, but above normal operational range - Most severe level" ;
VAL_ 3221225472 Auxiliary_steering_device_Joysti 31 "0x1F - Condition exists" 30 "0x1E - Stuck Closed" 29 "0x1D - Stuck Open" 28 "0x1C - Not in neutral at Power-up" 27 "0x1B - Unable to return to neutral" 26 "0x1A - No steering" 25 "0x19 - Signal crosscheck failed" 24 "0x18 - Reserved" 23 "0x17 - Unintended Steering" 22 "0x16 - Message missing" 21 "0x15 - Data drifted low" 20 "0x14 - Data drifted high" 19 "0x13 - Received network data in error" 18 "0x12 - Data valid, but below normal operating range - Moderately severe level" 17 "0x11 - Data valid, but below normal operating range - Least severe level" 16 "0x10 - Data valid, but above normal operating range - Moderately severe level" 15 "0x0F - Data valid, but above normal operating range - Least severe level" 14 "0x0E - Special instructions" 13 "0x0D - Out of calibration" 12 "0x0C - Bad intelligent device or component" 11 "0x0B - Unknown root-cause" 10 "0x0A - Abnormal rate of change" 9 "0x09 - Abnormal update rate" 8 "0x08 - Abnormal frequency or pulse width or period" 7 "0x07 - Mechanical system not responding or out of adjustement" 6 "0x06 - Current above normal or grounded circuit" 5 "0x05 - Current below normal or open circuit" 4 "0x04 - Voltage below normal or short-circuit to low source" 3 "0x03 - Voltage above normal or short-circuit to high source" 2 "0x02 - Data erratic, intermittent or incorrect" 1 "0x01 - Data valid, but below normal operational range - Most severe level" 0 "0x00 - Data valid, but above normal operational range - Most severe level" ;
VAL_ 3221225472 Aux_steering_device_Joystick_tri 31 "0x1F - Condition exists" 30 "0x1E - Stuck Closed" 29 "0x1D - Stuck Open" 28 "0x1C - Not in neutral at Power-up" 27 "0x1B - Unable to return to neutral" 26 "0x1A - No steering" 25 "0x19 - Signal crosscheck failed" 24 "0x18 - Reserved" 23 "0x17 - Unintended Steering" 22 "0x16 - Message missing" 21 "0x15 - Data drifted low" 20 "0x14 - Data drifted high" 19 "0x13 - Received network data in error" 18 "0x12 - Data valid, but below normal operating range - Moderately severe level" 17 "0x11 - Data valid, but below normal operating range - Least severe level" 16 "0x10 - Data valid, but above normal operating range - Moderately severe level" 15 "0x0F - Data valid, but above normal operating range - Least severe level" 14 "0x0E - Special instructions" 13 "0x0D - Out of calibration" 12 "0x0C - Bad intelligent device or component" 11 "0x0B - Unknown root-cause" 10 "0x0A - Abnormal rate of change" 9 "0x09 - Abnormal update rate" 8 "0x08 - Abnormal frequency or pulse width or period" 7 "0x07 - Mechanical system not responding or out of adjustement" 6 "0x06 - Current above normal or grounded circuit" 5 "0x05 - Current below normal or open circuit" 4 "0x04 - Voltage below normal or short-circuit to low source" 3 "0x03 - Voltage above normal or short-circuit to high source" 2 "0x02 - Data erratic, intermittent or incorrect" 1 "0x01 - Data valid, but below normal operational range - Most severe level" 0 "0x00 - Data valid, but above normal operational range - Most severe level" ;
VAL_ 3221225472 Invalid_sensor_configuration 31 "0x1F - Condition exists" 30 "0x1E - Stuck Closed" 29 "0x1D - Stuck Open" 28 "0x1C - Not in neutral at Power-up" 27 "0x1B - Unable to return to neutral" 26 "0x1A - No steering" 25 "0x19 - Signal crosscheck failed" 24 "0x18 - Reserved" 23 "0x17 - Unintended Steering" 22 "0x16 - Message missing" 21 "0x15 - Data drifted low" 20 "0x14 - Data drifted high" 19 "0x13 - Received network data in error" 18 "0x12 - Data valid, but below normal operating range - Moderately severe level" 17 "0x11 - Data valid, but below normal operating range - Least severe level" 16 "0x10 - Data valid, but above normal operating range - Moderately severe level" 15 "0x0F - Data valid, but above normal operating range - Least severe level" 14 "0x0E - Special instructions" 13 "0x0D - Out of calibration" 12 "0x0C - Bad intelligent device or component" 11 "0x0B - Unknown root-cause" 10 "0x0A - Abnormal rate of change" 9 "0x09 - Abnormal update rate" 8 "0x08 - Abnormal frequency or pulse width or period" 7 "0x07 - Mechanical system not responding or out of adjustement" 6 "0x06 - Current above normal or grounded circuit" 5 "0x05 - Current below normal or open circuit" 4 "0x04 - Voltage below normal or short-circuit to low source" 3 "0x03 - Voltage above normal or short-circuit to high source" 2 "0x02 - Data erratic, intermittent or incorrect" 1 "0x01 - Data valid, but below normal operational range - Most severe level" 0 "0x00 - Data valid, but above normal operational range - Most severe level" ;
VAL_ 3221225472 Incompatible_Bootloader 31 "0x1F - Condition exists" 30 "0x1E - Stuck Closed" 29 "0x1D - Stuck Open" 28 "0x1C - Not in neutral at Power-up" 27 "0x1B - Unable to return to neutral" 26 "0x1A - No steering" 25 "0x19 - Signal crosscheck failed" 24 "0x18 - Reserved" 23 "0x17 - Unintended Steering" 22 "0x16 - Message missing" 21 "0x15 - Data drifted low" 20 "0x14 - Data drifted high" 19 "0x13 - Received network data in error" 18 "0x12 - Data valid, but below normal operating range - Moderately severe level" 17 "0x11 - Data valid, but below normal operating range - Least severe level" 16 "0x10 - Data valid, but above normal operating range - Moderately severe level" 15 "0x0F - Data valid, but above normal operating range - Least severe level" 14 "0x0E - Special instructions" 13 "0x0D - Out of calibration" 12 "0x0C - Bad intelligent device or component" 11 "0x0B - Unknown root-cause" 10 "0x0A - Abnormal rate of change" 9 "0x09 - Abnormal update rate" 8 "0x08 - Abnormal frequency or pulse width or period" 7 "0x07 - Mechanical system not responding or out of adjustement" 6 "0x06 - Current above normal or grounded circuit" 5 "0x05 - Current below normal or open circuit" 4 "0x04 - Voltage below normal or short-circuit to low source" 3 "0x03 - Voltage above normal or short-circuit to high source" 2 "0x02 - Data erratic, intermittent or incorrect" 1 "0x01 - Data valid, but below normal operational range - Most severe level" 0 "0x00 - Data valid, but above normal operational range - Most severe level" ;
VAL_ 3221225472 PVED_CLS_Spare_part 31 "0x1F - Condition exists" 30 "0x1E - Stuck Closed" 29 "0x1D - Stuck Open" 28 "0x1C - Not in neutral at Power-up" 27 "0x1B - Unable to return to neutral" 26 "0x1A - No steering" 25 "0x19 - Signal crosscheck failed" 24 "0x18 - Reserved" 23 "0x17 - Unintended Steering" 22 "0x16 - Message missing" 21 "0x15 - Data drifted low" 20 "0x14 - Data drifted high" 19 "0x13 - Received network data in error" 18 "0x12 - Data valid, but below normal operating range - Moderately severe level" 17 "0x11 - Data valid, but below normal operating range - Least severe level" 16 "0x10 - Data valid, but above normal operating range - Moderately severe level" 15 "0x0F - Data valid, but above normal operating range - Least severe level" 14 "0x0E - Special instructions" 13 "0x0D - Out of calibration" 12 "0x0C - Bad intelligent device or component" 11 "0x0B - Unknown root-cause" 10 "0x0A - Abnormal rate of change" 9 "0x09 - Abnormal update rate" 8 "0x08 - Abnormal frequency or pulse width or period" 7 "0x07 - Mechanical system not responding or out of adjustement" 6 "0x06 - Current above normal or grounded circuit" 5 "0x05 - Current below normal or open circuit" 4 "0x04 - Voltage below normal or short-circuit to low source" 3 "0x03 - Voltage above normal or short-circuit to high source" 2 "0x02 - Data erratic, intermittent or incorrect" 1 "0x01 - Data valid, but below normal operational range - Most severe level" 0 "0x00 - Data valid, but above normal operational range - Most severe level" ;
VAL_ 3221225472 Software_Mismatch 31 "0x1F - Condition exists" 30 "0x1E - Stuck Closed" 29 "0x1D - Stuck Open" 28 "0x1C - Not in neutral at Power-up" 27 "0x1B - Unable to return to neutral" 26 "0x1A - No steering" 25 "0x19 - Signal crosscheck failed" 24 "0x18 - Reserved" 23 "0x17 - Unintended Steering" 22 "0x16 - Message missing" 21 "0x15 - Data drifted low" 20 "0x14 - Data drifted high" 19 "0x13 - Received network data in error" 18 "0x12 - Data valid, but below normal operating range - Moderately severe level" 17 "0x11 - Data valid, but below normal operating range - Least severe level" 16 "0x10 - Data valid, but above normal operating range - Moderately severe level" 15 "0x0F - Data valid, but above normal operating range - Least severe level" 14 "0x0E - Special instructions" 13 "0x0D - Out of calibration" 12 "0x0C - Bad intelligent device or component" 11 "0x0B - Unknown root-cause" 10 "0x0A - Abnormal rate of change" 9 "0x09 - Abnormal update rate" 8 "0x08 - Abnormal frequency or pulse width or period" 7 "0x07 - Mechanical system not responding or out of adjustement" 6 "0x06 - Current above normal or grounded circuit" 5 "0x05 - Current below normal or open circuit" 4 "0x04 - Voltage below normal or short-circuit to low source" 3 "0x03 - Voltage above normal or short-circuit to high source" 2 "0x02 - Data erratic, intermittent or incorrect" 1 "0x01 - Data valid, but below normal operational range - Most severe level" 0 "0x00 - Data valid, but above normal operational range - Most severe level" ;
VAL_ 3221225472 Road_Switch_Res_Monitoring 31 "0x1F - Condition exists" 30 "0x1E - Stuck Closed" 29 "0x1D - Stuck Open" 28 "0x1C - Not in neutral at Power-up" 27 "0x1B - Unable to return to neutral" 26 "0x1A - No steering" 25 "0x19 - Signal crosscheck failed" 24 "0x18 - Reserved" 23 "0x17 - Unintended Steering" 22 "0x16 - Message missing" 21 "0x15 - Data drifted low" 20 "0x14 - Data drifted high" 19 "0x13 - Received network data in error" 18 "0x12 - Data valid, but below normal operating range - Moderately severe level" 17 "0x11 - Data valid, but below normal operating range - Least severe level" 16 "0x10 - Data valid, but above normal operating range - Moderately severe level" 15 "0x0F - Data valid, but above normal operating range - Least severe level" 14 "0x0E - Special instructions" 13 "0x0D - Out of calibration" 12 "0x0C - Bad intelligent device or component" 11 "0x0B - Unknown root-cause" 10 "0x0A - Abnormal rate of change" 9 "0x09 - Abnormal update rate" 8 "0x08 - Abnormal frequency or pulse width or period" 7 "0x07 - Mechanical system not responding or out of adjustement" 6 "0x06 - Current above normal or grounded circuit" 5 "0x05 - Current below normal or open circuit" 4 "0x04 - Voltage below normal or short-circuit to low source" 3 "0x03 - Voltage above normal or short-circuit to high source" 2 "0x02 - Data erratic, intermittent or incorrect" 1 "0x01 - Data valid, but below normal operational range - Most severe level" 0 "0x00 - Data valid, but above normal operational range - Most severe level" ;
VAL_ 3221225472 EEP_Auto_Caliber_Config_sect 31 "0x1F - Condition exists" 30 "0x1E - Stuck Closed" 29 "0x1D - Stuck Open" 28 "0x1C - Not in neutral at Power-up" 27 "0x1B - Unable to return to neutral" 26 "0x1A - No steering" 25 "0x19 - Signal crosscheck failed" 24 "0x18 - Reserved" 23 "0x17 - Unintended Steering" 22 "0x16 - Message missing" 21 "0x15 - Data drifted low" 20 "0x14 - Data drifted high" 19 "0x13 - Received network data in error" 18 "0x12 - Data valid, but below normal operating range - Moderately severe level" 17 "0x11 - Data valid, but below normal operating range - Least severe level" 16 "0x10 - Data valid, but above normal operating range - Moderately severe level" 15 "0x0F - Data valid, but above normal operating range - Least severe level" 14 "0x0E - Special instructions" 13 "0x0D - Out of calibration" 12 "0x0C - Bad intelligent device or component" 11 "0x0B - Unknown root-cause" 10 "0x0A - Abnormal rate of change" 9 "0x09 - Abnormal update rate" 8 "0x08 - Abnormal frequency or pulse width or period" 7 "0x07 - Mechanical system not responding or out of adjustement" 6 "0x06 - Current above normal or grounded circuit" 5 "0x05 - Current below normal or open circuit" 4 "0x04 - Voltage below normal or short-circuit to low source" 3 "0x03 - Voltage above normal or short-circuit to high source" 2 "0x02 - Data erratic, intermittent or incorrect" 1 "0x01 - Data valid, but below normal operational range - Most severe level" 0 "0x00 - Data valid, but above normal operational range - Most severe level" ;
VAL_ 3221225472 EEPROM_AUX_config 31 "0x1F - Condition exists" 30 "0x1E - Stuck Closed" 29 "0x1D - Stuck Open" 28 "0x1C - Not in neutral at Power-up" 27 "0x1B - Unable to return to neutral" 26 "0x1A - No steering" 25 "0x19 - Signal crosscheck failed" 24 "0x18 - Reserved" 23 "0x17 - Unintended Steering" 22 "0x16 - Message missing" 21 "0x15 - Data drifted low" 20 "0x14 - Data drifted high" 19 "0x13 - Received network data in error" 18 "0x12 - Data valid, but below normal operating range - Moderately severe level" 17 "0x11 - Data valid, but below normal operating range - Least severe level" 16 "0x10 - Data valid, but above normal operating range - Moderately severe level" 15 "0x0F - Data valid, but above normal operating range - Least severe level" 14 "0x0E - Special instructions" 13 "0x0D - Out of calibration" 12 "0x0C - Bad intelligent device or component" 11 "0x0B - Unknown root-cause" 10 "0x0A - Abnormal rate of change" 9 "0x09 - Abnormal update rate" 8 "0x08 - Abnormal frequency or pulse width or period" 7 "0x07 - Mechanical system not responding or out of adjustement" 6 "0x06 - Current above normal or grounded circuit" 5 "0x05 - Current below normal or open circuit" 4 "0x04 - Voltage below normal or short-circuit to low source" 3 "0x03 - Voltage above normal or short-circuit to high source" 2 "0x02 - Data erratic, intermittent or incorrect" 1 "0x01 - Data valid, but below normal operational range - Most severe level" 0 "0x00 - Data valid, but above normal operational range - Most severe level" ;
VAL_ 3221225472 EEPROM_STW_config 31 "0x1F - Condition exists" 30 "0x1E - Stuck Closed" 29 "0x1D - Stuck Open" 28 "0x1C - Not in neutral at Power-up" 27 "0x1B - Unable to return to neutral" 26 "0x1A - No steering" 25 "0x19 - Signal crosscheck failed" 24 "0x18 - Reserved" 23 "0x17 - Unintended Steering" 22 "0x16 - Message missing" 21 "0x15 - Data drifted low" 20 "0x14 - Data drifted high" 19 "0x13 - Received network data in error" 18 "0x12 - Data valid, but below normal operating range - Moderately severe level" 17 "0x11 - Data valid, but below normal operating range - Least severe level" 16 "0x10 - Data valid, but above normal operating range - Moderately severe level" 15 "0x0F - Data valid, but above normal operating range - Least severe level" 14 "0x0E - Special instructions" 13 "0x0D - Out of calibration" 12 "0x0C - Bad intelligent device or component" 11 "0x0B - Unknown root-cause" 10 "0x0A - Abnormal rate of change" 9 "0x09 - Abnormal update rate" 8 "0x08 - Abnormal frequency or pulse width or period" 7 "0x07 - Mechanical system not responding or out of adjustement" 6 "0x06 - Current above normal or grounded circuit" 5 "0x05 - Current below normal or open circuit" 4 "0x04 - Voltage below normal or short-circuit to low source" 3 "0x03 - Voltage above normal or short-circuit to high source" 2 "0x02 - Data erratic, intermittent or incorrect" 1 "0x01 - Data valid, but below normal operational range - Most severe level" 0 "0x00 - Data valid, but above normal operational range - Most severe level" ;
VAL_ 3221225472 EEPROM_GPS_config 31 "0x1F - Condition exists" 30 "0x1E - Stuck Closed" 29 "0x1D - Stuck Open" 28 "0x1C - Not in neutral at Power-up" 27 "0x1B - Unable to return to neutral" 26 "0x1A - No steering" 25 "0x19 - Signal crosscheck failed" 24 "0x18 - Reserved" 23 "0x17 - Unintended Steering" 22 "0x16 - Message missing" 21 "0x15 - Data drifted low" 20 "0x14 - Data drifted high" 19 "0x13 - Received network data in error" 18 "0x12 - Data valid, but below normal operating range - Moderately severe level" 17 "0x11 - Data valid, but below normal operating range - Least severe level" 16 "0x10 - Data valid, but above normal operating range - Moderately severe level" 15 "0x0F - Data valid, but above normal operating range - Least severe level" 14 "0x0E - Special instructions" 13 "0x0D - Out of calibration" 12 "0x0C - Bad intelligent device or component" 11 "0x0B - Unknown root-cause" 10 "0x0A - Abnormal rate of change" 9 "0x09 - Abnormal update rate" 8 "0x08 - Abnormal frequency or pulse width or period" 7 "0x07 - Mechanical system not responding or out of adjustement" 6 "0x06 - Current above normal or grounded circuit" 5 "0x05 - Current below normal or open circuit" 4 "0x04 - Voltage below normal or short-circuit to low source" 3 "0x03 - Voltage above normal or short-circuit to high source" 2 "0x02 - Data erratic, intermittent or incorrect" 1 "0x01 - Data valid, but below normal operational range - Most severe level" 0 "0x00 - Data valid, but above normal operational range - Most severe level" ;
VAL_ 3221225472 EEPROM_Vehicle_geometry 31 "0x1F - Condition exists" 30 "0x1E - Stuck Closed" 29 "0x1D - Stuck Open" 28 "0x1C - Not in neutral at Power-up" 27 "0x1B - Unable to return to neutral" 26 "0x1A - No steering" 25 "0x19 - Signal crosscheck failed" 24 "0x18 - Reserved" 23 "0x17 - Unintended Steering" 22 "0x16 - Message missing" 21 "0x15 - Data drifted low" 20 "0x14 - Data drifted high" 19 "0x13 - Received network data in error" 18 "0x12 - Data valid, but below normal operating range - Moderately severe level" 17 "0x11 - Data valid, but below normal operating range - Least severe level" 16 "0x10 - Data valid, but above normal operating range - Moderately severe level" 15 "0x0F - Data valid, but above normal operating range - Least severe level" 14 "0x0E - Special instructions" 13 "0x0D - Out of calibration" 12 "0x0C - Bad intelligent device or component" 11 "0x0B - Unknown root-cause" 10 "0x0A - Abnormal rate of change" 9 "0x09 - Abnormal update rate" 8 "0x08 - Abnormal frequency or pulse width or period" 7 "0x07 - Mechanical system not responding or out of adjustement" 6 "0x06 - Current above normal or grounded circuit" 5 "0x05 - Current below normal or open circuit" 4 "0x04 - Voltage below normal or short-circuit to low source" 3 "0x03 - Voltage above normal or short-circuit to high source" 2 "0x02 - Data erratic, intermittent or incorrect" 1 "0x01 - Data valid, but below normal operational range - Most severe level" 0 "0x00 - Data valid, but above normal operational range - Most severe level" ;
VAL_ 3221225472 EEPROM_Peripherals_config 31 "0x1F - Condition exists" 30 "0x1E - Stuck Closed" 29 "0x1D - Stuck Open" 28 "0x1C - Not in neutral at Power-up" 27 "0x1B - Unable to return to neutral" 26 "0x1A - No steering" 25 "0x19 - Signal crosscheck failed" 24 "0x18 - Reserved" 23 "0x17 - Unintended Steering" 22 "0x16 - Message missing" 21 "0x15 - Data drifted low" 20 "0x14 - Data drifted high" 19 "0x13 - Received network data in error" 18 "0x12 - Data valid, but below normal operating range - Moderately severe level" 17 "0x11 - Data valid, but below normal operating range - Least severe level" 16 "0x10 - Data valid, but above normal operating range - Moderately severe level" 15 "0x0F - Data valid, but above normal operating range - Least severe level" 14 "0x0E - Special instructions" 13 "0x0D - Out of calibration" 12 "0x0C - Bad intelligent device or component" 11 "0x0B - Unknown root-cause" 10 "0x0A - Abnormal rate of change" 9 "0x09 - Abnormal update rate" 8 "0x08 - Abnormal frequency or pulse width or period" 7 "0x07 - Mechanical system not responding or out of adjustement" 6 "0x06 - Current above normal or grounded circuit" 5 "0x05 - Current below normal or open circuit" 4 "0x04 - Voltage below normal or short-circuit to low source" 3 "0x03 - Voltage above normal or short-circuit to high source" 2 "0x02 - Data erratic, intermittent or incorrect" 1 "0x01 - Data valid, but below normal operational range - Most severe level" 0 "0x00 - Data valid, but above normal operational range - Most severe level" ;
VAL_ 3221225472 EEP_Anal_Sensor_Caliber_data 31 "0x1F - Condition exists" 30 "0x1E - Stuck Closed" 29 "0x1D - Stuck Open" 28 "0x1C - Not in neutral at Power-up" 27 "0x1B - Unable to return to neutral" 26 "0x1A - No steering" 25 "0x19 - Signal crosscheck failed" 24 "0x18 - Reserved" 23 "0x17 - Unintended Steering" 22 "0x16 - Message missing" 21 "0x15 - Data drifted low" 20 "0x14 - Data drifted high" 19 "0x13 - Received network data in error" 18 "0x12 - Data valid, but below normal operating range - Moderately severe level" 17 "0x11 - Data valid, but below normal operating range - Least severe level" 16 "0x10 - Data valid, but above normal operating range - Moderately severe level" 15 "0x0F - Data valid, but above normal operating range - Least severe level" 14 "0x0E - Special instructions" 13 "0x0D - Out of calibration" 12 "0x0C - Bad intelligent device or component" 11 "0x0B - Unknown root-cause" 10 "0x0A - Abnormal rate of change" 9 "0x09 - Abnormal update rate" 8 "0x08 - Abnormal frequency or pulse width or period" 7 "0x07 - Mechanical system not responding or out of adjustement" 6 "0x06 - Current above normal or grounded circuit" 5 "0x05 - Current below normal or open circuit" 4 "0x04 - Voltage below normal or short-circuit to low source" 3 "0x03 - Voltage above normal or short-circuit to high source" 2 "0x02 - Data erratic, intermittent or incorrect" 1 "0x01 - Data valid, but below normal operational range - Most severe level" 0 "0x00 - Data valid, but above normal operational range - Most severe level" ;
VAL_ 3221225472 EEP_CAN_WAS_Caliber_data 31 "0x1F - Condition exists" 30 "0x1E - Stuck Closed" 29 "0x1D - Stuck Open" 28 "0x1C - Not in neutral at Power-up" 27 "0x1B - Unable to return to neutral" 26 "0x1A - No steering" 25 "0x19 - Signal crosscheck failed" 24 "0x18 - Reserved" 23 "0x17 - Unintended Steering" 22 "0x16 - Message missing" 21 "0x15 - Data drifted low" 20 "0x14 - Data drifted high" 19 "0x13 - Received network data in error" 18 "0x12 - Data valid, but below normal operating range - Moderately severe level" 17 "0x11 - Data valid, but below normal operating range - Least severe level" 16 "0x10 - Data valid, but above normal operating range - Moderately severe level" 15 "0x0F - Data valid, but above normal operating range - Least severe level" 14 "0x0E - Special instructions" 13 "0x0D - Out of calibration" 12 "0x0C - Bad intelligent device or component" 11 "0x0B - Unknown root-cause" 10 "0x0A - Abnormal rate of change" 9 "0x09 - Abnormal update rate" 8 "0x08 - Abnormal frequency or pulse width or period" 7 "0x07 - Mechanical system not responding or out of adjustement" 6 "0x06 - Current above normal or grounded circuit" 5 "0x05 - Current below normal or open circuit" 4 "0x04 - Voltage below normal or short-circuit to low source" 3 "0x03 - Voltage above normal or short-circuit to high source" 2 "0x02 - Data erratic, intermittent or incorrect" 1 "0x01 - Data valid, but below normal operational range - Most severe level" 0 "0x00 - Data valid, but above normal operational range - Most severe level" ;
VAL_ 3221225472 EEPROM_Valve_Calibration_data 31 "0x1F - Condition exists" 30 "0x1E - Stuck Closed" 29 "0x1D - Stuck Open" 28 "0x1C - Not in neutral at Power-up" 27 "0x1B - Unable to return to neutral" 26 "0x1A - No steering" 25 "0x19 - Signal crosscheck failed" 24 "0x18 - Reserved" 23 "0x17 - Unintended Steering" 22 "0x16 - Message missing" 21 "0x15 - Data drifted low" 20 "0x14 - Data drifted high" 19 "0x13 - Received network data in error" 18 "0x12 - Data valid, but below normal operating range - Moderately severe level" 17 "0x11 - Data valid, but below normal operating range - Least severe level" 16 "0x10 - Data valid, but above normal operating range - Moderately severe level" 15 "0x0F - Data valid, but above normal operating range - Least severe level" 14 "0x0E - Special instructions" 13 "0x0D - Out of calibration" 12 "0x0C - Bad intelligent device or component" 11 "0x0B - Unknown root-cause" 10 "0x0A - Abnormal rate of change" 9 "0x09 - Abnormal update rate" 8 "0x08 - Abnormal frequency or pulse width or period" 7 "0x07 - Mechanical system not responding or out of adjustement" 6 "0x06 - Current above normal or grounded circuit" 5 "0x05 - Current below normal or open circuit" 4 "0x04 - Voltage below normal or short-circuit to low source" 3 "0x03 - Voltage above normal or short-circuit to high source" 2 "0x02 - Data erratic, intermittent or incorrect" 1 "0x01 - Data valid, but below normal operational range - Most severe level" 0 "0x00 - Data valid, but above normal operational range - Most severe level" ;
VAL_ 3221225472 EEPROM_SEHS_FDA 31 "0x1F - Condition exists" 30 "0x1E - Stuck Closed" 29 "0x1D - Stuck Open" 28 "0x1C - Not in neutral at Power-up" 27 "0x1B - Unable to return to neutral" 26 "0x1A - No steering" 25 "0x19 - Signal crosscheck failed" 24 "0x18 - Reserved" 23 "0x17 - Unintended Steering" 22 "0x16 - Message missing" 21 "0x15 - Data drifted low" 20 "0x14 - Data drifted high" 19 "0x13 - Received network data in error" 18 "0x12 - Data valid, but below normal operating range - Moderately severe level" 17 "0x11 - Data valid, but below normal operating range - Least severe level" 16 "0x10 - Data valid, but above normal operating range - Moderately severe level" 15 "0x0F - Data valid, but above normal operating range - Least severe level" 14 "0x0E - Special instructions" 13 "0x0D - Out of calibration" 12 "0x0C - Bad intelligent device or component" 11 "0x0B - Unknown root-cause" 10 "0x0A - Abnormal rate of change" 9 "0x09 - Abnormal update rate" 8 "0x08 - Abnormal frequency or pulse width or period" 7 "0x07 - Mechanical system not responding or out of adjustement" 6 "0x06 - Current above normal or grounded circuit" 5 "0x05 - Current below normal or open circuit" 4 "0x04 - Voltage below normal or short-circuit to low source" 3 "0x03 - Voltage above normal or short-circuit to high source" 2 "0x02 - Data erratic, intermittent or incorrect" 1 "0x01 - Data valid, but below normal operational range - Most severe level" 0 "0x00 - Data valid, but above normal operational range - Most severe level" ;
VAL_ 3221225472 EEPROM_Hydraulic_config 31 "0x1F - Condition exists" 30 "0x1E - Stuck Closed" 29 "0x1D - Stuck Open" 28 "0x1C - Not in neutral at Power-up" 27 "0x1B - Unable to return to neutral" 26 "0x1A - No steering" 25 "0x19 - Signal crosscheck failed" 24 "0x18 - Reserved" 23 "0x17 - Unintended Steering" 22 "0x16 - Message missing" 21 "0x15 - Data drifted low" 20 "0x14 - Data drifted high" 19 "0x13 - Received network data in error" 18 "0x12 - Data valid, but below normal operating range - Moderately severe level" 17 "0x11 - Data valid, but below normal operating range - Least severe level" 16 "0x10 - Data valid, but above normal operating range - Moderately severe level" 15 "0x0F - Data valid, but above normal operating range - Least severe level" 14 "0x0E - Special instructions" 13 "0x0D - Out of calibration" 12 "0x0C - Bad intelligent device or component" 11 "0x0B - Unknown root-cause" 10 "0x0A - Abnormal rate of change" 9 "0x09 - Abnormal update rate" 8 "0x08 - Abnormal frequency or pulse width or period" 7 "0x07 - Mechanical system not responding or out of adjustement" 6 "0x06 - Current above normal or grounded circuit" 5 "0x05 - Current below normal or open circuit" 4 "0x04 - Voltage below normal or short-circuit to low source" 3 "0x03 - Voltage above normal or short-circuit to high source" 2 "0x02 - Data erratic, intermittent or incorrect" 1 "0x01 - Data valid, but below normal operational range - Most severe level" 0 "0x00 - Data valid, but above normal operational range - Most severe level" ;
VAL_ 3221225472 EEPROM_Internal_monitoring 31 "0x1F - Condition exists" 30 "0x1E - Stuck Closed" 29 "0x1D - Stuck Open" 28 "0x1C - Not in neutral at Power-up" 27 "0x1B - Unable to return to neutral" 26 "0x1A - No steering" 25 "0x19 - Signal crosscheck failed" 24 "0x18 - Reserved" 23 "0x17 - Unintended Steering" 22 "0x16 - Message missing" 21 "0x15 - Data drifted low" 20 "0x14 - Data drifted high" 19 "0x13 - Received network data in error" 18 "0x12 - Data valid, but below normal operating range - Moderately severe level" 17 "0x11 - Data valid, but below normal operating range - Least severe level" 16 "0x10 - Data valid, but above normal operating range - Moderately severe level" 15 "0x0F - Data valid, but above normal operating range - Least severe level" 14 "0x0E - Special instructions" 13 "0x0D - Out of calibration" 12 "0x0C - Bad intelligent device or component" 11 "0x0B - Unknown root-cause" 10 "0x0A - Abnormal rate of change" 9 "0x09 - Abnormal update rate" 8 "0x08 - Abnormal frequency or pulse width or period" 7 "0x07 - Mechanical system not responding or out of adjustement" 6 "0x06 - Current above normal or grounded circuit" 5 "0x05 - Current below normal or open circuit" 4 "0x04 - Voltage below normal or short-circuit to low source" 3 "0x03 - Voltage above normal or short-circuit to high source" 2 "0x02 - Data erratic, intermittent or incorrect" 1 "0x01 - Data valid, but below normal operational range - Most severe level" 0 "0x00 - Data valid, but above normal operational range - Most severe level" ;
VAL_ 3221225472 EEPROM_SEHS_Protocol_data 31 "0x1F - Condition exists" 30 "0x1E - Stuck Closed" 29 "0x1D - Stuck Open" 28 "0x1C - Not in neutral at Power-up" 27 "0x1B - Unable to return to neutral" 26 "0x1A - No steering" 25 "0x19 - Signal crosscheck failed" 24 "0x18 - Reserved" 23 "0x17 - Unintended Steering" 22 "0x16 - Message missing" 21 "0x15 - Data drifted low" 20 "0x14 - Data drifted high" 19 "0x13 - Received network data in error" 18 "0x12 - Data valid, but below normal operating range - Moderately severe level" 17 "0x11 - Data valid, but below normal operating range - Least severe level" 16 "0x10 - Data valid, but above normal operating range - Moderately severe level" 15 "0x0F - Data valid, but above normal operating range - Least severe level" 14 "0x0E - Special instructions" 13 "0x0D - Out of calibration" 12 "0x0C - Bad intelligent device or component" 11 "0x0B - Unknown root-cause" 10 "0x0A - Abnormal rate of change" 9 "0x09 - Abnormal update rate" 8 "0x08 - Abnormal frequency or pulse width or period" 7 "0x07 - Mechanical system not responding or out of adjustement" 6 "0x06 - Current above normal or grounded circuit" 5 "0x05 - Current below normal or open circuit" 4 "0x04 - Voltage below normal or short-circuit to low source" 3 "0x03 - Voltage above normal or short-circuit to high source" 2 "0x02 - Data erratic, intermittent or incorrect" 1 "0x01 - Data valid, but below normal operational range - Most severe level" 0 "0x00 - Data valid, but above normal operational range - Most severe level" ;
VAL_ 3221225472 Aux_str_dev_Joystick_position_cr 31 "0x1F - Condition exists" 30 "0x1E - Stuck Closed" 29 "0x1D - Stuck Open" 28 "0x1C - Not in neutral at Power-up" 27 "0x1B - Unable to return to neutral" 26 "0x1A - No steering" 25 "0x19 - Signal crosscheck failed" 24 "0x18 - Reserved" 23 "0x17 - Unintended Steering" 22 "0x16 - Message missing" 21 "0x15 - Data drifted low" 20 "0x14 - Data drifted high" 19 "0x13 - Received network data in error" 18 "0x12 - Data valid, but below normal operating range - Moderately severe level" 17 "0x11 - Data valid, but below normal operating range - Least severe level" 16 "0x10 - Data valid, but above normal operating range - Moderately severe level" 15 "0x0F - Data valid, but above normal operating range - Least severe level" 14 "0x0E - Special instructions" 13 "0x0D - Out of calibration" 12 "0x0C - Bad intelligent device or component" 11 "0x0B - Unknown root-cause" 10 "0x0A - Abnormal rate of change" 9 "0x09 - Abnormal update rate" 8 "0x08 - Abnormal frequency or pulse width or period" 7 "0x07 - Mechanical system not responding or out of adjustement" 6 "0x06 - Current above normal or grounded circuit" 5 "0x05 - Current below normal or open circuit" 4 "0x04 - Voltage below normal or short-circuit to low source" 3 "0x03 - Voltage above normal or short-circuit to high source" 2 "0x02 - Data erratic, intermittent or incorrect" 1 "0x01 - Data valid, but below normal operational range - Most severe level" 0 "0x00 - Data valid, but above normal operational range - Most severe level" ;
VAL_ 3221225472 Aux_str_dev_Str_ang_vel_croschck 31 "0x1F - Condition exists" 30 "0x1E - Stuck Closed" 29 "0x1D - Stuck Open" 28 "0x1C - Not in neutral at Power-up" 27 "0x1B - Unable to return to neutral" 26 "0x1A - No steering" 25 "0x19 - Signal crosscheck failed" 24 "0x18 - Reserved" 23 "0x17 - Unintended Steering" 22 "0x16 - Message missing" 21 "0x15 - Data drifted low" 20 "0x14 - Data drifted high" 19 "0x13 - Received network data in error" 18 "0x12 - Data valid, but below normal operating range - Moderately severe level" 17 "0x11 - Data valid, but below normal operating range - Least severe level" 16 "0x10 - Data valid, but above normal operating range - Moderately severe level" 15 "0x0F - Data valid, but above normal operating range - Least severe level" 14 "0x0E - Special instructions" 13 "0x0D - Out of calibration" 12 "0x0C - Bad intelligent device or component" 11 "0x0B - Unknown root-cause" 10 "0x0A - Abnormal rate of change" 9 "0x09 - Abnormal update rate" 8 "0x08 - Abnormal frequency or pulse width or period" 7 "0x07 - Mechanical system not responding or out of adjustement" 6 "0x06 - Current above normal or grounded circuit" 5 "0x05 - Current below normal or open circuit" 4 "0x04 - Voltage below normal or short-circuit to low source" 3 "0x03 - Voltage above normal or short-circuit to high source" 2 "0x02 - Data erratic, intermittent or incorrect" 1 "0x01 - Data valid, but below normal operational range - Most severe level" 0 "0x00 - Data valid, but above normal operational range - Most severe level" ;
VAL_ 3221225472 STW_sensor_Speed_crosscheck 31 "0x1F - Condition exists" 30 "0x1E - Stuck Closed" 29 "0x1D - Stuck Open" 28 "0x1C - Not in neutral at Power-up" 27 "0x1B - Unable to return to neutral" 26 "0x1A - No steering" 25 "0x19 - Signal crosscheck failed" 24 "0x18 - Reserved" 23 "0x17 - Unintended Steering" 22 "0x16 - Message missing" 21 "0x15 - Data drifted low" 20 "0x14 - Data drifted high" 19 "0x13 - Received network data in error" 18 "0x12 - Data valid, but below normal operating range - Moderately severe level" 17 "0x11 - Data valid, but below normal operating range - Least severe level" 16 "0x10 - Data valid, but above normal operating range - Moderately severe level" 15 "0x0F - Data valid, but above normal operating range - Least severe level" 14 "0x0E - Special instructions" 13 "0x0D - Out of calibration" 12 "0x0C - Bad intelligent device or component" 11 "0x0B - Unknown root-cause" 10 "0x0A - Abnormal rate of change" 9 "0x09 - Abnormal update rate" 8 "0x08 - Abnormal frequency or pulse width or period" 7 "0x07 - Mechanical system not responding or out of adjustement" 6 "0x06 - Current above normal or grounded circuit" 5 "0x05 - Current below normal or open circuit" 4 "0x04 - Voltage below normal or short-circuit to low source" 3 "0x03 - Voltage above normal or short-circuit to high source" 2 "0x02 - Data erratic, intermittent or incorrect" 1 "0x01 - Data valid, but below normal operational range - Most severe level" 0 "0x00 - Data valid, but above normal operational range - Most severe level" ;
VAL_ 3221225472 Soft_Error 31 "0x1F - Condition exists" 30 "0x1E - Stuck Closed" 29 "0x1D - Stuck Open" 28 "0x1C - Not in neutral at Power-up" 27 "0x1B - Unable to return to neutral" 26 "0x1A - No steering" 25 "0x19 - Signal crosscheck failed" 24 "0x18 - Reserved" 23 "0x17 - Unintended Steering" 22 "0x16 - Message missing" 21 "0x15 - Data drifted low" 20 "0x14 - Data drifted high" 19 "0x13 - Received network data in error" 18 "0x12 - Data valid, but below normal operating range - Moderately severe level" 17 "0x11 - Data valid, but below normal operating range - Least severe level" 16 "0x10 - Data valid, but above normal operating range - Moderately severe level" 15 "0x0F - Data valid, but above normal operating range - Least severe level" 14 "0x0E - Special instructions" 13 "0x0D - Out of calibration" 12 "0x0C - Bad intelligent device or component" 11 "0x0B - Unknown root-cause" 10 "0x0A - Abnormal rate of change" 9 "0x09 - Abnormal update rate" 8 "0x08 - Abnormal frequency or pulse width or period" 7 "0x07 - Mechanical system not responding or out of adjustement" 6 "0x06 - Current above normal or grounded circuit" 5 "0x05 - Current below normal or open circuit" 4 "0x04 - Voltage below normal or short-circuit to low source" 3 "0x03 - Voltage above normal or short-circuit to high source" 2 "0x02 - Data erratic, intermittent or incorrect" 1 "0x01 - Data valid, but below normal operational range - Most severe level" 0 "0x00 - Data valid, but above normal operational range - Most severe level" ;
VAL_ 3221225472 WAS_CAN_Sensor 31 "0x1F - Condition exists" 30 "0x1E - Stuck Closed" 29 "0x1D - Stuck Open" 28 "0x1C - Not in neutral at Power-up" 27 "0x1B - Unable to return to neutral" 26 "0x1A - No steering" 25 "0x19 - Signal crosscheck failed" 24 "0x18 - Reserved" 23 "0x17 - Unintended Steering" 22 "0x16 - Message missing" 21 "0x15 - Data drifted low" 20 "0x14 - Data drifted high" 19 "0x13 - Received network data in error" 18 "0x12 - Data valid, but below normal operating range - Moderately severe level" 17 "0x11 - Data valid, but below normal operating range - Least severe level" 16 "0x10 - Data valid, but above normal operating range - Moderately severe level" 15 "0x0F - Data valid, but above normal operating range - Least severe level" 14 "0x0E - Special instructions" 13 "0x0D - Out of calibration" 12 "0x0C - Bad intelligent device or component" 11 "0x0B - Unknown root-cause" 10 "0x0A - Abnormal rate of change" 9 "0x09 - Abnormal update rate" 8 "0x08 - Abnormal frequency or pulse width or period" 7 "0x07 - Mechanical system not responding or out of adjustement" 6 "0x06 - Current above normal or grounded circuit" 5 "0x05 - Current below normal or open circuit" 4 "0x04 - Voltage below normal or short-circuit to low source" 3 "0x03 - Voltage above normal or short-circuit to high source" 2 "0x02 - Data erratic, intermittent or incorrect" 1 "0x01 - Data valid, but below normal operational range - Most severe level" 0 "0x00 - Data valid, but above normal operational range - Most severe level" ;
VAL_ 3221225472 MMI_flag_crosscheck 31 "0x1F - Condition exists" 30 "0x1E - Stuck Closed" 29 "0x1D - Stuck Open" 28 "0x1C - Not in neutral at Power-up" 27 "0x1B - Unable to return to neutral" 26 "0x1A - No steering" 25 "0x19 - Signal crosscheck failed" 24 "0x18 - Reserved" 23 "0x17 - Unintended Steering" 22 "0x16 - Message missing" 21 "0x15 - Data drifted low" 20 "0x14 - Data drifted high" 19 "0x13 - Received network data in error" 18 "0x12 - Data valid, but below normal operating range - Moderately severe level" 17 "0x11 - Data valid, but below normal operating range - Least severe level" 16 "0x10 - Data valid, but above normal operating range - Moderately severe level" 15 "0x0F - Data valid, but above normal operating range - Least severe level" 14 "0x0E - Special instructions" 13 "0x0D - Out of calibration" 12 "0x0C - Bad intelligent device or component" 11 "0x0B - Unknown root-cause" 10 "0x0A - Abnormal rate of change" 9 "0x09 - Abnormal update rate" 8 "0x08 - Abnormal frequency or pulse width or period" 7 "0x07 - Mechanical system not responding or out of adjustement" 6 "0x06 - Current above normal or grounded circuit" 5 "0x05 - Current below normal or open circuit" 4 "0x04 - Voltage below normal or short-circuit to low source" 3 "0x03 - Voltage above normal or short-circuit to high source" 2 "0x02 - Data erratic, intermittent or incorrect" 1 "0x01 - Data valid, but below normal operational range - Most severe level" 0 "0x00 - Data valid, but above normal operational range - Most severe level" ;
VAL_ 3221225472 Application_state_crosscheck 31 "0x1F - Condition exists" 30 "0x1E - Stuck Closed" 29 "0x1D - Stuck Open" 28 "0x1C - Not in neutral at Power-up" 27 "0x1B - Unable to return to neutral" 26 "0x1A - No steering" 25 "0x19 - Signal crosscheck failed (0x19)" 24 "0x18 - Reserved" 23 "0x17 - Unintended Steering" 22 "0x16 - Message missing" 21 "0x15 - Data drifted low" 20 "0x14 - Data drifted high" 19 "0x13 - Received network data in error" 18 "0x12 - Data valid, but below normal operating range - Moderately severe level" 17 "0x11 - Data valid, but below normal operating range - Least severe level" 16 "0x10 - Data valid, but above normal operating range - Moderately severe level" 15 "0x0F - Data valid, but above normal operating range - Least severe level" 14 "0x0E - Special instructions" 13 "0x0D - Out of calibration" 12 "0x0C - Bad intelligent device or component" 11 "0x0B - Unknown root-cause" 10 "0x0A - Abnormal rate of change" 9 "0x09 - Abnormal update rate" 8 "0x08 - Abnormal frequency or pulse width or period" 7 "0x07 - Mechanical system not responding or out of adjustement" 6 "0x06 - Current above normal or grounded circuit" 5 "0x05 - Current below normal or open circuit" 4 "0x04 - Voltage below normal or short-circuit to low source" 3 "0x03 - Voltage above normal or short-circuit to high source" 2 "0x02 - Data erratic, intermittent or incorrect" 1 "0x01 - Data valid, but below normal operational range - Most severe level" 0 "0x00 - Data valid, but above normal operational range - Most severe level" ;
VAL_ 3221225472 Auxiliary_Steering_device_Steeri 31 "0x1F - Condition exists" 30 "0x1E - Stuck Closed" 29 "0x1D - Stuck Open" 28 "0x1C - Not in neutral at Power-up" 27 "0x1B - Unable to return to neutral" 26 "0x1A - No steering" 25 "0x19 - Signal crosscheck failed" 24 "0x18 - Reserved" 23 "0x17 - Unintended Steering" 22 "0x16 - Message missing" 21 "0x15 - Data drifted low" 20 "0x14 - Data drifted high" 19 "0x13 - Received network data in error" 18 "0x12 - Data valid, but below normal operating range - Moderately severe level" 17 "0x11 - Data valid, but below normal operating range - Least severe level" 16 "0x10 - Data valid, but above normal operating range - Moderately severe level" 15 "0x0F - Data valid, but above normal operating range - Least severe level" 14 "0x0E - Special instructions" 13 "0x0D - Out of calibration" 12 "0x0C - Bad intelligent device or component" 11 "0x0B - Unknown root-cause" 10 "0x0A - Abnormal rate of change" 9 "0x09 - Abnormal update rate" 8 "0x08 - Abnormal frequency or pulse width or period" 7 "0x07 - Mechanical system not responding or out of adjustement" 6 "0x06 - Current above normal or grounded circuit" 5 "0x05 - Current below normal or open circuit" 4 "0x04 - Voltage below normal or short-circuit to low source" 3 "0x03 - Voltage above normal or short-circuit to high source" 2 "0x02 - Data erratic, intermittent or incorrect" 1 "0x01 - Data valid, but below normal operational range - Most severe level" 0 "0x00 - Data valid, but above normal operational range - Most severe level" ;
VAL_ 3221225472 STW_sensor_Position_crosscheck 31 "0x1F - Condition exists" 30 "0x1E - Stuck Closed" 29 "0x1D - Stuck Open" 28 "0x1C - Not in neutral at Power-up" 27 "0x1B - Unable to return to neutral" 26 "0x1A - No steering" 25 "0x19 - Signal crosscheck failed" 24 "0x18 - Reserved" 23 "0x17 - Unintended Steering" 22 "0x16 - Message missing" 21 "0x15 - Data drifted low" 20 "0x14 - Data drifted high" 19 "0x13 - Received network data in error" 18 "0x12 - Data valid, but below normal operating range - Moderately severe level" 17 "0x11 - Data valid, but below normal operating range - Least severe level" 16 "0x10 - Data valid, but above normal operating range - Moderately severe level" 15 "0x0F - Data valid, but above normal operating range - Least severe level" 14 "0x0E - Special instructions" 13 "0x0D - Out of calibration" 12 "0x0C - Bad intelligent device or component" 11 "0x0B - Unknown root-cause" 10 "0x0A - Abnormal rate of change" 9 "0x09 - Abnormal update rate" 8 "0x08 - Abnormal frequency or pulse width or period" 7 "0x07 - Mechanical system not responding or out of adjustement" 6 "0x06 - Current above normal or grounded circuit" 5 "0x05 - Current below normal or open circuit" 4 "0x04 - Voltage below normal or short-circuit to low source" 3 "0x03 - Voltage above normal or short-circuit to high source" 2 "0x02 - Data erratic, intermittent or incorrect" 1 "0x01 - Data valid, but below normal operational range - Most severe level" 0 "0x00 - Data valid, but above normal operational range - Most severe level" ;
VAL_ 3221225472 Vehicle_Speed_sensor_speed_cross 31 "0x1F - Condition exists" 30 "0x1E - Stuck Closed" 29 "0x1D - Stuck Open" 28 "0x1C - Not in neutral at Power-up" 27 "0x1B - Unable to return to neutral" 26 "0x1A - No steering" 25 "0x19 - Signal crosscheck failed" 24 "0x18 - Reserved" 23 "0x17 - Unintended Steering" 22 "0x16 - Message missing" 21 "0x15 - Data drifted low" 20 "0x14 - Data drifted high" 19 "0x13 - Received network data in error" 18 "0x12 - Data valid, but below normal operating range - Moderately severe level" 17 "0x11 - Data valid, but below normal operating range - Least severe level" 16 "0x10 - Data valid, but above normal operating range - Moderately severe level" 15 "0x0F - Data valid, but above normal operating range - Least severe level" 14 "0x0E - Special instructions" 13 "0x0D - Out of calibration" 12 "0x0C - Bad intelligent device or component" 11 "0x0B - Unknown root-cause" 10 "0x0A - Abnormal rate of change" 9 "0x09 - Abnormal update rate" 8 "0x08 - Abnormal frequency or pulse width or period" 7 "0x07 - Mechanical system not responding or out of adjustement" 6 "0x06 - Current above normal or grounded circuit" 5 "0x05 - Current below normal or open circuit" 4 "0x04 - Voltage below normal or short-circuit to low source" 3 "0x03 - Voltage above normal or short-circuit to high source" 2 "0x02 - Data erratic, intermittent or incorrect" 1 "0x01 - Data valid, but below normal operational range - Most severe level" 0 "0x00 - Data valid, but above normal operational range - Most severe level" ;
VAL_ 3221225472 Wheel_angle_crosscheck 31 "0x1F - Condition exists" 30 "0x1E - Stuck Closed" 29 "0x1D - Stuck Open" 28 "0x1C - Not in neutral at Power-up" 27 "0x1B - Unable to return to neutral" 26 "0x1A - No steering" 25 "0x19 - Signal crosscheck failed" 24 "0x18 - Reserved" 23 "0x17 - Unintended Steering" 22 "0x16 - Message missing" 21 "0x15 - Data drifted low" 20 "0x14 - Data drifted high" 19 "0x13 - Received network data in error" 18 "0x12 - Data valid, but below normal operating range - Moderately severe level" 17 "0x11 - Data valid, but below normal operating range - Least severe level" 16 "0x10 - Data valid, but above normal operating range - Moderately severe level" 15 "0x0F - Data valid, but above normal operating range - Least severe level" 14 "0x0E - Special instructions" 13 "0x0D - Out of calibration" 12 "0x0C - Bad intelligent device or component" 11 "0x0B - Unknown root-cause" 10 "0x0A - Abnormal rate of change" 9 "0x09 - Abnormal update rate" 8 "0x08 - Abnormal frequency or pulse width or period" 7 "0x07 - Mechanical system not responding or out of adjustement" 6 "0x06 - Current above normal or grounded circuit" 5 "0x05 - Current below normal or open circuit" 4 "0x04 - Voltage below normal or short-circuit to low source" 3 "0x03 - Voltage above normal or short-circuit to high source" 2 "0x02 - Data erratic, intermittent or incorrect" 1 "0x01 - Data valid, but below normal operational range - Most severe level" 0 "0x00 - Data valid, but above normal operational range - Most severe level" ;
VAL_ 3221225472 EH_Mainspool_Position_crosscheck 31 "0x1F - Condition exists" 30 "0x1E - Stuck Closed" 29 "0x1D - Stuck Open" 28 "0x1C - Not in neutral at Power-up" 27 "0x1B - Unable to return to neutral" 26 "0x1A - No steering" 25 "0x19 - Signal crosscheck failed" 24 "0x18 - Reserved" 23 "0x17 - Unintended Steering" 22 "0x16 - Message missing" 21 "0x15 - Data drifted low" 20 "0x14 - Data drifted high" 19 "0x13 - Received network data in error" 18 "0x12 - Data valid, but below normal operating range - Moderately severe level" 17 "0x11 - Data valid, but below normal operating range - Least severe level" 16 "0x10 - Data valid, but above normal operating range - Moderately severe level" 15 "0x0F - Data valid, but above normal operating range - Least severe level" 14 "0x0E - Special instructions" 13 "0x0D - Out of calibration" 12 "0x0C - Bad intelligent device or component" 11 "0x0B - Unknown root-cause" 10 "0x0A - Abnormal rate of change" 9 "0x09 - Abnormal update rate" 8 "0x08 - Abnormal frequency or pulse width or period" 7 "0x07 - Mechanical system not responding or out of adjustement" 6 "0x06 - Current above normal or grounded circuit" 5 "0x05 - Current below normal or open circuit" 4 "0x04 - Voltage below normal or short-circuit to low source" 3 "0x03 - Voltage above normal or short-circuit to high source" 2 "0x02 - Data erratic, intermittent or incorrect" 1 "0x01 - Data valid, but below normal operational range - Most severe level" 0 "0x00 - Data valid, but above normal operational range - Most severe level" ;
VAL_ 3221225472 Flow_command_crosscheck 31 "0x1F - Condition exists" 30 "0x1E - Stuck Closed" 29 "0x1D - Stuck Open" 28 "0x1C - Not in neutral at Power-up" 27 "0x1B - Unable to return to neutral" 26 "0x1A - No steering" 25 "0x19 - Signal crosscheck failed" 24 "0x18 - Reserved" 23 "0x17 - Unintended Steering" 22 "0x16 - Message missing" 21 "0x15 - Data drifted low" 20 "0x14 - Data drifted high" 19 "0x13 - Received network data in error" 18 "0x12 - Data valid, but below normal operating range - Moderately severe level" 17 "0x11 - Data valid, but below normal operating range - Least severe level" 16 "0x10 - Data valid, but above normal operating range - Moderately severe level" 15 "0x0F - Data valid, but above normal operating range - Least severe level" 14 "0x0E - Special instructions" 13 "0x0D - Out of calibration" 12 "0x0C - Bad intelligent device or component" 11 "0x0B - Unknown root-cause" 10 "0x0A - Abnormal rate of change" 9 "0x09 - Abnormal update rate" 8 "0x08 - Abnormal frequency or pulse width or period" 7 "0x07 - Mechanical system not responding or out of adjustement" 6 "0x06 - Current above normal or grounded circuit" 5 "0x05 - Current below normal or open circuit" 4 "0x04 - Voltage below normal or short-circuit to low source" 3 "0x03 - Voltage above normal or short-circuit to high source" 2 "0x02 - Data erratic, intermittent or incorrect" 1 "0x01 - Data valid, but below normal operational range - Most severe level" 0 "0x00 - Data valid, but above normal operational range - Most severe level" ;
VAL_ 3221225472 LVDT_calculation 31 "0x1F - Condition exists" 30 "0x1E - Stuck Closed" 29 "0x1D - Stuck Open" 28 "0x1C - Not in neutral at Power-up" 27 "0x1B - Unable to return to neutral" 26 "0x1A - No steering" 25 "0x19 - Signal crosscheck failed" 24 "0x18 - Reserved" 23 "0x17 - Unintended Steering" 22 "0x16 - Message missing" 21 "0x15 - Data drifted low" 20 "0x14 - Data drifted high" 19 "0x13 - Received network data in error" 18 "0x12 - Data valid, but below normal operating range - Moderately severe level" 17 "0x11 - Data valid, but below normal operating range - Least severe level" 16 "0x10 - Data valid, but above normal operating range - Moderately severe level" 15 "0x0F - Data valid, but above normal operating range - Least severe level" 14 "0x0E - Special instructions" 13 "0x0D - Out of calibration" 12 "0x0C - Bad intelligent device or component" 11 "0x0B - Unknown root-cause" 10 "0x0A - Abnormal rate of change" 9 "0x09 - Abnormal update rate" 8 "0x08 - Abnormal frequency or pulse width or period" 7 "0x07 - Mechanical system not responding or out of adjustement" 6 "0x06 - Current above normal or grounded circuit" 5 "0x05 - Current below normal or open circuit" 4 "0x04 - Voltage below normal or short-circuit to low source" 3 "0x03 - Voltage above normal or short-circuit to high source" 2 "0x02 - Data erratic, intermittent or incorrect" 1 "0x01 - Data valid, but below normal operational range - Most severe level" 0 "0x00 - Data valid, but above normal operational range - Most severe level" ;
VAL_ 3221225472 PSM_task 31 "0x1F - Condition exists" 30 "0x1E - Stuck Closed" 29 "0x1D - Stuck Open" 28 "0x1C - Not in neutral at Power-up" 27 "0x1B - Unable to return to neutral" 26 "0x1A - No steering" 25 "0x19 - Signal crosscheck failed" 24 "0x18 - Reserved" 23 "0x17 - Unintended Steering" 22 "0x16 - Message missing" 21 "0x15 - Data drifted low" 20 "0x14 - Data drifted high" 19 "0x13 - Received network data in error" 18 "0x12 - Data valid, but below normal operating range - Moderately severe level" 17 "0x11 - Data valid, but below normal operating range - Least severe level" 16 "0x10 - Data valid, but above normal operating range - Moderately severe level" 15 "0x0F - Data valid, but above normal operating range - Least severe level" 14 "0x0E - Special instructions" 13 "0x0D - Out of calibration" 12 "0x0C - Bad intelligent device or component" 11 "0x0B - Unknown root-cause" 10 "0x0A - Abnormal rate of change" 9 "0x09 - Abnormal update rate" 8 "0x08 - Abnormal frequency or pulse width or period" 7 "0x07 - Mechanical system not responding or out of adjustement" 6 "0x06 - Current above normal or grounded circuit" 5 "0x05 - Current below normal or open circuit" 4 "0x04 - Voltage below normal or short-circuit to low source" 3 "0x03 - Voltage above normal or short-circuit to high source" 2 "0x02 - Data erratic, intermittent or incorrect" 1 "0x01 - Data valid, but below normal operational range - Most severe level" 0 "0x00 - Data valid, but above normal operational range - Most severe level" ;
VAL_ 3221225472 EEPROM_Diagnostic_sectors 31 "0x1F - Condition exists" 30 "0x1E - Stuck Closed" 29 "0x1D - Stuck Open" 28 "0x1C - Not in neutral at Power-up" 27 "0x1B - Unable to return to neutral" 26 "0x1A - No steering" 25 "0x19 - Signal crosscheck failed" 24 "0x18 - Reserved" 23 "0x17 - Unintended Steering" 22 "0x16 - Message missing" 21 "0x15 - Data drifted low" 20 "0x14 - Data drifted high" 19 "0x13 - Received network data in error" 18 "0x12 - Data valid, but below normal operating range - Moderately severe level" 17 "0x11 - Data valid, but below normal operating range - Least severe level" 16 "0x10 - Data valid, but above normal operating range - Moderately severe level" 15 "0x0F - Data valid, but above normal operating range - Least severe level" 14 "0x0E - Special instructions" 13 "0x0D - Out of calibration" 12 "0x0C - Bad intelligent device or component" 11 "0x0B - Unknown root-cause" 10 "0x0A - Abnormal rate of change" 9 "0x09 - Abnormal update rate" 8 "0x08 - Abnormal frequency or pulse width or period" 7 "0x07 - Mechanical system not responding or out of adjustement" 6 "0x06 - Current above normal or grounded circuit" 5 "0x05 - Current below normal or open circuit" 4 "0x04 - Voltage below normal or short-circuit to low source" 3 "0x03 - Voltage above normal or short-circuit to high source" 2 "0x02 - Data erratic, intermittent or incorrect" 1 "0x01 - Data valid, but below normal operational range - Most severe level" 0 "0x00 - Data valid, but above normal operational range - Most severe level" ;
VAL_ 3221225472 EEPROM_configuration_sectors 31 "0x1F - Condition exists" 30 "0x1E - Stuck Closed" 29 "0x1D - Stuck Open" 28 "0x1C - Not in neutral at Power-up" 27 "0x1B - Unable to return to neutral" 26 "0x1A - No steering" 25 "0x19 - Signal crosscheck failed" 24 "0x18 - Reserved" 23 "0x17 - Unintended Steering" 22 "0x16 - Message missing" 21 "0x15 - Data drifted low" 20 "0x14 - Data drifted high" 19 "0x13 - Received network data in error" 18 "0x12 - Data valid, but below normal operating range - Moderately severe level" 17 "0x11 - Data valid, but below normal operating range - Least severe level" 16 "0x10 - Data valid, but above normal operating range - Moderately severe level" 15 "0x0F - Data valid, but above normal operating range - Least severe level" 14 "0x0E - Special instructions" 13 "0x0D - Out of calibration" 12 "0x0C - Bad intelligent device or component" 11 "0x0B - Unknown root-cause" 10 "0x0A - Abnormal rate of change" 9 "0x09 - Abnormal update rate" 8 "0x08 - Abnormal frequency or pulse width or period" 7 "0x07 - Mechanical system not responding or out of adjustement" 6 "0x06 - Current above normal or grounded circuit" 5 "0x05 - Current below normal or open circuit" 4 "0x04 - Voltage below normal or short-circuit to low source" 3 "0x03 - Voltage above normal or short-circuit to high source" 2 "0x02 - Data erratic, intermittent or incorrect" 1 "0x01 - Data valid, but below normal operational range - Most severe level" 0 "0x00 - Data valid, but above normal operational range - Most severe level" ;
VAL_ 3221225472 Program_sequence_monitoring 31 "0x1F - Condition exists" 30 "0x1E - Stuck Closed" 29 "0x1D - Stuck Open" 28 "0x1C - Not in neutral at Power-up" 27 "0x1B - Unable to return to neutral" 26 "0x1A - No steering" 25 "0x19 - Signal crosscheck failed" 24 "0x18 - Reserved" 23 "0x17 - Unintended Steering" 22 "0x16 - Message missing" 21 "0x15 - Data drifted low" 20 "0x14 - Data drifted high" 19 "0x13 - Received network data in error" 18 "0x12 - Data valid, but below normal operating range - Moderately severe level" 17 "0x11 - Data valid, but below normal operating range - Least severe level" 16 "0x10 - Data valid, but above normal operating range - Moderately severe level" 15 "0x0F - Data valid, but above normal operating range - Least severe level" 14 "0x0E - Special instructions" 13 "0x0D - Out of calibration" 12 "0x0C - Bad intelligent device or component" 11 "0x0B - Unknown root-cause" 10 "0x0A - Abnormal rate of change" 9 "0x09 - Abnormal update rate" 8 "0x08 - Abnormal frequency or pulse width or period" 7 "0x07 - Mechanical system not responding or out of adjustement" 6 "0x06 - Current above normal or grounded circuit" 5 "0x05 - Current below normal or open circuit" 4 "0x04 - Voltage below normal or short-circuit to low source" 3 "0x03 - Voltage above normal or short-circuit to high source" 2 "0x02 - Data erratic, intermittent or incorrect" 1 "0x01 - Data valid, but below normal operational range - Most severe level" 0 "0x00 - Data valid, but above normal operational range - Most severe level" ;
VAL_ 3221225472 SVC_Parameters 31 "0x1F - Condition exists" 30 "0x1E - Stuck Closed" 29 "0x1D - Stuck Open" 28 "0x1C - Not in neutral at Power-up" 27 "0x1B - Unable to return to neutral" 26 "0x1A - No steering" 25 "0x19 - Signal crosscheck failed" 24 "0x18 - Reserved" 23 "0x17 - Unintended Steering" 22 "0x16 - Message missing" 21 "0x15 - Data drifted low" 20 "0x14 - Data drifted high" 19 "0x13 - Received network data in error" 18 "0x12 - Data valid, but below normal operating range - Moderately severe level" 17 "0x11 - Data valid, but below normal operating range - Least severe level" 16 "0x10 - Data valid, but above normal operating range - Moderately severe level" 15 "0x0F - Data valid, but above normal operating range - Least severe level" 14 "0x0E - Special instructions" 13 "0x0D - Out of calibration" 12 "0x0C - Bad intelligent device or component" 11 "0x0B - Unknown root-cause" 10 "0x0A - Abnormal rate of change" 9 "0x09 - Abnormal update rate" 8 "0x08 - Abnormal frequency or pulse width or period" 7 "0x07 - Mechanical system not responding or out of adjustement" 6 "0x06 - Current above normal or grounded circuit" 5 "0x05 - Current below normal or open circuit" 4 "0x04 - Voltage below normal or short-circuit to low source" 3 "0x03 - Voltage above normal or short-circuit to high source" 2 "0x02 - Data erratic, intermittent or incorrect" 1 "0x01 - Data valid, but below normal operational range - Most severe level" 0 "0x00 - Data valid, but above normal operational range - Most severe level" ;
VAL_ 3221225472 Interpolation 31 "0x1F - Condition exists" 30 "0x1E - Stuck Closed" 29 "0x1D - Stuck Open" 28 "0x1C - Not in neutral at Power-up" 27 "0x1B - Unable to return to neutral" 26 "0x1A - No steering" 25 "0x19 - Signal crosscheck failed" 24 "0x18 - Reserved" 23 "0x17 - Unintended Steering" 22 "0x16 - Message missing" 21 "0x15 - Data drifted low" 20 "0x14 - Data drifted high" 19 "0x13 - Received network data in error" 18 "0x12 - Data valid, but below normal operating range - Moderately severe level" 17 "0x11 - Data valid, but below normal operating range - Least severe level" 16 "0x10 - Data valid, but above normal operating range - Moderately severe level" 15 "0x0F - Data valid, but above normal operating range - Least severe level" 14 "0x0E - Special instructions" 13 "0x0D - Out of calibration" 12 "0x0C - Bad intelligent device or component" 11 "0x0B - Unknown root-cause" 10 "0x0A - Abnormal rate of change" 9 "0x09 - Abnormal update rate" 8 "0x08 - Abnormal frequency or pulse width or period" 7 "0x07 - Mechanical system not responding or out of adjustement" 6 "0x06 - Current above normal or grounded circuit" 5 "0x05 - Current below normal or open circuit" 4 "0x04 - Voltage below normal or short-circuit to low source" 3 "0x03 - Voltage above normal or short-circuit to high source" 2 "0x02 - Data erratic, intermittent or incorrect" 1 "0x01 - Data valid, but below normal operational range - Most severe level" 0 "0x00 - Data valid, but above normal operational range - Most severe level" ;
VAL_ 3221225472 Too_many_errors 31 "0x1F - Condition exists" 30 "0x1E - Stuck Closed" 29 "0x1D - Stuck Open" 28 "0x1C - Not in neutral at Power-up" 27 "0x1B - Unable to return to neutral" 26 "0x1A - No steering" 25 "0x19 - Signal crosscheck failed" 24 "0x18 - Reserved" 23 "0x17 - Unintended Steering" 22 "0x16 - Message missing" 21 "0x15 - Data drifted low" 20 "0x14 - Data drifted high" 19 "0x13 - Received network data in error" 18 "0x12 - Data valid, but below normal operating range - Moderately severe level" 17 "0x11 - Data valid, but below normal operating range - Least severe level" 16 "0x10 - Data valid, but above normal operating range - Moderately severe level" 15 "0x0F - Data valid, but above normal operating range - Least severe level" 14 "0x0E - Special instructions" 13 "0x0D - Out of calibration" 12 "0x0C - Bad intelligent device or component" 11 "0x0B - Unknown root-cause" 10 "0x0A - Abnormal rate of change" 9 "0x09 - Abnormal update rate" 8 "0x08 - Abnormal frequency or pulse width or period" 7 "0x07 - Mechanical system not responding or out of adjustement" 6 "0x06 - Current above normal or grounded circuit" 5 "0x05 - Current below normal or open circuit" 4 "0x04 - Voltage below normal or short-circuit to low source" 3 "0x03 - Voltage above normal or short-circuit to high source" 2 "0x02 - Data erratic, intermittent or incorrect" 1 "0x01 - Data valid, but below normal operational range - Most severe level" 0 "0x00 - Data valid, but above normal operational range - Most severe level" ;
VAL_ 3221225472 I2C_communication 31 "0x1F - Condition exists" 30 "0x1E - Stuck Closed" 29 "0x1D - Stuck Open" 28 "0x1C - Not in neutral at Power-up" 27 "0x1B - Unable to return to neutral" 26 "0x1A - No steering" 25 "0x19 - Signal crosscheck failed" 24 "0x18 - Reserved" 23 "0x17 - Unintended Steering" 22 "0x16 - Message missing" 21 "0x15 - Data drifted low" 20 "0x14 - Data drifted high" 19 "0x13 - Received network data in error" 18 "0x12 - Data valid, but below normal operating range - Moderately severe level" 17 "0x11 - Data valid, but below normal operating range - Least severe level" 16 "0x10 - Data valid, but above normal operating range - Moderately severe level" 15 "0x0F - Data valid, but above normal operating range - Least severe level" 14 "0x0E - Special instructions" 13 "0x0D - Out of calibration" 12 "0x0C - Bad intelligent device or component" 11 "0x0B - Unknown root-cause" 10 "0x0A - Abnormal rate of change" 9 "0x09 - Abnormal update rate" 8 "0x08 - Abnormal frequency or pulse width or period" 7 "0x07 - Mechanical system not responding or out of adjustement" 6 "0x06 - Current above normal or grounded circuit" 5 "0x05 - Current below normal or open circuit" 4 "0x04 - Voltage below normal or short-circuit to low source" 3 "0x03 - Voltage above normal or short-circuit to high source" 2 "0x02 - Data erratic, intermittent or incorrect" 1 "0x01 - Data valid, but below normal operational range - Most severe level" 0 "0x00 - Data valid, but above normal operational range - Most severe level" ;
VAL_ 3221225472 Variable_truncation 31 "0x1F - Condition exists" 30 "0x1E - Stuck Closed" 29 "0x1D - Stuck Open" 28 "0x1C - Not in neutral at Power-up" 27 "0x1B - Unable to return to neutral" 26 "0x1A - No steering" 25 "0x19 - Signal crosscheck failed" 24 "0x18 - Reserved" 23 "0x17 - Unintended Steering" 22 "0x16 - Message missing" 21 "0x15 - Data drifted low" 20 "0x14 - Data drifted high" 19 "0x13 - Received network data in error" 18 "0x12 - Data valid, but below normal operating range - Moderately severe level" 17 "0x11 - Data valid, but below normal operating range - Least severe level" 16 "0x10 - Data valid, but above normal operating range - Moderately severe level" 15 "0x0F - Data valid, but above normal operating range - Least severe level" 14 "0x0E - Special instructions" 13 "0x0D - Out of calibration" 12 "0x0C - Bad intelligent device or component" 11 "0x0B - Unknown root-cause" 10 "0x0A - Abnormal rate of change" 9 "0x09 - Abnormal update rate" 8 "0x08 - Abnormal frequency or pulse width or period" 7 "0x07 - Mechanical system not responding or out of adjustement" 6 "0x06 - Current above normal or grounded circuit" 5 "0x05 - Current below normal or open circuit" 4 "0x04 - Voltage below normal or short-circuit to low source" 3 "0x03 - Voltage above normal or short-circuit to high source" 2 "0x02 - Data erratic, intermittent or incorrect" 1 "0x01 - Data valid, but below normal operational range - Most severe level" 0 "0x00 - Data valid, but above normal operational range - Most severe level" ;
VAL_ 3221225472 Flash_test 31 "0x1F - Condition exists" 30 "0x1E - Stuck Closed" 29 "0x1D - Stuck Open" 28 "0x1C - Not in neutral at Power-up" 27 "0x1B - Unable to return to neutral" 26 "0x1A - No steering" 25 "0x19 - Signal crosscheck failed" 24 "0x18 - Reserved" 23 "0x17 - Unintended Steering" 22 "0x16 - Message missing" 21 "0x15 - Data drifted low" 20 "0x14 - Data drifted high" 19 "0x13 - Received network data in error" 18 "0x12 - Data valid, but below normal operating range - Moderately severe level" 17 "0x11 - Data valid, but below normal operating range - Least severe level" 16 "0x10 - Data valid, but above normal operating range - Moderately severe level" 15 "0x0F - Data valid, but above normal operating range - Least severe level" 14 "0x0E - Special instructions" 13 "0x0D - Out of calibration" 12 "0x0C - Bad intelligent device or component" 11 "0x0B - Unknown root-cause" 10 "0x0A - Abnormal rate of change" 9 "0x09 - Abnormal update rate" 8 "0x08 - Abnormal frequency or pulse width or period" 7 "0x07 - Mechanical system not responding or out of adjustement" 6 "0x06 - Current above normal or grounded circuit" 5 "0x05 - Current below normal or open circuit" 4 "0x04 - Voltage below normal or short-circuit to low source" 3 "0x03 - Voltage above normal or short-circuit to high source" 2 "0x02 - Data erratic, intermittent or incorrect" 1 "0x01 - Data valid, but below normal operational range - Most severe level" 0 "0x00 - Data valid, but above normal operational range - Most severe level" ;
VAL_ 3221225472 Division_by_zero 31 "0x1F - Condition exists" 30 "0x1E - Stuck Closed" 29 "0x1D - Stuck Open" 28 "0x1C - Not in neutral at Power-up" 27 "0x1B - Unable to return to neutral" 26 "0x1A - No steering" 25 "0x19 - Signal crosscheck failed" 24 "0x18 - Reserved" 23 "0x17 - Unintended Steering" 22 "0x16 - Message missing" 21 "0x15 - Data drifted low" 20 "0x14 - Data drifted high" 19 "0x13 - Received network data in error" 18 "0x12 - Data valid, but below normal operating range - Moderately severe level" 17 "0x11 - Data valid, but below normal operating range - Least severe level" 16 "0x10 - Data valid, but above normal operating range - Moderately severe level" 15 "0x0F - Data valid, but above normal operating range - Least severe level" 14 "0x0E - Special instructions" 13 "0x0D - Out of calibration" 12 "0x0C - Bad intelligent device or component" 11 "0x0B - Unknown root-cause" 10 "0x0A - Abnormal rate of change" 9 "0x09 - Abnormal update rate" 8 "0x08 - Abnormal frequency or pulse width or period" 7 "0x07 - Mechanical system not responding or out of adjustement" 6 "0x06 - Current above normal or grounded circuit" 5 "0x05 - Current below normal or open circuit" 4 "0x04 - Voltage below normal or short-circuit to low source" 3 "0x03 - Voltage above normal or short-circuit to high source" 2 "0x02 - Data erratic, intermittent or incorrect" 1 "0x01 - Data valid, but below normal operational range - Most severe level" 0 "0x00 - Data valid, but above normal operational range - Most severe level" ;
VAL_ 3221225472 Software_initialisation 31 "0x1F - Condition exists" 30 "0x1E - Stuck Closed" 29 "0x1D - Stuck Open" 28 "0x1C - Not in neutral at Power-up" 27 "0x1B - Unable to return to neutral" 26 "0x1A - No steering" 25 "0x19 - Signal crosscheck failed" 24 "0x18 - Reserved" 23 "0x17 - Unintended Steering" 22 "0x16 - Message missing" 21 "0x15 - Data drifted low" 20 "0x14 - Data drifted high" 19 "0x13 - Received network data in error" 18 "0x12 - Data valid, but below normal operating range - Moderately severe level" 17 "0x11 - Data valid, but below normal operating range - Least severe level" 16 "0x10 - Data valid, but above normal operating range - Moderately severe level" 15 "0x0F - Data valid, but above normal operating range - Least severe level" 14 "0x0E - Special instructions" 13 "0x0D - Out of calibration" 12 "0x0C - Bad intelligent device or component" 11 "0x0B - Unknown root-cause" 10 "0x0A - Abnormal rate of change" 9 "0x09 - Abnormal update rate" 8 "0x08 - Abnormal frequency or pulse width or period" 7 "0x07 - Mechanical system not responding or out of adjustement" 6 "0x06 - Current above normal or grounded circuit" 5 "0x05 - Current below normal or open circuit" 4 "0x04 - Voltage below normal or short-circuit to low source" 3 "0x03 - Voltage above normal or short-circuit to high source" 2 "0x02 - Data erratic, intermittent or incorrect" 1 "0x01 - Data valid, but below normal operational range - Most severe level" 0 "0x00 - Data valid, but above normal operational range - Most severe level" ;
VAL_ 3221225472 EEPROM_VPS_Data 31 "0x1F - Condition exists" 30 "0x1E - Stuck Closed" 29 "0x1D - Stuck Open" 28 "0x1C - Not in neutral at Power-up" 27 "0x1B - Unable to return to neutral" 26 "0x1A - No steering" 25 "0x19 - Signal crosscheck failed" 24 "0x18 - Reserved" 23 "0x17 - Unintended Steering" 22 "0x16 - Message missing" 21 "0x15 - Data drifted low" 20 "0x14 - Data drifted high" 19 "0x13 - Received network data in error" 18 "0x12 - Data valid, but below normal operating range - Moderately severe level" 17 "0x11 - Data valid, but below normal operating range - Least severe level" 16 "0x10 - Data valid, but above normal operating range - Moderately severe level" 15 "0x0F - Data valid, but above normal operating range - Least severe level" 14 "0x0E - Special instructions" 13 "0x0D - Out of calibration" 12 "0x0C - Bad intelligent device or component" 11 "0x0B - Unknown root-cause" 10 "0x0A - Abnormal rate of change" 9 "0x09 - Abnormal update rate" 8 "0x08 - Abnormal frequency or pulse width or period" 7 "0x07 - Mechanical system not responding or out of adjustement" 6 "0x06 - Current above normal or grounded circuit" 5 "0x05 - Current below normal or open circuit" 4 "0x04 - Voltage below normal or short-circuit to low source" 3 "0x03 - Voltage above normal or short-circuit to high source" 2 "0x02 - Data erratic, intermittent or incorrect" 1 "0x01 - Data valid, but below normal operational range - Most severe level" 0 "0x00 - Data valid, but above normal operational range - Most severe level" ;
VAL_ 3221225472 RAM_Test 31 "0x1F - Condition exists" 30 "0x1E - Stuck Closed" 29 "0x1D - Stuck Open" 28 "0x1C - Not in neutral at Power-up" 27 "0x1B - Unable to return to neutral" 26 "0x1A - No steering" 25 "0x19 - Signal crosscheck failed" 24 "0x18 - Reserved" 23 "0x17 - Unintended Steering" 22 "0x16 - Message missing" 21 "0x15 - Data drifted low" 20 "0x14 - Data drifted high" 19 "0x13 - Received network data in error" 18 "0x12 - Data valid, but below normal operating range - Moderately severe level" 17 "0x11 - Data valid, but below normal operating range - Least severe level" 16 "0x10 - Data valid, but above normal operating range - Moderately severe level" 15 "0x0F - Data valid, but above normal operating range - Least severe level" 14 "0x0E - Special instructions" 13 "0x0D - Out of calibration" 12 "0x0C - Bad intelligent device or component" 11 "0x0B - Unknown root-cause" 10 "0x0A - Abnormal rate of change" 9 "0x09 - Abnormal update rate" 8 "0x08 - Abnormal frequency or pulse width or period" 7 "0x07 - Mechanical system not responding or out of adjustement" 6 "0x06 - Current above normal or grounded circuit" 5 "0x05 - Current below normal or open circuit" 4 "0x04 - Voltage below normal or short-circuit to low source" 3 "0x03 - Voltage above normal or short-circuit to high source" 2 "0x02 - Data erratic, intermittent or incorrect" 1 "0x01 - Data valid, but below normal operational range - Most severe level" 0 "0x00 - Data valid, but above normal operational range - Most severe level" ;
VAL_ 3221225472 SPI_communication 31 "0x1F - Condition exists" 30 "0x1E - Stuck Closed" 29 "0x1D - Stuck Open" 28 "0x1C - Not in neutral at Power-up" 27 "0x1B - Unable to return to neutral" 26 "0x1A - No steering" 25 "0x19 - Signal crosscheck failed" 24 "0x18 - Reserved" 23 "0x17 - Unintended Steering" 22 "0x16 - Message missing" 21 "0x15 - Data drifted low" 20 "0x14 - Data drifted high" 19 "0x13 - Received network data in error" 18 "0x12 - Data valid, but below normal operating range - Moderately severe level" 17 "0x11 - Data valid, but below normal operating range - Least severe level" 16 "0x10 - Data valid, but above normal operating range - Moderately severe level" 15 "0x0F - Data valid, but above normal operating range - Least severe level" 14 "0x0E - Special instructions" 13 "0x0D - Out of calibration" 12 "0x0C - Bad intelligent device or component" 11 "0x0B - Unknown root-cause" 10 "0x0A - Abnormal rate of change" 9 "0x09 - Abnormal update rate" 8 "0x08 - Abnormal frequency or pulse width or period" 7 "0x07 - Mechanical system not responding or out of adjustement" 6 "0x06 - Current above normal or grounded circuit" 5 "0x05 - Current below normal or open circuit" 4 "0x04 - Voltage below normal or short-circuit to low source" 3 "0x03 - Voltage above normal or short-circuit to high source" 2 "0x02 - Data erratic, intermittent or incorrect" 1 "0x01 - Data valid, but below normal operational range - Most severe level" 0 "0x00 - Data valid, but above normal operational range - Most severe level" ;
VAL_ 3221225472 LVDT_demod_B 31 "0x1F - Condition exists" 30 "0x1E - Stuck Closed" 29 "0x1D - Stuck Open" 28 "0x1C - Not in neutral at Power-up" 27 "0x1B - Unable to return to neutral" 26 "0x1A - No steering" 25 "0x19 - Signal crosscheck failed" 24 "0x18 - Reserved" 23 "0x17 - Unintended Steering" 22 "0x16 - Message missing" 21 "0x15 - Data drifted low" 20 "0x14 - Data drifted high" 19 "0x13 - Received network data in error" 18 "0x12 - Data valid, but below normal operating range - Moderately severe level" 17 "0x11 - Data valid, but below normal operating range - Least severe level" 16 "0x10 - Data valid, but above normal operating range - Moderately severe level" 15 "0x0F - Data valid, but above normal operating range - Least severe level" 14 "0x0E - Special instructions" 13 "0x0D - Out of calibration" 12 "0x0C - Bad intelligent device or component" 11 "0x0B - Unknown root-cause" 10 "0x0A - Abnormal rate of change" 9 "0x09 - Abnormal update rate" 8 "0x08 - Abnormal frequency or pulse width or period" 7 "0x07 - Mechanical system not responding or out of adjustement" 6 "0x06 - Current above normal or grounded circuit" 5 "0x05 - Current below normal or open circuit" 4 "0x04 - Voltage below normal or short-circuit to low source" 3 "0x03 - Voltage above normal or short-circuit to high source" 2 "0x02 - Data erratic, intermittent or incorrect" 1 "0x01 - Data valid, but below normal operational range - Most severe level" 0 "0x00 - Data valid, but above normal operational range - Most severe level" ;
VAL_ 3221225472 LVDT_demod_A 31 "0x1F - Condition exists" 30 "0x1E - Stuck Closed" 29 "0x1D - Stuck Open" 28 "0x1C - Not in neutral at Power-up" 27 "0x1B - Unable to return to neutral" 26 "0x1A - No steering" 25 "0x19 - Signal crosscheck failed" 24 "0x18 - Reserved" 23 "0x17 - Unintended Steering" 22 "0x16 - Message missing" 21 "0x15 - Data drifted low" 20 "0x14 - Data drifted high" 19 "0x13 - Received network data in error" 18 "0x12 - Data valid, but below normal operating range - Moderately severe level" 17 "0x11 - Data valid, but below normal operating range - Least severe level" 16 "0x10 - Data valid, but above normal operating range - Moderately severe level" 15 "0x0F - Data valid, but above normal operating range - Least severe level" 14 "0x0E - Special instructions" 13 "0x0D - Out of calibration" 12 "0x0C - Bad intelligent device or component" 11 "0x0B - Unknown root-cause" 10 "0x0A - Abnormal rate of change" 9 "0x09 - Abnormal update rate" 8 "0x08 - Abnormal frequency or pulse width or period" 7 "0x07 - Mechanical system not responding or out of adjustement" 6 "0x06 - Current above normal or grounded circuit" 5 "0x05 - Current below normal or open circuit" 4 "0x04 - Voltage below normal or short-circuit to low source" 3 "0x03 - Voltage above normal or short-circuit to high source" 2 "0x02 - Data erratic, intermittent or incorrect" 1 "0x01 - Data valid, but below normal operational range - Most severe level" 0 "0x00 - Data valid, but above normal operational range - Most severe level" ;
VAL_ 3221225472 GND_level 31 "0x1F - Condition exists" 30 "0x1E - Stuck Closed" 29 "0x1D - Stuck Open" 28 "0x1C - Not in neutral at Power-up" 27 "0x1B - Unable to return to neutral" 26 "0x1A - No steering" 25 "0x19 - Signal crosscheck failed" 24 "0x18 - Reserved" 23 "0x17 - Unintended Steering" 22 "0x16 - Message missing" 21 "0x15 - Data drifted low" 20 "0x14 - Data drifted high" 19 "0x13 - Received network data in error" 18 "0x12 - Data valid, but below normal operating range - Moderately severe level" 17 "0x11 - Data valid, but below normal operating range - Least severe level" 16 "0x10 - Data valid, but above normal operating range - Moderately severe level" 15 "0x0F - Data valid, but above normal operating range - Least severe level" 14 "0x0E - Special instructions" 13 "0x0D - Out of calibration" 12 "0x0C - Bad intelligent device or component" 11 "0x0B - Unknown root-cause" 10 "0x0A - Abnormal rate of change" 9 "0x09 - Abnormal update rate" 8 "0x08 - Abnormal frequency or pulse width or period" 7 "0x07 - Mechanical system not responding or out of adjustement" 6 "0x06 - Current above normal or grounded circuit" 5 "0x05 - Current below normal or open circuit" 4 "0x04 - Voltage below normal or short-circuit to low source" 3 "0x03 - Voltage above normal or short-circuit to high source" 2 "0x02 - Data erratic, intermittent or incorrect" 1 "0x01 - Data valid, but below normal operational range - Most severe level" 0 "0x00 - Data valid, but above normal operational range - Most severe level" ;
VAL_ 3221225472 Vref_generation 31 "0x1F - Condition exists" 30 "0x1E - Stuck Closed" 29 "0x1D - Stuck Open" 28 "0x1C - Not in neutral at Power-up" 27 "0x1B - Unable to return to neutral" 26 "0x1A - No steering" 25 "0x19 - Signal crosscheck failed" 24 "0x18 - Reserved" 23 "0x17 - Unintended Steering" 22 "0x16 - Message missing" 21 "0x15 - Data drifted low" 20 "0x14 - Data drifted high" 19 "0x13 - Received network data in error" 18 "0x12 - Data valid, but below normal operating range - Moderately severe level" 17 "0x11 - Data valid, but below normal operating range - Least severe level" 16 "0x10 - Data valid, but above normal operating range - Moderately severe level" 15 "0x0F - Data valid, but above normal operating range - Least severe level" 14 "0x0E - Special instructions" 13 "0x0D - Out of calibration" 12 "0x0C - Bad intelligent device or component" 11 "0x0B - Unknown root-cause" 10 "0x0A - Abnormal rate of change" 9 "0x09 - Abnormal update rate" 8 "0x08 - Abnormal frequency or pulse width or period" 7 "0x07 - Mechanical system not responding or out of adjustement" 6 "0x06 - Current above normal or grounded circuit" 5 "0x05 - Current below normal or open circuit" 4 "0x04 - Voltage below normal or short-circuit to low source" 3 "0x03 - Voltage above normal or short-circuit to high source" 2 "0x02 - Data erratic, intermittent or incorrect" 1 "0x01 - Data valid, but below normal operational range - Most severe level" 0 "0x00 - Data valid, but above normal operational range - Most severe level" ;
VAL_ 3221225472 LVDT_Sinus_signal 31 "0x1F - Condition exists" 30 "0x1E - Stuck Closed" 29 "0x1D - Stuck Open" 28 "0x1C - Not in neutral at Power-up" 27 "0x1B - Unable to return to neutral" 26 "0x1A - No steering" 25 "0x19 - Signal crosscheck failed" 24 "0x18 - Reserved" 23 "0x17 - Unintended Steering" 22 "0x16 - Message missing" 21 "0x15 - Data drifted low" 20 "0x14 - Data drifted high" 19 "0x13 - Received network data in error" 18 "0x12 - Data valid, but below normal operating range - Moderately severe level" 17 "0x11 - Data valid, but below normal operating range - Least severe level" 16 "0x10 - Data valid, but above normal operating range - Moderately severe level" 15 "0x0F - Data valid, but above normal operating range - Least severe level" 14 "0x0E - Special instructions" 13 "0x0D - Out of calibration" 12 "0x0C - Bad intelligent device or component" 11 "0x0B - Unknown root-cause" 10 "0x0A - Abnormal rate of change" 9 "0x09 - Abnormal update rate" 8 "0x08 - Abnormal frequency or pulse width or period" 7 "0x07 - Mechanical system not responding or out of adjustement" 6 "0x06 - Current above normal or grounded circuit" 5 "0x05 - Current below normal or open circuit" 4 "0x04 - Voltage below normal or short-circuit to low source" 3 "0x03 - Voltage above normal or short-circuit to high source" 2 "0x02 - Data erratic, intermittent or incorrect" 1 "0x01 - Data valid, but below normal operational range - Most severe level" 0 "0x00 - Data valid, but above normal operational range - Most severe level" ;
VAL_ 3221225472 EEPROM 31 "0x1F - Condition exists" 30 "0x1E - Stuck Closed" 29 "0x1D - Stuck Open" 28 "0x1C - Not in neutral at Power-up" 27 "0x1B - Unable to return to neutral" 26 "0x1A - No steering" 25 "0x19 - Signal crosscheck failed" 24 "0x18 - Reserved" 23 "0x17 - Unintended Steering" 22 "0x16 - Message missing" 21 "0x15 - Data drifted low" 20 "0x14 - Data drifted high" 19 "0x13 - Received network data in error" 18 "0x12 - Data valid, but below normal operating range - Moderately severe level" 17 "0x11 - Data valid, but below normal operating range - Least severe level" 16 "0x10 - Data valid, but above normal operating range - Moderately severe level" 15 "0x0F - Data valid, but above normal operating range - Least severe level" 14 "0x0E - Special instructions" 13 "0x0D - Out of calibration" 12 "0x0C - Bad intelligent device or component" 11 "0x0B - Unknown root-cause" 10 "0x0A - Abnormal rate of change" 9 "0x09 - Abnormal update rate" 8 "0x08 - Abnormal frequency or pulse width or period" 7 "0x07 - Mechanical system not responding or out of adjustement" 6 "0x06 - Current above normal or grounded circuit" 5 "0x05 - Current below normal or open circuit" 4 "0x04 - Voltage below normal or short-circuit to low source" 3 "0x03 - Voltage above normal or short-circuit to high source" 2 "0x02 - Data erratic, intermittent or incorrect" 1 "0x01 - Data valid, but below normal operational range - Most severe level" 0 "0x00 - Data valid, but above normal operational range - Most severe level" ;
VAL_ 3221225472 CAN_Bus 31 "0x1F - Condition exists" 30 "0x1E - Stuck Closed" 29 "0x1D - Stuck Open" 28 "0x1C - Not in neutral at Power-up" 27 "0x1B - Unable to return to neutral" 26 "0x1A - No steering" 25 "0x19 - Signal crosscheck failed" 24 "0x18 - Reserved" 23 "0x17 - Unintended Steering" 22 "0x16 - Message missing" 21 "0x15 - Data drifted low" 20 "0x14 - Data drifted high" 19 "0x13 - Received network data in error" 18 "0x12 - Data valid, but below normal operating range - Moderately severe level" 17 "0x11 - Data valid, but below normal operating range - Least severe level" 16 "0x10 - Data valid, but above normal operating range - Moderately severe level" 15 "0x0F - Data valid, but above normal operating range - Least severe level" 14 "0x0E - Special instructions" 13 "0x0D - Out of calibration" 12 "0x0C - Bad intelligent device or component" 11 "0x0B - Unknown root-cause" 10 "0x0A - Abnormal rate of change" 9 "0x09 - Abnormal update rate" 8 "0x08 - Abnormal frequency or pulse width or period" 7 "0x07 - Mechanical system not responding or out of adjustement" 6 "0x06 - Current above normal or grounded circuit" 5 "0x05 - Current below normal or open circuit" 4 "0x04 - Voltage below normal or short-circuit to low source" 3 "0x03 - Voltage above normal or short-circuit to high source" 2 "0x02 - Data erratic, intermittent or incorrect" 1 "0x01 - Data valid, but below normal operational range - Most severe level" 0 "0x00 - Data valid, but above normal operational range - Most severe level" ;
VAL_ 3221225472 Plus_5V 31 "0x1F - Condition exists" 30 "0x1E - Stuck Closed" 29 "0x1D - Stuck Open" 28 "0x1C - Not in neutral at Power-up" 27 "0x1B - Unable to return to neutral" 26 "0x1A - No steering" 25 "0x19 - Signal crosscheck failed" 24 "0x18 - Reserved" 23 "0x17 - Unintended Steering" 22 "0x16 - Message missing" 21 "0x15 - Data drifted low" 20 "0x14 - Data drifted high" 19 "0x13 - Received network data in error" 18 "0x12 - Data valid, but below normal operating range - Moderately severe level" 17 "0x11 - Data valid, but below normal operating range - Least severe level" 16 "0x10 - Data valid, but above normal operating range - Moderately severe level" 15 "0x0F - Data valid, but above normal operating range - Least severe level" 14 "0x0E - Special instructions" 13 "0x0D - Out of calibration" 12 "0x0C - Bad intelligent device or component" 11 "0x0B - Unknown root-cause" 10 "0x0A - Abnormal rate of change" 9 "0x09 - Abnormal update rate" 8 "0x08 - Abnormal frequency or pulse width or period" 7 "0x07 - Mechanical system not responding or out of adjustement" 6 "0x06 - Current above normal or grounded circuit" 5 "0x05 - Current below normal or open circuit" 4 "0x04 - Voltage below normal or short-circuit to low source" 3 "0x03 - Voltage above normal or short-circuit to high source" 2 "0x02 - Data erratic, intermittent or incorrect" 1 "0x01 - Data valid, but below normal operational range - Most severe level" 0 "0x00 - Data valid, but above normal operational range - Most severe level" ;
VAL_ 3221225472 Overvoltage_supervisor 31 "0x1F - Condition exists" 30 "0x1E - Stuck Closed" 29 "0x1D - Stuck Open" 28 "0x1C - Not in neutral at Power-up" 27 "0x1B - Unable to return to neutral" 26 "0x1A - No steering" 25 "0x19 - Signal crosscheck failed" 24 "0x18 - Reserved" 23 "0x17 - Unintended Steering" 22 "0x16 - Message missing" 21 "0x15 - Data drifted low" 20 "0x14 - Data drifted high" 19 "0x13 - Received network data in error" 18 "0x12 - Data valid, but below normal operating range - Moderately severe level" 17 "0x11 - Data valid, but below normal operating range - Least severe level" 16 "0x10 - Data valid, but above normal operating range - Moderately severe level" 15 "0x0F - Data valid, but above normal operating range - Least severe level" 14 "0x0E - Special instructions" 13 "0x0D - Out of calibration" 12 "0x0C - Bad intelligent device or component" 11 "0x0B - Unknown root-cause" 10 "0x0A - Abnormal rate of change" 9 "0x09 - Abnormal update rate" 8 "0x08 - Abnormal frequency or pulse width or period" 7 "0x07 - Mechanical system not responding or out of adjustement" 6 "0x06 - Current above normal or grounded circuit" 5 "0x05 - Current below normal or open circuit" 4 "0x04 - Voltage below normal or short-circuit to low source" 3 "0x03 - Voltage above normal or short-circuit to high source" 2 "0x02 - Data erratic, intermittent or incorrect" 1 "0x01 - Data valid, but below normal operational range - Most severe level" 0 "0x00 - Data valid, but above normal operational range - Most severe level" ;
VAL_ 3221225472 Coils_Supply_Switch 31 "0x1F - Condition exists" 30 "0x1E - Stuck Closed" 29 "0x1D - Stuck Open" 28 "0x1C - Not in neutral at Power-up" 27 "0x1B - Unable to return to neutral" 26 "0x1A - No steering" 25 "0x19 - Signal crosscheck failed" 24 "0x18 - Reserved" 23 "0x17 - Unintended Steering" 22 "0x16 - Message missing" 21 "0x15 - Data drifted low" 20 "0x14 - Data drifted high" 19 "0x13 - Received network data in error" 18 "0x12 - Data valid, but below normal operating range - Moderately severe level" 17 "0x11 - Data valid, but below normal operating range - Least severe level" 16 "0x10 - Data valid, but above normal operating range - Moderately severe level" 15 "0x0F - Data valid, but above normal operating range - Least severe level" 14 "0x0E - Special instructions" 13 "0x0D - Out of calibration" 12 "0x0C - Bad intelligent device or component" 11 "0x0B - Unknown root-cause" 10 "0x0A - Abnormal rate of change" 9 "0x09 - Abnormal update rate" 8 "0x08 - Abnormal frequency or pulse width or period" 7 "0x07 - Mechanical system not responding or out of adjustement" 6 "0x06 - Current above normal or grounded circuit" 5 "0x05 - Current below normal or open circuit" 4 "0x04 - Voltage below normal or short-circuit to low source" 3 "0x03 - Voltage above normal or short-circuit to high source" 2 "0x02 - Data erratic, intermittent or incorrect" 1 "0x01 - Data valid, but below normal operational range - Most severe level" 0 "0x00 - Data valid, but above normal operational range - Most severe level" ;
VAL_ 3221225472 Cut_off_solenoid 31 "0x1F - Condition exists" 30 "0x1E - Stuck Closed" 29 "0x1D - Stuck Open" 28 "0x1C - Not in neutral at Power-up" 27 "0x1B - Unable to return to neutral" 26 "0x1A - No steering" 25 "0x19 - Signal crosscheck failed" 24 "0x18 - Reserved" 23 "0x17 - Unintended Steering" 22 "0x16 - Message missing" 21 "0x15 - Data drifted low" 20 "0x14 - Data drifted high" 19 "0x13 - Received network data in error" 18 "0x12 - Data valid, but below normal operating range - Moderately severe level" 17 "0x11 - Data valid, but below normal operating range - Least severe level" 16 "0x10 - Data valid, but above normal operating range - Moderately severe level" 15 "0x0F - Data valid, but above normal operating range - Least severe level" 14 "0x0E - Special instructions" 13 "0x0D - Out of calibration" 12 "0x0C - Bad intelligent device or component" 11 "0x0B - Unknown root-cause" 10 "0x0A - Abnormal rate of change" 9 "0x09 - Abnormal update rate" 8 "0x08 - Abnormal frequency or pulse width or period" 7 "0x07 - Mechanical system not responding or out of adjustement" 6 "0x06 - Current above normal or grounded circuit" 5 "0x05 - Current below normal or open circuit" 4 "0x04 - Voltage below normal or short-circuit to low source" 3 "0x03 - Voltage above normal or short-circuit to high source" 2 "0x02 - Data erratic, intermittent or incorrect" 1 "0x01 - Data valid, but below normal operational range - Most severe level" 0 "0x00 - Data valid, but above normal operational range - Most severe level" ;
VAL_ 3221225472 Demanded_safe_state 31 "0x1F - Condition exists" 30 "0x1E - Stuck Closed" 29 "0x1D - Stuck Open" 28 "0x1C - Not in neutral at Power-up" 27 "0x1B - Unable to return to neutral" 26 "0x1A - No steering" 25 "0x19 - Signal crosscheck failed" 24 "0x18 - Reserved" 23 "0x17 - Unintended Steering" 22 "0x16 - Message missing" 21 "0x15 - Data drifted low" 20 "0x14 - Data drifted high" 19 "0x13 - Received network data in error" 18 "0x12 - Data valid, but below normal operating range - Moderately severe level" 17 "0x11 - Data valid, but below normal operating range - Least severe level" 16 "0x10 - Data valid, but above normal operating range - Moderately severe level" 15 "0x0F - Data valid, but above normal operating range - Least severe level" 14 "0x0E - Special instructions" 13 "0x0D - Out of calibration" 12 "0x0C - Bad intelligent device or component" 11 "0x0B - Unknown root-cause" 10 "0x0A - Abnormal rate of change" 9 "0x09 - Abnormal update rate" 8 "0x08 - Abnormal frequency or pulse width or period" 7 "0x07 - Mechanical system not responding or out of adjustement" 6 "0x06 - Current above normal or grounded circuit" 5 "0x05 - Current below normal or open circuit" 4 "0x04 - Voltage below normal or short-circuit to low source" 3 "0x03 - Voltage above normal or short-circuit to high source" 2 "0x02 - Data erratic, intermittent or incorrect" 1 "0x01 - Data valid, but below normal operational range - Most severe level" 0 "0x00 - Data valid, but above normal operational range - Most severe level" ;
VAL_ 3221225472 Safe_On_Road_Monitoring 31 "0x1F - Condition exists" 30 "0x1E - Stuck Closed" 29 "0x1D - Stuck Open" 28 "0x1C - Not in neutral at Power-up" 27 "0x1B - Unable to return to neutral" 26 "0x1A - No steering" 25 "0x19 - Signal crosscheck failed" 24 "0x18 - Reserved" 23 "0x17 - Unintended Steering" 22 "0x16 - Message missing" 21 "0x15 - Data drifted low" 20 "0x14 - Data drifted high" 19 "0x13 - Received network data in error" 18 "0x12 - Data valid, but below normal operating range - Moderately severe level" 17 "0x11 - Data valid, but below normal operating range - Least severe level" 16 "0x10 - Data valid, but above normal operating range - Moderately severe level" 15 "0x0F - Data valid, but above normal operating range - Least severe level" 14 "0x0E - Special instructions" 13 "0x0D - Out of calibration" 12 "0x0C - Bad intelligent device or component" 11 "0x0B - Unknown root-cause" 10 "0x0A - Abnormal rate of change" 9 "0x09 - Abnormal update rate" 8 "0x08 - Abnormal frequency or pulse width or period" 7 "0x07 - Mechanical system not responding or out of adjustement" 6 "0x06 - Current above normal or grounded circuit" 5 "0x05 - Current below normal or open circuit" 4 "0x04 - Voltage below normal or short-circuit to low source" 3 "0x03 - Voltage above normal or short-circuit to high source" 2 "0x02 - Data erratic, intermittent or incorrect" 1 "0x01 - Data valid, but below normal operational range - Most severe level" 0 "0x00 - Data valid, but above normal operational range - Most severe level" ;
VAL_ 3221225472 Fault_Detection_Algorithm_Monito 31 "0x1F - Condition exists" 30 "0x1E - Stuck Closed" 29 "0x1D - Stuck Open" 28 "0x1C - Not in neutral at Power-up" 27 "0x1B - Unable to return to neutral" 26 "0x1A - No steering" 25 "0x19 - Signal crosscheck failed" 24 "0x18 - Reserved" 23 "0x17 - Unintended Steering" 22 "0x16 - Message missing" 21 "0x15 - Data drifted low" 20 "0x14 - Data drifted high" 19 "0x13 - Received network data in error" 18 "0x12 - Data valid, but below normal operating range - Moderately severe level" 17 "0x11 - Data valid, but below normal operating range - Least severe level" 16 "0x10 - Data valid, but above normal operating range - Moderately severe level" 15 "0x0F - Data valid, but above normal operating range - Least severe level" 14 "0x0E - Special instructions" 13 "0x0D - Out of calibration" 12 "0x0C - Bad intelligent device or component" 11 "0x0B - Unknown root-cause" 10 "0x0A - Abnormal rate of change" 9 "0x09 - Abnormal update rate" 8 "0x08 - Abnormal frequency or pulse width or period" 7 "0x07 - Mechanical system not responding or out of adjustement" 6 "0x06 - Current above normal or grounded circuit" 5 "0x05 - Current below normal or open circuit" 4 "0x04 - Voltage below normal or short-circuit to low source" 3 "0x03 - Voltage above normal or short-circuit to high source" 2 "0x02 - Data erratic, intermittent or incorrect" 1 "0x01 - Data valid, but below normal operational range - Most severe level" 0 "0x00 - Data valid, but above normal operational range - Most severe level" ;
VAL_ 3221225472 EH_main_spool_monitoring 31 "0x1F - Condition exists" 30 "0x1E - Stuck Closed" 29 "0x1D - Stuck Open" 28 "0x1C - Not in neutral at Power-up" 27 "0x1B - Unable to return to neutral" 26 "0x1A - No steering" 25 "0x19 - Signal crosscheck failed" 24 "0x18 - Reserved" 23 "0x17 - Unintended Steering" 22 "0x16 - Message missing" 21 "0x15 - Data drifted low" 20 "0x14 - Data drifted high" 19 "0x13 - Received network data in error" 18 "0x12 - Data valid, but below normal operating range - Moderately severe level" 17 "0x11 - Data valid, but below normal operating range - Least severe level" 16 "0x10 - Data valid, but above normal operating range - Moderately severe level" 15 "0x0F - Data valid, but above normal operating range - Least severe level" 14 "0x0E - Special instructions" 13 "0x0D - Out of calibration" 12 "0x0C - Bad intelligent device or component" 11 "0x0B - Unknown root-cause" 10 "0x0A - Abnormal rate of change" 9 "0x09 - Abnormal update rate" 8 "0x08 - Abnormal frequency or pulse width or period" 7 "0x07 - Mechanical system not responding or out of adjustement" 6 "0x06 - Current above normal or grounded circuit" 5 "0x05 - Current below normal or open circuit" 4 "0x04 - Voltage below normal or short-circuit to low source" 3 "0x03 - Voltage above normal or short-circuit to high source" 2 "0x02 - Data erratic, intermittent or incorrect" 1 "0x01 - Data valid, but below normal operational range - Most severe level" 0 "0x00 - Data valid, but above normal operational range - Most severe level" ;
VAL_ 3221225472 Vehicle_speed_triggered_EH_Steer 31 "0x1F - Condition exists" 30 "0x1E - Stuck Closed" 29 "0x1D - Stuck Open" 28 "0x1C - Not in neutral at Power-up" 27 "0x1B - Unable to return to neutral" 26 "0x1A - No steering" 25 "0x19 - Signal crosscheck failed" 24 "0x18 - Reserved" 23 "0x17 - Unintended Steering" 22 "0x16 - Message missing" 21 "0x15 - Data drifted low" 20 "0x14 - Data drifted high" 19 "0x13 - Received network data in error" 18 "0x12 - Data valid, but below normal operating range - Moderately severe level" 17 "0x11 - Data valid, but below normal operating range - Least severe level" 16 "0x10 - Data valid, but above normal operating range - Moderately severe level" 15 "0x0F - Data valid, but above normal operating range - Least severe level" 14 "0x0E - Special instructions" 13 "0x0D - Out of calibration" 12 "0x0C - Bad intelligent device or component" 11 "0x0B - Unknown root-cause" 10 "0x0A - Abnormal rate of change" 9 "0x09 - Abnormal update rate" 8 "0x08 - Abnormal frequency or pulse width or period" 7 "0x07 - Mechanical system not responding or out of adjustement" 6 "0x06 - Current above normal or grounded circuit" 5 "0x05 - Current below normal or open circuit" 4 "0x04 - Voltage below normal or short-circuit to low source" 3 "0x03 - Voltage above normal or short-circuit to high source" 2 "0x02 - Data erratic, intermittent or incorrect" 1 "0x01 - Data valid, but below normal operational range - Most severe level" 0 "0x00 - Data valid, but above normal operational range - Most severe level" ;
VAL_ 3221225472 Auxiliary_steering_device 31 "0x1F - Condition exists" 30 "0x1E - Stuck Closed" 29 "0x1D - Stuck Open" 28 "0x1C - Not in neutral at Power-up" 27 "0x1B - Unable to return to neutral" 26 "0x1A - No steering" 25 "0x19 - Signal crosscheck failed" 24 "0x18 - Reserved" 23 "0x17 - Unintended Steering" 22 "0x16 - Message missing" 21 "0x15 - Data drifted low" 20 "0x14 - Data drifted high" 19 "0x13 - Received network data in error" 18 "0x12 - Data valid, but below normal operating range - Moderately severe level" 17 "0x11 - Data valid, but below normal operating range - Least severe level" 16 "0x10 - Data valid, but above normal operating range - Moderately severe level" 15 "0x0F - Data valid, but above normal operating range - Least severe level" 14 "0x0E - Special instructions" 13 "0x0D - Out of calibration" 12 "0x0C - Bad intelligent device or component" 11 "0x0B - Unknown root-cause" 10 "0x0A - Abnormal rate of change" 9 "0x09 - Abnormal update rate" 8 "0x08 - Abnormal frequency or pulse width or period" 7 "0x07 - Mechanical system not responding or out of adjustement" 6 "0x06 - Current above normal or grounded circuit" 5 "0x05 - Current below normal or open circuit" 4 "0x04 - Voltage below normal or short-circuit to low source" 3 "0x03 - Voltage above normal or short-circuit to high source" 2 "0x02 - Data erratic, intermittent or incorrect" 1 "0x01 - Data valid, but below normal operational range - Most severe level" 0 "0x00 - Data valid, but above normal operational range - Most severe level" ;
VAL_ 3221225472 MMI 31 "0x1F - Condition exists" 30 "0x1E - Stuck Closed" 29 "0x1D - Stuck Open" 28 "0x1C - Not in neutral at Power-up" 27 "0x1B - Unable to return to neutral" 26 "0x1A - No steering" 25 "0x19 - Signal crosscheck failed" 24 "0x18 - Reserved" 23 "0x17 - Unintended Steering" 22 "0x16 - Message missing" 21 "0x15 - Data drifted low" 20 "0x14 - Data drifted high" 19 "0x13 - Received network data in error" 18 "0x12 - Data valid, but below normal operating range - Moderately severe level" 17 "0x11 - Data valid, but below normal operating range - Least severe level" 16 "0x10 - Data valid, but above normal operating range - Moderately severe level" 15 "0x0F - Data valid, but above normal operating range - Least severe level" 14 "0x0E - Special instructions" 13 "0x0D - Out of calibration" 12 "0x0C - Bad intelligent device or component" 11 "0x0B - Unknown root-cause" 10 "0x0A - Abnormal rate of change" 9 "0x09 - Abnormal update rate" 8 "0x08 - Abnormal frequency or pulse width or period" 7 "0x07 - Mechanical system not responding or out of adjustement" 6 "0x06 - Current above normal or grounded circuit" 5 "0x05 - Current below normal or open circuit" 4 "0x04 - Voltage below normal or short-circuit to low source" 3 "0x03 - Voltage above normal or short-circuit to high source" 2 "0x02 - Data erratic, intermittent or incorrect" 1 "0x01 - Data valid, but below normal operational range - Most severe level" 0 "0x00 - Data valid, but above normal operational range - Most severe level" ;
VAL_ 3221225472 Vehicle_speed_sensor 31 "0x1F - Condition exists" 30 "0x1E - Stuck Closed" 29 "0x1D - Stuck Open" 28 "0x1C - Not in neutral at Power-up" 27 "0x1B - Unable to return to neutral" 26 "0x1A - No steering" 25 "0x19 - Signal crosscheck failed" 24 "0x18 - Reserved" 23 "0x17 - Unintended Steering" 22 "0x16 - Message missing" 21 "0x15 - Data drifted low" 20 "0x14 - Data drifted high" 19 "0x13 - Received network data in error" 18 "0x12 - Data valid, but below normal operating range - Moderately severe level" 17 "0x11 - Data valid, but below normal operating range - Least severe level" 16 "0x10 - Data valid, but above normal operating range - Moderately severe level" 15 "0x0F - Data valid, but above normal operating range - Least severe level" 14 "0x0E - Special instructions" 13 "0x0D - Out of calibration" 12 "0x0C - Bad intelligent device or component" 11 "0x0B - Unknown root-cause" 10 "0x0A - Abnormal rate of change" 9 "0x09 - Abnormal update rate" 8 "0x08 - Abnormal frequency or pulse width or period" 7 "0x07 - Mechanical system not responding or out of adjustement" 6 "0x06 - Current above normal or grounded circuit" 5 "0x05 - Current below normal or open circuit" 4 "0x04 - Voltage below normal or short-circuit to low source" 3 "0x03 - Voltage above normal or short-circuit to high source" 2 "0x02 - Data erratic, intermittent or incorrect" 1 "0x01 - Data valid, but below normal operational range - Most severe level" 0 "0x00 - Data valid, but above normal operational range - Most severe level" ;
VAL_ 3221225472 SASA_Steering_sensor 31 "0x1F - Condition exists" 30 "0x1E - Stuck Closed" 29 "0x1D - Stuck Open" 28 "0x1C - Not in neutral at Power-up" 27 "0x1B - Unable to return to neutral" 26 "0x1A - No steering" 25 "0x19 - Signal crosscheck failed" 24 "0x18 - Reserved" 23 "0x17 - Unintended Steering" 22 "0x16 - Message missing" 21 "0x15 - Data drifted low" 20 "0x14 - Data drifted high" 19 "0x13 - Received network data in error" 18 "0x12 - Data valid, but below normal operating range - Moderately severe level" 17 "0x11 - Data valid, but below normal operating range - Least severe level" 16 "0x10 - Data valid, but above normal operating range - Moderately severe level" 15 "0x0F - Data valid, but above normal operating range - Least severe level" 14 "0x0E - Special instructions" 13 "0x0D - Out of calibration" 12 "0x0C - Bad intelligent device or component" 11 "0x0B - Unknown root-cause" 10 "0x0A - Abnormal rate of change" 9 "0x09 - Abnormal update rate" 8 "0x08 - Abnormal frequency or pulse width or period" 7 "0x07 - Mechanical system not responding or out of adjustement" 6 "0x06 - Current above normal or grounded circuit" 5 "0x05 - Current below normal or open circuit" 4 "0x04 - Voltage below normal or short-circuit to low source" 3 "0x03 - Voltage above normal or short-circuit to high source" 2 "0x02 - Data erratic, intermittent or incorrect" 1 "0x01 - Data valid, but below normal operational range - Most severe level" 0 "0x00 - Data valid, but above normal operational range - Most severe level" ;
VAL_ 3221225472 Cut_off_supply 31 "0x1F - Condition exists" 30 "0x1E - Stuck Closed" 29 "0x1D - Stuck Open" 28 "0x1C - Not in neutral at Power-up" 27 "0x1B - Unable to return to neutral" 26 "0x1A - No steering" 25 "0x19 - Signal crosscheck failed" 24 "0x18 - Reserved" 23 "0x17 - Unintended Steering" 22 "0x16 - Message missing" 21 "0x15 - Data drifted low" 20 "0x14 - Data drifted high" 19 "0x13 - Received network data in error" 18 "0x12 - Data valid, but below normal operating range - Moderately severe level" 17 "0x11 - Data valid, but below normal operating range - Least severe level" 16 "0x10 - Data valid, but above normal operating range - Moderately severe level" 15 "0x0F - Data valid, but above normal operating range - Least severe level" 14 "0x0E - Special instructions" 13 "0x0D - Out of calibration" 12 "0x0C - Bad intelligent device or component" 11 "0x0B - Unknown root-cause" 10 "0x0A - Abnormal rate of change" 9 "0x09 - Abnormal update rate" 8 "0x08 - Abnormal frequency or pulse width or period" 7 "0x07 - Mechanical system not responding or out of adjustement" 6 "0x06 - Current above normal or grounded circuit" 5 "0x05 - Current below normal or open circuit" 4 "0x04 - Voltage below normal or short-circuit to low source" 3 "0x03 - Voltage above normal or short-circuit to high source" 2 "0x02 - Data erratic, intermittent or incorrect" 1 "0x01 - Data valid, but below normal operational range - Most severe level" 0 "0x00 - Data valid, but above normal operational range - Most severe level" ;
VAL_ 3221225472 Sensor_5V 31 "0x1F - Condition exists" 30 "0x1E - Stuck Closed" 29 "0x1D - Stuck Open" 28 "0x1C - Not in neutral at Power-up" 27 "0x1B - Unable to return to neutral" 26 "0x1A - No steering" 25 "0x19 - Signal crosscheck failed" 24 "0x18 - Reserved" 23 "0x17 - Unintended Steering" 22 "0x16 - Message missing" 21 "0x15 - Data drifted low" 20 "0x14 - Data drifted high" 19 "0x13 - Received network data in error" 18 "0x12 - Data valid, but below normal operating range - Moderately severe level" 17 "0x11 - Data valid, but below normal operating range - Least severe level" 16 "0x10 - Data valid, but above normal operating range - Moderately severe level" 15 "0x0F - Data valid, but above normal operating range - Least severe level" 14 "0x0E - Special instructions" 13 "0x0D - Out of calibration" 12 "0x0C - Bad intelligent device or component" 11 "0x0B - Unknown root-cause" 10 "0x0A - Abnormal rate of change" 9 "0x09 - Abnormal update rate" 8 "0x08 - Abnormal frequency or pulse width or period" 7 "0x07 - Mechanical system not responding or out of adjustement" 6 "0x06 - Current above normal or grounded circuit" 5 "0x05 - Current below normal or open circuit" 4 "0x04 - Voltage below normal or short-circuit to low source" 3 "0x03 - Voltage above normal or short-circuit to high source" 2 "0x02 - Data erratic, intermittent or incorrect" 1 "0x01 - Data valid, but below normal operational range - Most severe level" 0 "0x00 - Data valid, but above normal operational range - Most severe level" ;
VAL_ 3221225472 Vbat 31 "0x1F - Condition exists" 30 "0x1E - Stuck Closed" 29 "0x1D - Stuck Open" 28 "0x1C - Not in neutral at Power-up" 27 "0x1B - Unable to return to neutral" 26 "0x1A - No steering" 25 "0x19 - Signal crosscheck failed" 24 "0x18 - Reserved" 23 "0x17 - Unintended Steering" 22 "0x16 - Message missing" 21 "0x15 - Data drifted low" 20 "0x14 - Data drifted high" 19 "0x13 - Received network data in error" 18 "0x12 - Data valid, but below normal operating range - Moderately severe level" 17 "0x11 - Data valid, but below normal operating range - Least severe level" 16 "0x10 - Data valid, but above normal operating range - Moderately severe level" 15 "0x0F - Data valid, but above normal operating range - Least severe level" 14 "0x0E - Special instructions" 13 "0x0D - Out of calibration" 12 "0x0C - Bad intelligent device or component" 11 "0x0B - Unknown root-cause" 10 "0x0A - Abnormal rate of change" 9 "0x09 - Abnormal update rate" 8 "0x08 - Abnormal frequency or pulse width or period" 7 "0x07 - Mechanical system not responding or out of adjustement" 6 "0x06 - Current above normal or grounded circuit" 5 "0x05 - Current below normal or open circuit" 4 "0x04 - Voltage below normal or short-circuit to low source" 3 "0x03 - Voltage above normal or short-circuit to high source" 2 "0x02 - Data erratic, intermittent or incorrect" 1 "0x01 - Data valid, but below normal operational range - Most severe level" 0 "0x00 - Data valid, but above normal operational range - Most severe level" ;
VAL_ 3221225472 Temperature_Sensor 31 "0x1F - Condition exists" 30 "0x1E - Stuck Closed" 29 "0x1D - Stuck Open" 28 "0x1C - Not in neutral at Power-up" 27 "0x1B - Unable to return to neutral" 26 "0x1A - No steering" 25 "0x19 - Signal crosscheck failed" 24 "0x18 - Reserved" 23 "0x17 - Unintended Steering" 22 "0x16 - Message missing" 21 "0x15 - Data drifted low" 20 "0x14 - Data drifted high" 19 "0x13 - Received network data in error" 18 "0x12 - Data valid, but below normal operating range - Moderately severe level" 17 "0x11 - Data valid, but below normal operating range - Least severe level" 16 "0x10 - Data valid, but above normal operating range - Moderately severe level" 15 "0x0F - Data valid, but above normal operating range - Least severe level" 14 "0x0E - Special instructions" 13 "0x0D - Out of calibration" 12 "0x0C - Bad intelligent device or component" 11 "0x0B - Unknown root-cause" 10 "0x0A - Abnormal rate of change" 9 "0x09 - Abnormal update rate" 8 "0x08 - Abnormal frequency or pulse width or period" 7 "0x07 - Mechanical system not responding or out of adjustement" 6 "0x06 - Current above normal or grounded circuit" 5 "0x05 - Current below normal or open circuit" 4 "0x04 - Voltage below normal or short-circuit to low source" 3 "0x03 - Voltage above normal or short-circuit to high source" 2 "0x02 - Data erratic, intermittent or incorrect" 1 "0x01 - Data valid, but below normal operational range - Most severe level" 0 "0x00 - Data valid, but above normal operational range - Most severe level" ;
VAL_ 3221225472 Analogue_sensor_connected_to_AD2 31 "0x1F - Condition exists" 30 "0x1E - Stuck Closed" 29 "0x1D - Stuck Open" 28 "0x1C - Not in neutral at Power-up" 27 "0x1B - Unable to return to neutral" 26 "0x1A - No steering" 25 "0x19 - Signal crosscheck failed" 24 "0x18 - Reserved" 23 "0x17 - Unintended Steering" 22 "0x16 - Message missing" 21 "0x15 - Data drifted low" 20 "0x14 - Data drifted high" 19 "0x13 - Received network data in error" 18 "0x12 - Data valid, but below normal operating range - Moderately severe level" 17 "0x11 - Data valid, but below normal operating range - Least severe level" 16 "0x10 - Data valid, but above normal operating range - Moderately severe level" 15 "0x0F - Data valid, but above normal operating range - Least severe level" 14 "0x0E - Special instructions" 13 "0x0D - Out of calibration" 12 "0x0C - Bad intelligent device or component" 11 "0x0B - Unknown root-cause" 10 "0x0A - Abnormal rate of change" 9 "0x09 - Abnormal update rate" 8 "0x08 - Abnormal frequency or pulse width or period" 7 "0x07 - Mechanical system not responding or out of adjustement" 6 "0x06 - Current above normal or grounded circuit" 5 "0x05 - Current below normal or open circuit" 4 "0x04 - Voltage below normal or short-circuit to low source" 3 "0x03 - Voltage above normal or short-circuit to high source" 2 "0x02 - Data erratic, intermittent or incorrect" 1 "0x01 - Data valid, but below normal operational range - Most severe level" 0 "0x00 - Data valid, but above normal operational range - Most severe level" ;
VAL_ 3221225472 Analogue_sensor_connected_to_AD1 31 "0x1F - Condition exists" 30 "0x1E - Stuck Closed" 29 "0x1D - Stuck Open" 28 "0x1C - Not in neutral at Power-up" 27 "0x1B - Unable to return to neutral" 26 "0x1A - No steering" 25 "0x19 - Signal crosscheck failed" 24 "0x18 - Reserved" 23 "0x17 - Unintended Steering" 22 "0x16 - Message missing" 21 "0x15 - Data drifted low" 20 "0x14 - Data drifted high" 19 "0x13 - Received network data in error" 18 "0x12 - Data valid, but below normal operating range - Moderately severe level" 17 "0x11 - Data valid, but below normal operating range - Least severe level" 16 "0x10 - Data valid, but above normal operating range - Moderately severe level" 15 "0x0F - Data valid, but above normal operating range - Least severe level" 14 "0x0E - Special instructions" 13 "0x0D - Out of calibration" 12 "0x0C - Bad intelligent device or component" 11 "0x0B - Unknown root-cause" 10 "0x0A - Abnormal rate of change" 9 "0x09 - Abnormal update rate" 8 "0x08 - Abnormal frequency or pulse width or period" 7 "0x07 - Mechanical system not responding or out of adjustement" 6 "0x06 - Current above normal or grounded circuit" 5 "0x05 - Current below normal or open circuit" 4 "0x04 - Voltage below normal or short-circuit to low source" 3 "0x03 - Voltage above normal or short-circuit to high source" 2 "0x02 - Data erratic, intermittent or incorrect" 1 "0x01 - Data valid, but below normal operational range - Most severe level" 0 "0x00 - Data valid, but above normal operational range - Most severe level" ;
