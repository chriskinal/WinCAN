VERSION ""

NS_ :

BS_:
BU_:
BO_ 2360125960 Mess: 8 Vector__XXX
   SG_ Analogue_sensor_connected_to_AD1 : 0|8@1- (1,0) [0|0] "" Vector__XXX
   SG_ Analogue_sensor_connected_to_AD2 : 0|8@1- (1,0) [0|0] "" Vector__XXX
   SG_ Application_state_crosscheck : 0|8@1- (1,0) [0|0] "" Vector__XXX
   SG_ Aux_steering_device_Joystick_tri : 0|8@1- (1,0) [0|0] "" Vector__XXX
   SG_ Aux_str_dev_Joystick_position_cr : 0|8@1- (1,0) [0|0] "" Vector__XXX
   SG_ Aux_str_dev_Str_ang_vel_croschck : 0|8@1- (1,0) [0|0] "" Vector__XXX
   SG_ Auxiliary_Steering_device_Steeri : 0|8@1- (1,0) [0|0] "" Vector__XXX
   SG_ Auxiliary_steering_device : 0|8@1- (1,0) [0|0] "" Vector__XXX
   SG_ Auxiliary_steering_device_Joysti : 0|8@1- (1,0) [0|0] "" Vector__XXX
   SG_ CAN_Bus : 0|8@1- (1,0) [0|0] "" Vector__XXX
   SG_ Coils_Supply_Switch : 0|8@1- (1,0) [0|0] "" Vector__XXX
   SG_ Cut_off_solenoid : 0|8@1- (1,0) [0|0] "" Vector__XXX
   SG_ Cut_off_supply : 0|8@1- (1,0) [0|0] "" Vector__XXX
   SG_ Demanded_safe_state : 0|8@1- (1,0) [0|0] "" Vector__XXX
   SG_ Division_by_zero : 0|8@1- (1,0) [0|0] "" Vector__XXX
   SG_ EEPROM : 0|8@1- (1,0) [0|0] "" Vector__XXX
   SG_ EEPROM_AUX_config : 0|8@1- (1,0) [0|0] "" Vector__XXX
   SG_ EEPROM_Diagnostic_sectors : 0|8@1- (1,0) [0|0] "" Vector__XXX
   SG_ EEPROM_GPS_config : 0|8@1- (1,0) [0|0] "" Vector__XXX
   SG_ EEPROM_Hydraulic_config : 0|8@1- (1,0) [0|0] "" Vector__XXX
   SG_ EEPROM_Internal_monitoring : 0|8@1- (1,0) [0|0] "" Vector__XXX
   SG_ EEPROM_Peripherals_config : 0|8@1- (1,0) [0|0] "" Vector__XXX
   SG_ EEPROM_SEHS_FDA : 0|8@1- (1,0) [0|0] "" Vector__XXX
   SG_ EEPROM_SEHS_Protocol_data : 0|8@1- (1,0) [0|0] "" Vector__XXX
   SG_ EEPROM_STW_config : 0|8@1- (1,0) [0|0] "" Vector__XXX
   SG_ EEPROM_VPS_Data : 0|8@1- (1,0) [0|0] "" Vector__XXX
   SG_ EEPROM_Valve_Calibration_data : 0|8@1- (1,0) [0|0] "" Vector__XXX
   SG_ EEPROM_Vehicle_geometry : 0|8@1- (1,0) [0|0] "" Vector__XXX
   SG_ EEPROM_configuration_sectors : 0|8@1- (1,0) [0|0] "" Vector__XXX
   SG_ EEP_Anal_Sensor_Caliber_data : 0|8@1- (1,0) [0|0] "" Vector__XXX
   SG_ EEP_Auto_Caliber_Config_sect : 0|8@1- (1,0) [0|0] "" Vector__XXX
   SG_ EEP_CAN_WAS_Caliber_data : 0|8@1- (1,0) [0|0] "" Vector__XXX
   SG_ EH_Mainspool_Position_crosscheck : 0|8@1- (1,0) [0|0] "" Vector__XXX
   SG_ EH_main_spool_monitoring : 0|8@1- (1,0) [0|0] "" Vector__XXX
   SG_ Fault_Detection_Algorithm_Monito : 0|8@1- (1,0) [0|0] "" Vector__XXX
   SG_ Flash_test : 0|8@1- (1,0) [0|0] "" Vector__XXX
   SG_ Flow_command_crosscheck : 0|8@1- (1,0) [0|0] "" Vector__XXX
   SG_ GND_level : 0|8@1- (1,0) [0|0] "" Vector__XXX
   SG_ I2C_communication : 0|8@1- (1,0) [0|0] "" Vector__XXX
   SG_ IMD_status_crosscheck : 0|8@1- (1,0) [0|0] "" Vector__XXX
   SG_ Incompatible_Bootloader : 0|8@1- (1,0) [0|0] "" Vector__XXX
   SG_ Interpolation : 0|8@1- (1,0) [0|0] "" Vector__XXX
   SG_ Invalid_sensor_configuration : 0|8@1- (1,0) [0|0] "" Vector__XXX
   SG_ LVDT_Sinus_signal : 0|8@1- (1,0) [0|0] "" Vector__XXX
   SG_ LVDT_calculation : 0|8@1- (1,0) [0|0] "" Vector__XXX
   SG_ LVDT_demod_A : 0|8@1- (1,0) [0|0] "" Vector__XXX
   SG_ LVDT_demod_B : 0|8@1- (1,0) [0|0] "" Vector__XXX
   SG_ MMI : 0|8@1- (1,0) [0|0] "" Vector__XXX
   SG_ MMI_flag_crosscheck : 0|8@1- (1,0) [0|0] "" Vector__XXX
   SG_ Overvoltage_supervisor : 0|8@1- (1,0) [0|0] "" Vector__XXX
   SG_ PSM_task : 0|8@1- (1,0) [0|0] "" Vector__XXX
   SG_ PVED_CLS_Spare_part : 0|8@1- (1,0) [0|0] "" Vector__XXX
   SG_ Plus_5V : 0|8@1- (1,0) [0|0] "" Vector__XXX
   SG_ Program_sequence_monitoring : 0|8@1- (1,0) [0|0] "" Vector__XXX
   SG_ RAM_Test : 0|8@1- (1,0) [0|0] "" Vector__XXX
   SG_ Reserved : 0|8@1- (1,0) [0|0] "" Vector__XXX
   SG_ Road_Switch_Res_Monitoring : 0|8@1- (1,0) [0|0] "" Vector__XXX
   SG_ SASA_Steering_sensor : 0|8@1- (1,0) [0|0] "" Vector__XXX
   SG_ SPI_communication : 0|8@1- (1,0) [0|0] "" Vector__XXX
   SG_ STW_sensor_Position_crosscheck : 0|8@1- (1,0) [0|0] "" Vector__XXX
   SG_ STW_sensor_Speed_crosscheck : 0|8@1- (1,0) [0|0] "" Vector__XXX
   SG_ SVC_Parameters : 0|8@1- (1,0) [0|0] "" Vector__XXX
   SG_ Safe_On_Road_Monitoring : 0|8@1- (1,0) [0|0] "" Vector__XXX
   SG_ Sensor_5V : 0|8@1- (1,0) [0|0] "" Vector__XXX
   SG_ Soft_Error : 0|8@1- (1,0) [0|0] "" Vector__XXX
   SG_ Software_Mismatch : 0|8@1- (1,0) [0|0] "" Vector__XXX
   SG_ Software_initialisation : 0|8@1- (1,0) [0|0] "" Vector__XXX
   SG_ Temperature_Sensor : 0|8@1- (1,0) [0|0] "" Vector__XXX
   SG_ Too_many_errors : 0|8@1- (1,0) [0|0] "" Vector__XXX
   SG_ Variable_truncation : 0|8@1- (1,0) [0|0] "" Vector__XXX
   SG_ Vbat : 0|8@1- (1,0) [0|0] "" Vector__XXX
   SG_ Vehicle_Speed_sensor_speed_cross : 0|8@1- (1,0) [0|0] "" Vector__XXX
   SG_ Vehicle_speed_sensor : 0|8@1- (1,0) [0|0] "" Vector__XXX
   SG_ Vehicle_speed_triggered_EH_Steer : 0|8@1- (1,0) [0|0] "" Vector__XXX
   SG_ Vref_generation : 0|8@1- (1,0) [0|0] "" Vector__XXX
   SG_ WAS_CAN_Sensor : 0|8@1- (1,0) [0|0] "" Vector__XXX
   SG_ Wheel_angle_crosscheck : 0|8@1- (1,0) [0|0] "" Vector__XXX

CM_ BO_ 2360125960 "This is a message for not used signals, created by Vector CANdb++ DBC OLE DB Provider.";
BA_DEF_ SG_ "SigType" ENUM "Default","Range","RangeSigned","ASCII","Discrete","Control","ReferencePGN","DTC","StringDelimiter","StringLength","StringLengthControl";
BA_DEF_ SG_ "GenSigEVName" STRING ;
BA_DEF_ SG_ "GenSigILSupport" ENUM "Default","Range","RangeSigned","ASCII","Discrete","Control","ReferencePGN","DTC","StringDelimiter","StringLength","StringLengthControl","No","Yes";
BA_DEF_ SG_ "GenSigSendType" ENUM "Default","Range","RangeSigned","ASCII","Discrete","Control","ReferencePGN","DTC","StringDelimiter","StringLength","StringLengthControl","No","Yes","Cyclic","OnWrite","OnWriteWithRepetition","OnChange","OnChangeWithRepetition","IfActive","IfActiveWithRepetition","NoSigSendType";
BA_DEF_ BO_ "GenMsgILSupport" ENUM "Default","Range","RangeSigned","ASCII","Discrete","Control","ReferencePGN","DTC","StringDelimiter","StringLength","StringLengthControl","No","Yes","Cyclic","OnWrite","OnWriteWithRepetition","OnChange","OnChangeWithRepetition","IfActive","IfActiveWithRepetition","NoSigSendType","No","Yes";
BA_DEF_ BU_ "NmStationAddress" INT 0 255;
BA_DEF_ BO_ "GenMsgSendType" ENUM "Default","Range","RangeSigned","ASCII","Discrete","Control","ReferencePGN","DTC","StringDelimiter","StringLength","StringLengthControl","No","Yes","Cyclic","OnWrite","OnWriteWithRepetition","OnChange","OnChangeWithRepetition","IfActive","IfActiveWithRepetition","NoSigSendType","No","Yes","cyclic","NotUsed","IfActive","NotUsed","NotUsed","NotUsed","NotUsed","NotUsed","noMsgSendType";
BA_DEF_ BO_ "GenMsgRequestable" INT 0 1;
BA_DEF_ SG_ "SPN" INT 0 524287;
BA_DEF_ "BusType" STRING ;
BA_DEF_ "ProtocolType" STRING ;
BA_DEF_ BO_ "VFrameFormat" ENUM "Default","Range","RangeSigned","ASCII","Discrete","Control","ReferencePGN","DTC","StringDelimiter","StringLength","StringLengthControl","No","Yes","Cyclic","OnWrite","OnWriteWithRepetition","OnChange","OnChangeWithRepetition","IfActive","IfActiveWithRepetition","NoSigSendType","No","Yes","cyclic","NotUsed","IfActive","NotUsed","NotUsed","NotUsed","NotUsed","NotUsed","noMsgSendType","StandardCAN","ExtendedCAN","reserved","J1939PG";
BA_DEF_ SG_ "SystemSignalLongSymbol" STRING ;
BA_DEF_ BO_ "GenMsgBackgroundColor" STRING ;
BA_DEF_ BO_ "GenMsgForegroundColor" STRING ;
BA_DEF_ BO_ "matchingcriteria" INT 0 0;
BA_DEF_ BO_ "filterlabeling" INT 0 0;
BA_DEF_DEF_ "SigType" "Default";
BA_DEF_DEF_ "GenSigEVName" "Env";
BA_DEF_DEF_ "GenSigILSupport" "No";
BA_DEF_DEF_ "GenSigSendType" "NoSigSendType";
BA_DEF_DEF_ "GenMsgILSupport" "Yes";
BA_DEF_DEF_ "NmStationAddress" 254;
BA_DEF_DEF_ "GenMsgSendType" "noMsgSendType";
BA_DEF_DEF_ "GenMsgRequestable" 1;
BA_DEF_DEF_ "SPN" 0;
BA_DEF_DEF_ "BusType" "CAN";
BA_DEF_DEF_ "ProtocolType" "J1939";
BA_DEF_DEF_ "VFrameFormat" "J1939PG";
BA_DEF_DEF_ "SystemSignalLongSymbol" "";
BA_DEF_DEF_ "GenMsgBackgroundColor" "#2d2d2d";
BA_DEF_DEF_ "GenMsgForegroundColor" "#ffffff";
BA_DEF_DEF_ "matchingcriteria" 1;
BA_DEF_DEF_ "filterlabeling" 1;
BA_ "GenMsgForegroundColor" BO_ 2360125960 "#000000";
BA_ "GenSigILSupport" SG_ 2360125960 Analogue_sensor_connected_to_AD1 0;
BA_ "GenSigILSupport" SG_ 2360125960 Analogue_sensor_connected_to_AD2 0;
BA_ "GenSigILSupport" SG_ 2360125960 Application_state_crosscheck 0;
BA_ "SystemSignalLongSymbol" SG_ 2360125960 Aux_steering_device_Joystick_tri "Aux_steering_device_Joystick_tri";
BA_ "GenSigILSupport" SG_ 2360125960 Aux_str_dev_Joystick_position_cr 0;
BA_ "SystemSignalLongSymbol" SG_ 2360125960 Aux_str_dev_Joystick_position_cr "Aux_str_dev_Joystick_position_cr";
BA_ "GenSigILSupport" SG_ 2360125960 Aux_str_dev_Str_ang_vel_croschck 0;
BA_ "GenSigILSupport" SG_ 2360125960 Auxiliary_Steering_device_Steeri 0;
BA_ "SystemSignalLongSymbol" SG_ 2360125960 Auxiliary_Steering_device_Steeri "Auxiliary_Steering_device_Steeri";
BA_ "GenSigILSupport" SG_ 2360125960 Auxiliary_steering_device 0;
BA_ "SystemSignalLongSymbol" SG_ 2360125960 Auxiliary_steering_device_Joysti "Auxiliary_steering_device_Joysti";
BA_ "GenSigILSupport" SG_ 2360125960 CAN_Bus 0;
BA_ "GenSigILSupport" SG_ 2360125960 Coils_Supply_Switch 0;
BA_ "GenSigILSupport" SG_ 2360125960 Cut_off_solenoid 0;
BA_ "GenSigILSupport" SG_ 2360125960 Cut_off_supply 0;
BA_ "GenSigILSupport" SG_ 2360125960 Demanded_safe_state 0;
BA_ "GenSigILSupport" SG_ 2360125960 Division_by_zero 0;
BA_ "GenSigILSupport" SG_ 2360125960 EEPROM 0;
BA_ "GenSigILSupport" SG_ 2360125960 EEPROM_Diagnostic_sectors 0;
BA_ "GenSigILSupport" SG_ 2360125960 EEPROM_VPS_Data 0;
BA_ "GenSigILSupport" SG_ 2360125960 EEPROM_configuration_sectors 0;
BA_ "GenSigILSupport" SG_ 2360125960 EH_Mainspool_Position_crosscheck 0;
BA_ "GenSigILSupport" SG_ 2360125960 EH_main_spool_monitoring 0;
BA_ "GenSigILSupport" SG_ 2360125960 Fault_Detection_Algorithm_Monito 0;
BA_ "SystemSignalLongSymbol" SG_ 2360125960 Fault_Detection_Algorithm_Monito "Fault_Detection_Algorithm_Monito";
BA_ "GenSigILSupport" SG_ 2360125960 Flash_test 0;
BA_ "GenSigILSupport" SG_ 2360125960 Flow_command_crosscheck 0;
BA_ "GenSigILSupport" SG_ 2360125960 GND_level 0;
BA_ "GenSigILSupport" SG_ 2360125960 I2C_communication 0;
BA_ "GenSigILSupport" SG_ 2360125960 Incompatible_Bootloader 0;
BA_ "GenSigILSupport" SG_ 2360125960 Interpolation 0;
BA_ "GenSigILSupport" SG_ 2360125960 Invalid_sensor_configuration 0;
BA_ "GenSigILSupport" SG_ 2360125960 LVDT_Sinus_signal 0;
BA_ "GenSigILSupport" SG_ 2360125960 LVDT_calculation 0;
BA_ "GenSigILSupport" SG_ 2360125960 LVDT_demod_A 0;
BA_ "GenSigILSupport" SG_ 2360125960 LVDT_demod_B 0;
BA_ "GenSigILSupport" SG_ 2360125960 MMI 0;
BA_ "GenSigILSupport" SG_ 2360125960 MMI_flag_crosscheck 0;
BA_ "GenSigILSupport" SG_ 2360125960 Overvoltage_supervisor 0;
BA_ "GenSigILSupport" SG_ 2360125960 PSM_task 0;
BA_ "GenSigILSupport" SG_ 2360125960 Plus_5V 0;
BA_ "GenSigILSupport" SG_ 2360125960 Program_sequence_monitoring 0;
BA_ "GenSigILSupport" SG_ 2360125960 RAM_Test 0;
BA_ "GenSigILSupport" SG_ 2360125960 Reserved 0;
BA_ "GenSigILSupport" SG_ 2360125960 SASA_Steering_sensor 0;
BA_ "GenSigILSupport" SG_ 2360125960 SPI_communication 0;
BA_ "GenSigILSupport" SG_ 2360125960 STW_sensor_Position_crosscheck 0;
BA_ "GenSigILSupport" SG_ 2360125960 STW_sensor_Speed_crosscheck 0;
BA_ "GenSigILSupport" SG_ 2360125960 SVC_Parameters 0;
BA_ "GenSigILSupport" SG_ 2360125960 Safe_On_Road_Monitoring 0;
BA_ "GenSigILSupport" SG_ 2360125960 Sensor_5V 0;
BA_ "GenSigILSupport" SG_ 2360125960 Software_Mismatch 0;
BA_ "GenSigILSupport" SG_ 2360125960 Software_initialisation 0;
BA_ "GenSigILSupport" SG_ 2360125960 Temperature_Sensor 0;
BA_ "GenSigILSupport" SG_ 2360125960 Too_many_errors 0;
BA_ "GenSigILSupport" SG_ 2360125960 Variable_truncation 0;
BA_ "GenSigILSupport" SG_ 2360125960 Vbat 0;
BA_ "GenSigILSupport" SG_ 2360125960 Vehicle_Speed_sensor_speed_cross 0;
BA_ "SystemSignalLongSymbol" SG_ 2360125960 Vehicle_Speed_sensor_speed_cross "Vehicle_Speed_sensor_speed_cross";
BA_ "GenSigILSupport" SG_ 2360125960 Vehicle_speed_sensor 0;
BA_ "GenSigILSupport" SG_ 2360125960 Vehicle_speed_triggered_EH_Steer 0;
BA_ "SystemSignalLongSymbol" SG_ 2360125960 Vehicle_speed_triggered_EH_Steer "Vehicle_speed_triggered_EH_Steer";
BA_ "GenSigILSupport" SG_ 2360125960 Vref_generation 0;
BA_ "GenSigILSupport" SG_ 2360125960 Wheel_angle_crosscheck 0;
VAL_ 2360125960 Analogue_sensor_connected_to_AD1 31 "0x1F - Condition exists" 30 "0x1E - Stuck Closed" 29 "0x1D - Stuck Open" 28 "0x1C - Not in neutral at Power-up" 27 "0x1B - Unable to return to neutral" 26 "0x1A - No steering" 25 "0x19 - Signal crosscheck failed" 24 "0x18 - Reserved" 23 "0x17 - Unintended Steering" 22 "0x16 - Message missing" 21 "0x15 - Data drifted low" 20 "0x14 - Data drifted high" 19 "0x13 - Received network data in error" 18 "0x12 - Data valid, but below normal operating range - Moderately severe level" 17 "0x11 - Data valid, but below normal operating range - Least severe level" 16 "0x10 - Data valid, but above normal operating range - Moderately severe level" 15 "0x0F - Data valid, but above normal operating range - Least severe level" 14 "0x0E - Special instructions" 13 "0x0D - Out of calibration" 12 "0x0C - Bad intelligent device or component" 11 "0x0B - Unknown root-cause" 10 "0x0A - Abnormal rate of change" 9 "0x09 - Abnormal update rate" 8 "0x08 - Abnormal frequency or pulse width or period" 7 "0x07 - Mechanical system not responding or out of adjustement" 6 "0x06 - Current above normal or grounded circuit" 5 "0x05 - Current below normal or open circuit" 4 "0x04 - Voltage below normal or short-circuit to low source" 3 "0x03 - Voltage above normal or short-circuit to high source" 2 "0x02 - Data erratic, intermittent or incorrect" 1 "0x01 - Data valid, but below normal operational range - Most severe level" 0 "0x00 - Data valid, but above normal operational range - Most severe level";
VAL_ 2360125960 Analogue_sensor_connected_to_AD2 31 "0x1F - Condition exists" 30 "0x1E - Stuck Closed" 29 "0x1D - Stuck Open" 28 "0x1C - Not in neutral at Power-up" 27 "0x1B - Unable to return to neutral" 26 "0x1A - No steering" 25 "0x19 - Signal crosscheck failed" 24 "0x18 - Reserved" 23 "0x17 - Unintended Steering" 22 "0x16 - Message missing" 21 "0x15 - Data drifted low" 20 "0x14 - Data drifted high" 19 "0x13 - Received network data in error" 18 "0x12 - Data valid, but below normal operating range - Moderately severe level" 17 "0x11 - Data valid, but below normal operating range - Least severe level" 16 "0x10 - Data valid, but above normal operating range - Moderately severe level" 15 "0x0F - Data valid, but above normal operating range - Least severe level" 14 "0x0E - Special instructions" 13 "0x0D - Out of calibration" 12 "0x0C - Bad intelligent device or component" 11 "0x0B - Unknown root-cause" 10 "0x0A - Abnormal rate of change" 9 "0x09 - Abnormal update rate" 8 "0x08 - Abnormal frequency or pulse width or period" 7 "0x07 - Mechanical system not responding or out of adjustement" 6 "0x06 - Current above normal or grounded circuit" 5 "0x05 - Current below normal or open circuit" 4 "0x04 - Voltage below normal or short-circuit to low source" 3 "0x03 - Voltage above normal or short-circuit to high source" 2 "0x02 - Data erratic, intermittent or incorrect" 1 "0x01 - Data valid, but below normal operational range - Most severe level" 0 "0x00 - Data valid, but above normal operational range - Most severe level";
VAL_ 2360125960 Application_state_crosscheck 31 "0x1F - Condition exists" 30 "0x1E - Stuck Closed" 29 "0x1D - Stuck Open" 28 "0x1C - Not in neutral at Power-up" 27 "0x1B - Unable to return to neutral" 26 "0x1A - No steering" 25 "0x19 - Signal crosscheck failed (0x19)" 24 "0x18 - Reserved" 23 "0x17 - Unintended Steering" 22 "0x16 - Message missing" 21 "0x15 - Data drifted low" 20 "0x14 - Data drifted high" 19 "0x13 - Received network data in error" 18 "0x12 - Data valid, but below normal operating range - Moderately severe level" 17 "0x11 - Data valid, but below normal operating range - Least severe level" 16 "0x10 - Data valid, but above normal operating range - Moderately severe level" 15 "0x0F - Data valid, but above normal operating range - Least severe level" 14 "0x0E - Special instructions" 13 "0x0D - Out of calibration" 12 "0x0C - Bad intelligent device or component" 11 "0x0B - Unknown root-cause" 10 "0x0A - Abnormal rate of change" 9 "0x09 - Abnormal update rate" 8 "0x08 - Abnormal frequency or pulse width or period" 7 "0x07 - Mechanical system not responding or out of adjustement" 6 "0x06 - Current above normal or grounded circuit" 5 "0x05 - Current below normal or open circuit" 4 "0x04 - Voltage below normal or short-circuit to low source" 3 "0x03 - Voltage above normal or short-circuit to high source" 2 "0x02 - Data erratic, intermittent or incorrect" 1 "0x01 - Data valid, but below normal operational range - Most severe level" 0 "0x00 - Data valid, but above normal operational range - Most severe level";
VAL_ 2360125960 Aux_steering_device_Joystick_tri 31 "0x1F - Condition exists" 30 "0x1E - Stuck Closed" 29 "0x1D - Stuck Open" 28 "0x1C - Not in neutral at Power-up" 27 "0x1B - Unable to return to neutral" 26 "0x1A - No steering" 25 "0x19 - Signal crosscheck failed" 24 "0x18 - Reserved" 23 "0x17 - Unintended Steering" 22 "0x16 - Message missing" 21 "0x15 - Data drifted low" 20 "0x14 - Data drifted high" 19 "0x13 - Received network data in error" 18 "0x12 - Data valid, but below normal operating range - Moderately severe level" 17 "0x11 - Data valid, but below normal operating range - Least severe level" 16 "0x10 - Data valid, but above normal operating range - Moderately severe level" 15 "0x0F - Data valid, but above normal operating range - Least severe level" 14 "0x0E - Special instructions" 13 "0x0D - Out of calibration" 12 "0x0C - Bad intelligent device or component" 11 "0x0B - Unknown root-cause" 10 "0x0A - Abnormal rate of change" 9 "0x09 - Abnormal update rate" 8 "0x08 - Abnormal frequency or pulse width or period" 7 "0x07 - Mechanical system not responding or out of adjustement" 6 "0x06 - Current above normal or grounded circuit" 5 "0x05 - Current below normal or open circuit" 4 "0x04 - Voltage below normal or short-circuit to low source" 3 "0x03 - Voltage above normal or short-circuit to high source" 2 "0x02 - Data erratic, intermittent or incorrect" 1 "0x01 - Data valid, but below normal operational range - Most severe level" 0 "0x00 - Data valid, but above normal operational range - Most severe level";
VAL_ 2360125960 Aux_str_dev_Joystick_position_cr 31 "0x1F - Condition exists" 30 "0x1E - Stuck Closed" 29 "0x1D - Stuck Open" 28 "0x1C - Not in neutral at Power-up" 27 "0x1B - Unable to return to neutral" 26 "0x1A - No steering" 25 "0x19 - Signal crosscheck failed" 24 "0x18 - Reserved" 23 "0x17 - Unintended Steering" 22 "0x16 - Message missing" 21 "0x15 - Data drifted low" 20 "0x14 - Data drifted high" 19 "0x13 - Received network data in error" 18 "0x12 - Data valid, but below normal operating range - Moderately severe level" 17 "0x11 - Data valid, but below normal operating range - Least severe level" 16 "0x10 - Data valid, but above normal operating range - Moderately severe level" 15 "0x0F - Data valid, but above normal operating range - Least severe level" 14 "0x0E - Special instructions" 13 "0x0D - Out of calibration" 12 "0x0C - Bad intelligent device or component" 11 "0x0B - Unknown root-cause" 10 "0x0A - Abnormal rate of change" 9 "0x09 - Abnormal update rate" 8 "0x08 - Abnormal frequency or pulse width or period" 7 "0x07 - Mechanical system not responding or out of adjustement" 6 "0x06 - Current above normal or grounded circuit" 5 "0x05 - Current below normal or open circuit" 4 "0x04 - Voltage below normal or short-circuit to low source" 3 "0x03 - Voltage above normal or short-circuit to high source" 2 "0x02 - Data erratic, intermittent or incorrect" 1 "0x01 - Data valid, but below normal operational range - Most severe level" 0 "0x00 - Data valid, but above normal operational range - Most severe level";
VAL_ 2360125960 Aux_str_dev_Str_ang_vel_croschck 31 "0x1F - Condition exists" 30 "0x1E - Stuck Closed" 29 "0x1D - Stuck Open" 28 "0x1C - Not in neutral at Power-up" 27 "0x1B - Unable to return to neutral" 26 "0x1A - No steering" 25 "0x19 - Signal crosscheck failed" 24 "0x18 - Reserved" 23 "0x17 - Unintended Steering" 22 "0x16 - Message missing" 21 "0x15 - Data drifted low" 20 "0x14 - Data drifted high" 19 "0x13 - Received network data in error" 18 "0x12 - Data valid, but below normal operating range - Moderately severe level" 17 "0x11 - Data valid, but below normal operating range - Least severe level" 16 "0x10 - Data valid, but above normal operating range - Moderately severe level" 15 "0x0F - Data valid, but above normal operating range - Least severe level" 14 "0x0E - Special instructions" 13 "0x0D - Out of calibration" 12 "0x0C - Bad intelligent device or component" 11 "0x0B - Unknown root-cause" 10 "0x0A - Abnormal rate of change" 9 "0x09 - Abnormal update rate" 8 "0x08 - Abnormal frequency or pulse width or period" 7 "0x07 - Mechanical system not responding or out of adjustement" 6 "0x06 - Current above normal or grounded circuit" 5 "0x05 - Current below normal or open circuit" 4 "0x04 - Voltage below normal or short-circuit to low source" 3 "0x03 - Voltage above normal or short-circuit to high source" 2 "0x02 - Data erratic, intermittent or incorrect" 1 "0x01 - Data valid, but below normal operational range - Most severe level" 0 "0x00 - Data valid, but above normal operational range - Most severe level";
VAL_ 2360125960 Auxiliary_Steering_device_Steeri 31 "0x1F - Condition exists" 30 "0x1E - Stuck Closed" 29 "0x1D - Stuck Open" 28 "0x1C - Not in neutral at Power-up" 27 "0x1B - Unable to return to neutral" 26 "0x1A - No steering" 25 "0x19 - Signal crosscheck failed" 24 "0x18 - Reserved" 23 "0x17 - Unintended Steering" 22 "0x16 - Message missing" 21 "0x15 - Data drifted low" 20 "0x14 - Data drifted high" 19 "0x13 - Received network data in error" 18 "0x12 - Data valid, but below normal operating range - Moderately severe level" 17 "0x11 - Data valid, but below normal operating range - Least severe level" 16 "0x10 - Data valid, but above normal operating range - Moderately severe level" 15 "0x0F - Data valid, but above normal operating range - Least severe level" 14 "0x0E - Special instructions" 13 "0x0D - Out of calibration" 12 "0x0C - Bad intelligent device or component" 11 "0x0B - Unknown root-cause" 10 "0x0A - Abnormal rate of change" 9 "0x09 - Abnormal update rate" 8 "0x08 - Abnormal frequency or pulse width or period" 7 "0x07 - Mechanical system not responding or out of adjustement" 6 "0x06 - Current above normal or grounded circuit" 5 "0x05 - Current below normal or open circuit" 4 "0x04 - Voltage below normal or short-circuit to low source" 3 "0x03 - Voltage above normal or short-circuit to high source" 2 "0x02 - Data erratic, intermittent or incorrect" 1 "0x01 - Data valid, but below normal operational range - Most severe level" 0 "0x00 - Data valid, but above normal operational range - Most severe level";
VAL_ 2360125960 Auxiliary_steering_device 31 "0x1F - Condition exists" 30 "0x1E - Stuck Closed" 29 "0x1D - Stuck Open" 28 "0x1C - Not in neutral at Power-up" 27 "0x1B - Unable to return to neutral" 26 "0x1A - No steering" 25 "0x19 - Signal crosscheck failed" 24 "0x18 - Reserved" 23 "0x17 - Unintended Steering" 22 "0x16 - Message missing" 21 "0x15 - Data drifted low" 20 "0x14 - Data drifted high" 19 "0x13 - Received network data in error" 18 "0x12 - Data valid, but below normal operating range - Moderately severe level" 17 "0x11 - Data valid, but below normal operating range - Least severe level" 16 "0x10 - Data valid, but above normal operating range - Moderately severe level" 15 "0x0F - Data valid, but above normal operating range - Least severe level" 14 "0x0E - Special instructions" 13 "0x0D - Out of calibration" 12 "0x0C - Bad intelligent device or component" 11 "0x0B - Unknown root-cause" 10 "0x0A - Abnormal rate of change" 9 "0x09 - Abnormal update rate" 8 "0x08 - Abnormal frequency or pulse width or period" 7 "0x07 - Mechanical system not responding or out of adjustement" 6 "0x06 - Current above normal or grounded circuit" 5 "0x05 - Current below normal or open circuit" 4 "0x04 - Voltage below normal or short-circuit to low source" 3 "0x03 - Voltage above normal or short-circuit to high source" 2 "0x02 - Data erratic, intermittent or incorrect" 1 "0x01 - Data valid, but below normal operational range - Most severe level" 0 "0x00 - Data valid, but above normal operational range - Most severe level";
VAL_ 2360125960 Auxiliary_steering_device_Joysti 31 "0x1F - Condition exists" 30 "0x1E - Stuck Closed" 29 "0x1D - Stuck Open" 28 "0x1C - Not in neutral at Power-up" 27 "0x1B - Unable to return to neutral" 26 "0x1A - No steering" 25 "0x19 - Signal crosscheck failed" 24 "0x18 - Reserved" 23 "0x17 - Unintended Steering" 22 "0x16 - Message missing" 21 "0x15 - Data drifted low" 20 "0x14 - Data drifted high" 19 "0x13 - Received network data in error" 18 "0x12 - Data valid, but below normal operating range - Moderately severe level" 17 "0x11 - Data valid, but below normal operating range - Least severe level" 16 "0x10 - Data valid, but above normal operating range - Moderately severe level" 15 "0x0F - Data valid, but above normal operating range - Least severe level" 14 "0x0E - Special instructions" 13 "0x0D - Out of calibration" 12 "0x0C - Bad intelligent device or component" 11 "0x0B - Unknown root-cause" 10 "0x0A - Abnormal rate of change" 9 "0x09 - Abnormal update rate" 8 "0x08 - Abnormal frequency or pulse width or period" 7 "0x07 - Mechanical system not responding or out of adjustement" 6 "0x06 - Current above normal or grounded circuit" 5 "0x05 - Current below normal or open circuit" 4 "0x04 - Voltage below normal or short-circuit to low source" 3 "0x03 - Voltage above normal or short-circuit to high source" 2 "0x02 - Data erratic, intermittent or incorrect" 1 "0x01 - Data valid, but below normal operational range - Most severe level" 0 "0x00 - Data valid, but above normal operational range - Most severe level";
VAL_ 2360125960 CAN_Bus 31 "0x1F - Condition exists" 30 "0x1E - Stuck Closed" 29 "0x1D - Stuck Open" 28 "0x1C - Not in neutral at Power-up" 27 "0x1B - Unable to return to neutral" 26 "0x1A - No steering" 25 "0x19 - Signal crosscheck failed" 24 "0x18 - Reserved" 23 "0x17 - Unintended Steering" 22 "0x16 - Message missing" 21 "0x15 - Data drifted low" 20 "0x14 - Data drifted high" 19 "0x13 - Received network data in error" 18 "0x12 - Data valid, but below normal operating range - Moderately severe level" 17 "0x11 - Data valid, but below normal operating range - Least severe level" 16 "0x10 - Data valid, but above normal operating range - Moderately severe level" 15 "0x0F - Data valid, but above normal operating range - Least severe level" 14 "0x0E - Special instructions" 13 "0x0D - Out of calibration" 12 "0x0C - Bad intelligent device or component" 11 "0x0B - Unknown root-cause" 10 "0x0A - Abnormal rate of change" 9 "0x09 - Abnormal update rate" 8 "0x08 - Abnormal frequency or pulse width or period" 7 "0x07 - Mechanical system not responding or out of adjustement" 6 "0x06 - Current above normal or grounded circuit" 5 "0x05 - Current below normal or open circuit" 4 "0x04 - Voltage below normal or short-circuit to low source" 3 "0x03 - Voltage above normal or short-circuit to high source" 2 "0x02 - Data erratic, intermittent or incorrect" 1 "0x01 - Data valid, but below normal operational range - Most severe level" 0 "0x00 - Data valid, but above normal operational range - Most severe level";
VAL_ 2360125960 Coils_Supply_Switch 31 "0x1F - Condition exists" 30 "0x1E - Stuck Closed" 29 "0x1D - Stuck Open" 28 "0x1C - Not in neutral at Power-up" 27 "0x1B - Unable to return to neutral" 26 "0x1A - No steering" 25 "0x19 - Signal crosscheck failed" 24 "0x18 - Reserved" 23 "0x17 - Unintended Steering" 22 "0x16 - Message missing" 21 "0x15 - Data drifted low" 20 "0x14 - Data drifted high" 19 "0x13 - Received network data in error" 18 "0x12 - Data valid, but below normal operating range - Moderately severe level" 17 "0x11 - Data valid, but below normal operating range - Least severe level" 16 "0x10 - Data valid, but above normal operating range - Moderately severe level" 15 "0x0F - Data valid, but above normal operating range - Least severe level" 14 "0x0E - Special instructions" 13 "0x0D - Out of calibration" 12 "0x0C - Bad intelligent device or component" 11 "0x0B - Unknown root-cause" 10 "0x0A - Abnormal rate of change" 9 "0x09 - Abnormal update rate" 8 "0x08 - Abnormal frequency or pulse width or period" 7 "0x07 - Mechanical system not responding or out of adjustement" 6 "0x06 - Current above normal or grounded circuit" 5 "0x05 - Current below normal or open circuit" 4 "0x04 - Voltage below normal or short-circuit to low source" 3 "0x03 - Voltage above normal or short-circuit to high source" 2 "0x02 - Data erratic, intermittent or incorrect" 1 "0x01 - Data valid, but below normal operational range - Most severe level" 0 "0x00 - Data valid, but above normal operational range - Most severe level";
VAL_ 2360125960 Cut_off_solenoid 31 "0x1F - Condition exists" 30 "0x1E - Stuck Closed" 29 "0x1D - Stuck Open" 28 "0x1C - Not in neutral at Power-up" 27 "0x1B - Unable to return to neutral" 26 "0x1A - No steering" 25 "0x19 - Signal crosscheck failed" 24 "0x18 - Reserved" 23 "0x17 - Unintended Steering" 22 "0x16 - Message missing" 21 "0x15 - Data drifted low" 20 "0x14 - Data drifted high" 19 "0x13 - Received network data in error" 18 "0x12 - Data valid, but below normal operating range - Moderately severe level" 17 "0x11 - Data valid, but below normal operating range - Least severe level" 16 "0x10 - Data valid, but above normal operating range - Moderately severe level" 15 "0x0F - Data valid, but above normal operating range - Least severe level" 14 "0x0E - Special instructions" 13 "0x0D - Out of calibration" 12 "0x0C - Bad intelligent device or component" 11 "0x0B - Unknown root-cause" 10 "0x0A - Abnormal rate of change" 9 "0x09 - Abnormal update rate" 8 "0x08 - Abnormal frequency or pulse width or period" 7 "0x07 - Mechanical system not responding or out of adjustement" 6 "0x06 - Current above normal or grounded circuit" 5 "0x05 - Current below normal or open circuit" 4 "0x04 - Voltage below normal or short-circuit to low source" 3 "0x03 - Voltage above normal or short-circuit to high source" 2 "0x02 - Data erratic, intermittent or incorrect" 1 "0x01 - Data valid, but below normal operational range - Most severe level" 0 "0x00 - Data valid, but above normal operational range - Most severe level";
VAL_ 2360125960 Cut_off_supply 31 "0x1F - Condition exists" 30 "0x1E - Stuck Closed" 29 "0x1D - Stuck Open" 28 "0x1C - Not in neutral at Power-up" 27 "0x1B - Unable to return to neutral" 26 "0x1A - No steering" 25 "0x19 - Signal crosscheck failed" 24 "0x18 - Reserved" 23 "0x17 - Unintended Steering" 22 "0x16 - Message missing" 21 "0x15 - Data drifted low" 20 "0x14 - Data drifted high" 19 "0x13 - Received network data in error" 18 "0x12 - Data valid, but below normal operating range - Moderately severe level" 17 "0x11 - Data valid, but below normal operating range - Least severe level" 16 "0x10 - Data valid, but above normal operating range - Moderately severe level" 15 "0x0F - Data valid, but above normal operating range - Least severe level" 14 "0x0E - Special instructions" 13 "0x0D - Out of calibration" 12 "0x0C - Bad intelligent device or component" 11 "0x0B - Unknown root-cause" 10 "0x0A - Abnormal rate of change" 9 "0x09 - Abnormal update rate" 8 "0x08 - Abnormal frequency or pulse width or period" 7 "0x07 - Mechanical system not responding or out of adjustement" 6 "0x06 - Current above normal or grounded circuit" 5 "0x05 - Current below normal or open circuit" 4 "0x04 - Voltage below normal or short-circuit to low source" 3 "0x03 - Voltage above normal or short-circuit to high source" 2 "0x02 - Data erratic, intermittent or incorrect" 1 "0x01 - Data valid, but below normal operational range - Most severe level" 0 "0x00 - Data valid, but above normal operational range - Most severe level";
VAL_ 2360125960 Demanded_safe_state 31 "0x1F - Condition exists" 30 "0x1E - Stuck Closed" 29 "0x1D - Stuck Open" 28 "0x1C - Not in neutral at Power-up" 27 "0x1B - Unable to return to neutral" 26 "0x1A - No steering" 25 "0x19 - Signal crosscheck failed" 24 "0x18 - Reserved" 23 "0x17 - Unintended Steering" 22 "0x16 - Message missing" 21 "0x15 - Data drifted low" 20 "0x14 - Data drifted high" 19 "0x13 - Received network data in error" 18 "0x12 - Data valid, but below normal operating range - Moderately severe level" 17 "0x11 - Data valid, but below normal operating range - Least severe level" 16 "0x10 - Data valid, but above normal operating range - Moderately severe level" 15 "0x0F - Data valid, but above normal operating range - Least severe level" 14 "0x0E - Special instructions" 13 "0x0D - Out of calibration" 12 "0x0C - Bad intelligent device or component" 11 "0x0B - Unknown root-cause" 10 "0x0A - Abnormal rate of change" 9 "0x09 - Abnormal update rate" 8 "0x08 - Abnormal frequency or pulse width or period" 7 "0x07 - Mechanical system not responding or out of adjustement" 6 "0x06 - Current above normal or grounded circuit" 5 "0x05 - Current below normal or open circuit" 4 "0x04 - Voltage below normal or short-circuit to low source" 3 "0x03 - Voltage above normal or short-circuit to high source" 2 "0x02 - Data erratic, intermittent or incorrect" 1 "0x01 - Data valid, but below normal operational range - Most severe level" 0 "0x00 - Data valid, but above normal operational range - Most severe level";
VAL_ 2360125960 Division_by_zero 31 "0x1F - Condition exists" 30 "0x1E - Stuck Closed" 29 "0x1D - Stuck Open" 28 "0x1C - Not in neutral at Power-up" 27 "0x1B - Unable to return to neutral" 26 "0x1A - No steering" 25 "0x19 - Signal crosscheck failed" 24 "0x18 - Reserved" 23 "0x17 - Unintended Steering" 22 "0x16 - Message missing" 21 "0x15 - Data drifted low" 20 "0x14 - Data drifted high" 19 "0x13 - Received network data in error" 18 "0x12 - Data valid, but below normal operating range - Moderately severe level" 17 "0x11 - Data valid, but below normal operating range - Least severe level" 16 "0x10 - Data valid, but above normal operating range - Moderately severe level" 15 "0x0F - Data valid, but above normal operating range - Least severe level" 14 "0x0E - Special instructions" 13 "0x0D - Out of calibration" 12 "0x0C - Bad intelligent device or component" 11 "0x0B - Unknown root-cause" 10 "0x0A - Abnormal rate of change" 9 "0x09 - Abnormal update rate" 8 "0x08 - Abnormal frequency or pulse width or period" 7 "0x07 - Mechanical system not responding or out of adjustement" 6 "0x06 - Current above normal or grounded circuit" 5 "0x05 - Current below normal or open circuit" 4 "0x04 - Voltage below normal or short-circuit to low source" 3 "0x03 - Voltage above normal or short-circuit to high source" 2 "0x02 - Data erratic, intermittent or incorrect" 1 "0x01 - Data valid, but below normal operational range - Most severe level" 0 "0x00 - Data valid, but above normal operational range - Most severe level";
VAL_ 2360125960 EEPROM 31 "0x1F - Condition exists" 30 "0x1E - Stuck Closed" 29 "0x1D - Stuck Open" 28 "0x1C - Not in neutral at Power-up" 27 "0x1B - Unable to return to neutral" 26 "0x1A - No steering" 25 "0x19 - Signal crosscheck failed" 24 "0x18 - Reserved" 23 "0x17 - Unintended Steering" 22 "0x16 - Message missing" 21 "0x15 - Data drifted low" 20 "0x14 - Data drifted high" 19 "0x13 - Received network data in error" 18 "0x12 - Data valid, but below normal operating range - Moderately severe level" 17 "0x11 - Data valid, but below normal operating range - Least severe level" 16 "0x10 - Data valid, but above normal operating range - Moderately severe level" 15 "0x0F - Data valid, but above normal operating range - Least severe level" 14 "0x0E - Special instructions" 13 "0x0D - Out of calibration" 12 "0x0C - Bad intelligent device or component" 11 "0x0B - Unknown root-cause" 10 "0x0A - Abnormal rate of change" 9 "0x09 - Abnormal update rate" 8 "0x08 - Abnormal frequency or pulse width or period" 7 "0x07 - Mechanical system not responding or out of adjustement" 6 "0x06 - Current above normal or grounded circuit" 5 "0x05 - Current below normal or open circuit" 4 "0x04 - Voltage below normal or short-circuit to low source" 3 "0x03 - Voltage above normal or short-circuit to high source" 2 "0x02 - Data erratic, intermittent or incorrect" 1 "0x01 - Data valid, but below normal operational range - Most severe level" 0 "0x00 - Data valid, but above normal operational range - Most severe level";
VAL_ 2360125960 EEPROM_AUX_config 31 "0x1F - Condition exists" 30 "0x1E - Stuck Closed" 29 "0x1D - Stuck Open" 28 "0x1C - Not in neutral at Power-up" 27 "0x1B - Unable to return to neutral" 26 "0x1A - No steering" 25 "0x19 - Signal crosscheck failed" 24 "0x18 - Reserved" 23 "0x17 - Unintended Steering" 22 "0x16 - Message missing" 21 "0x15 - Data drifted low" 20 "0x14 - Data drifted high" 19 "0x13 - Received network data in error" 18 "0x12 - Data valid, but below normal operating range - Moderately severe level" 17 "0x11 - Data valid, but below normal operating range - Least severe level" 16 "0x10 - Data valid, but above normal operating range - Moderately severe level" 15 "0x0F - Data valid, but above normal operating range - Least severe level" 14 "0x0E - Special instructions" 13 "0x0D - Out of calibration" 12 "0x0C - Bad intelligent device or component" 11 "0x0B - Unknown root-cause" 10 "0x0A - Abnormal rate of change" 9 "0x09 - Abnormal update rate" 8 "0x08 - Abnormal frequency or pulse width or period" 7 "0x07 - Mechanical system not responding or out of adjustement" 6 "0x06 - Current above normal or grounded circuit" 5 "0x05 - Current below normal or open circuit" 4 "0x04 - Voltage below normal or short-circuit to low source" 3 "0x03 - Voltage above normal or short-circuit to high source" 2 "0x02 - Data erratic, intermittent or incorrect" 1 "0x01 - Data valid, but below normal operational range - Most severe level" 0 "0x00 - Data valid, but above normal operational range - Most severe level";
VAL_ 2360125960 EEPROM_Diagnostic_sectors 31 "0x1F - Condition exists" 30 "0x1E - Stuck Closed" 29 "0x1D - Stuck Open" 28 "0x1C - Not in neutral at Power-up" 27 "0x1B - Unable to return to neutral" 26 "0x1A - No steering" 25 "0x19 - Signal crosscheck failed" 24 "0x18 - Reserved" 23 "0x17 - Unintended Steering" 22 "0x16 - Message missing" 21 "0x15 - Data drifted low" 20 "0x14 - Data drifted high" 19 "0x13 - Received network data in error" 18 "0x12 - Data valid, but below normal operating range - Moderately severe level" 17 "0x11 - Data valid, but below normal operating range - Least severe level" 16 "0x10 - Data valid, but above normal operating range - Moderately severe level" 15 "0x0F - Data valid, but above normal operating range - Least severe level" 14 "0x0E - Special instructions" 13 "0x0D - Out of calibration" 12 "0x0C - Bad intelligent device or component" 11 "0x0B - Unknown root-cause" 10 "0x0A - Abnormal rate of change" 9 "0x09 - Abnormal update rate" 8 "0x08 - Abnormal frequency or pulse width or period" 7 "0x07 - Mechanical system not responding or out of adjustement" 6 "0x06 - Current above normal or grounded circuit" 5 "0x05 - Current below normal or open circuit" 4 "0x04 - Voltage below normal or short-circuit to low source" 3 "0x03 - Voltage above normal or short-circuit to high source" 2 "0x02 - Data erratic, intermittent or incorrect" 1 "0x01 - Data valid, but below normal operational range - Most severe level" 0 "0x00 - Data valid, but above normal operational range - Most severe level";
VAL_ 2360125960 EEPROM_GPS_config 31 "0x1F - Condition exists" 30 "0x1E - Stuck Closed" 29 "0x1D - Stuck Open" 28 "0x1C - Not in neutral at Power-up" 27 "0x1B - Unable to return to neutral" 26 "0x1A - No steering" 25 "0x19 - Signal crosscheck failed" 24 "0x18 - Reserved" 23 "0x17 - Unintended Steering" 22 "0x16 - Message missing" 21 "0x15 - Data drifted low" 20 "0x14 - Data drifted high" 19 "0x13 - Received network data in error" 18 "0x12 - Data valid, but below normal operating range - Moderately severe level" 17 "0x11 - Data valid, but below normal operating range - Least severe level" 16 "0x10 - Data valid, but above normal operating range - Moderately severe level" 15 "0x0F - Data valid, but above normal operating range - Least severe level" 14 "0x0E - Special instructions" 13 "0x0D - Out of calibration" 12 "0x0C - Bad intelligent device or component" 11 "0x0B - Unknown root-cause" 10 "0x0A - Abnormal rate of change" 9 "0x09 - Abnormal update rate" 8 "0x08 - Abnormal frequency or pulse width or period" 7 "0x07 - Mechanical system not responding or out of adjustement" 6 "0x06 - Current above normal or grounded circuit" 5 "0x05 - Current below normal or open circuit" 4 "0x04 - Voltage below normal or short-circuit to low source" 3 "0x03 - Voltage above normal or short-circuit to high source" 2 "0x02 - Data erratic, intermittent or incorrect" 1 "0x01 - Data valid, but below normal operational range - Most severe level" 0 "0x00 - Data valid, but above normal operational range - Most severe level";
VAL_ 2360125960 EEPROM_Hydraulic_config 31 "0x1F - Condition exists" 30 "0x1E - Stuck Closed" 29 "0x1D - Stuck Open" 28 "0x1C - Not in neutral at Power-up" 27 "0x1B - Unable to return to neutral" 26 "0x1A - No steering" 25 "0x19 - Signal crosscheck failed" 24 "0x18 - Reserved" 23 "0x17 - Unintended Steering" 22 "0x16 - Message missing" 21 "0x15 - Data drifted low" 20 "0x14 - Data drifted high" 19 "0x13 - Received network data in error" 18 "0x12 - Data valid, but below normal operating range - Moderately severe level" 17 "0x11 - Data valid, but below normal operating range - Least severe level" 16 "0x10 - Data valid, but above normal operating range - Moderately severe level" 15 "0x0F - Data valid, but above normal operating range - Least severe level" 14 "0x0E - Special instructions" 13 "0x0D - Out of calibration" 12 "0x0C - Bad intelligent device or component" 11 "0x0B - Unknown root-cause" 10 "0x0A - Abnormal rate of change" 9 "0x09 - Abnormal update rate" 8 "0x08 - Abnormal frequency or pulse width or period" 7 "0x07 - Mechanical system not responding or out of adjustement" 6 "0x06 - Current above normal or grounded circuit" 5 "0x05 - Current below normal or open circuit" 4 "0x04 - Voltage below normal or short-circuit to low source" 3 "0x03 - Voltage above normal or short-circuit to high source" 2 "0x02 - Data erratic, intermittent or incorrect" 1 "0x01 - Data valid, but below normal operational range - Most severe level" 0 "0x00 - Data valid, but above normal operational range - Most severe level";
VAL_ 2360125960 EEPROM_Internal_monitoring 31 "0x1F - Condition exists" 30 "0x1E - Stuck Closed" 29 "0x1D - Stuck Open" 28 "0x1C - Not in neutral at Power-up" 27 "0x1B - Unable to return to neutral" 26 "0x1A - No steering" 25 "0x19 - Signal crosscheck failed" 24 "0x18 - Reserved" 23 "0x17 - Unintended Steering" 22 "0x16 - Message missing" 21 "0x15 - Data drifted low" 20 "0x14 - Data drifted high" 19 "0x13 - Received network data in error" 18 "0x12 - Data valid, but below normal operating range - Moderately severe level" 17 "0x11 - Data valid, but below normal operating range - Least severe level" 16 "0x10 - Data valid, but above normal operating range - Moderately severe level" 15 "0x0F - Data valid, but above normal operating range - Least severe level" 14 "0x0E - Special instructions" 13 "0x0D - Out of calibration" 12 "0x0C - Bad intelligent device or component" 11 "0x0B - Unknown root-cause" 10 "0x0A - Abnormal rate of change" 9 "0x09 - Abnormal update rate" 8 "0x08 - Abnormal frequency or pulse width or period" 7 "0x07 - Mechanical system not responding or out of adjustement" 6 "0x06 - Current above normal or grounded circuit" 5 "0x05 - Current below normal or open circuit" 4 "0x04 - Voltage below normal or short-circuit to low source" 3 "0x03 - Voltage above normal or short-circuit to high source" 2 "0x02 - Data erratic, intermittent or incorrect" 1 "0x01 - Data valid, but below normal operational range - Most severe level" 0 "0x00 - Data valid, but above normal operational range - Most severe level";
VAL_ 2360125960 EEPROM_Peripherals_config 31 "0x1F - Condition exists" 30 "0x1E - Stuck Closed" 29 "0x1D - Stuck Open" 28 "0x1C - Not in neutral at Power-up" 27 "0x1B - Unable to return to neutral" 26 "0x1A - No steering" 25 "0x19 - Signal crosscheck failed" 24 "0x18 - Reserved" 23 "0x17 - Unintended Steering" 22 "0x16 - Message missing" 21 "0x15 - Data drifted low" 20 "0x14 - Data drifted high" 19 "0x13 - Received network data in error" 18 "0x12 - Data valid, but below normal operating range - Moderately severe level" 17 "0x11 - Data valid, but below normal operating range - Least severe level" 16 "0x10 - Data valid, but above normal operating range - Moderately severe level" 15 "0x0F - Data valid, but above normal operating range - Least severe level" 14 "0x0E - Special instructions" 13 "0x0D - Out of calibration" 12 "0x0C - Bad intelligent device or component" 11 "0x0B - Unknown root-cause" 10 "0x0A - Abnormal rate of change" 9 "0x09 - Abnormal update rate" 8 "0x08 - Abnormal frequency or pulse width or period" 7 "0x07 - Mechanical system not responding or out of adjustement" 6 "0x06 - Current above normal or grounded circuit" 5 "0x05 - Current below normal or open circuit" 4 "0x04 - Voltage below normal or short-circuit to low source" 3 "0x03 - Voltage above normal or short-circuit to high source" 2 "0x02 - Data erratic, intermittent or incorrect" 1 "0x01 - Data valid, but below normal operational range - Most severe level" 0 "0x00 - Data valid, but above normal operational range - Most severe level";
VAL_ 2360125960 EEPROM_SEHS_FDA 31 "0x1F - Condition exists" 30 "0x1E - Stuck Closed" 29 "0x1D - Stuck Open" 28 "0x1C - Not in neutral at Power-up" 27 "0x1B - Unable to return to neutral" 26 "0x1A - No steering" 25 "0x19 - Signal crosscheck failed" 24 "0x18 - Reserved" 23 "0x17 - Unintended Steering" 22 "0x16 - Message missing" 21 "0x15 - Data drifted low" 20 "0x14 - Data drifted high" 19 "0x13 - Received network data in error" 18 "0x12 - Data valid, but below normal operating range - Moderately severe level" 17 "0x11 - Data valid, but below normal operating range - Least severe level" 16 "0x10 - Data valid, but above normal operating range - Moderately severe level" 15 "0x0F - Data valid, but above normal operating range - Least severe level" 14 "0x0E - Special instructions" 13 "0x0D - Out of calibration" 12 "0x0C - Bad intelligent device or component" 11 "0x0B - Unknown root-cause" 10 "0x0A - Abnormal rate of change" 9 "0x09 - Abnormal update rate" 8 "0x08 - Abnormal frequency or pulse width or period" 7 "0x07 - Mechanical system not responding or out of adjustement" 6 "0x06 - Current above normal or grounded circuit" 5 "0x05 - Current below normal or open circuit" 4 "0x04 - Voltage below normal or short-circuit to low source" 3 "0x03 - Voltage above normal or short-circuit to high source" 2 "0x02 - Data erratic, intermittent or incorrect" 1 "0x01 - Data valid, but below normal operational range - Most severe level" 0 "0x00 - Data valid, but above normal operational range - Most severe level";
VAL_ 2360125960 EEPROM_SEHS_Protocol_data 31 "0x1F - Condition exists" 30 "0x1E - Stuck Closed" 29 "0x1D - Stuck Open" 28 "0x1C - Not in neutral at Power-up" 27 "0x1B - Unable to return to neutral" 26 "0x1A - No steering" 25 "0x19 - Signal crosscheck failed" 24 "0x18 - Reserved" 23 "0x17 - Unintended Steering" 22 "0x16 - Message missing" 21 "0x15 - Data drifted low" 20 "0x14 - Data drifted high" 19 "0x13 - Received network data in error" 18 "0x12 - Data valid, but below normal operating range - Moderately severe level" 17 "0x11 - Data valid, but below normal operating range - Least severe level" 16 "0x10 - Data valid, but above normal operating range - Moderately severe level" 15 "0x0F - Data valid, but above normal operating range - Least severe level" 14 "0x0E - Special instructions" 13 "0x0D - Out of calibration" 12 "0x0C - Bad intelligent device or component" 11 "0x0B - Unknown root-cause" 10 "0x0A - Abnormal rate of change" 9 "0x09 - Abnormal update rate" 8 "0x08 - Abnormal frequency or pulse width or period" 7 "0x07 - Mechanical system not responding or out of adjustement" 6 "0x06 - Current above normal or grounded circuit" 5 "0x05 - Current below normal or open circuit" 4 "0x04 - Voltage below normal or short-circuit to low source" 3 "0x03 - Voltage above normal or short-circuit to high source" 2 "0x02 - Data erratic, intermittent or incorrect" 1 "0x01 - Data valid, but below normal operational range - Most severe level" 0 "0x00 - Data valid, but above normal operational range - Most severe level";
VAL_ 2360125960 EEPROM_STW_config 31 "0x1F - Condition exists" 30 "0x1E - Stuck Closed" 29 "0x1D - Stuck Open" 28 "0x1C - Not in neutral at Power-up" 27 "0x1B - Unable to return to neutral" 26 "0x1A - No steering" 25 "0x19 - Signal crosscheck failed" 24 "0x18 - Reserved" 23 "0x17 - Unintended Steering" 22 "0x16 - Message missing" 21 "0x15 - Data drifted low" 20 "0x14 - Data drifted high" 19 "0x13 - Received network data in error" 18 "0x12 - Data valid, but below normal operating range - Moderately severe level" 17 "0x11 - Data valid, but below normal operating range - Least severe level" 16 "0x10 - Data valid, but above normal operating range - Moderately severe level" 15 "0x0F - Data valid, but above normal operating range - Least severe level" 14 "0x0E - Special instructions" 13 "0x0D - Out of calibration" 12 "0x0C - Bad intelligent device or component" 11 "0x0B - Unknown root-cause" 10 "0x0A - Abnormal rate of change" 9 "0x09 - Abnormal update rate" 8 "0x08 - Abnormal frequency or pulse width or period" 7 "0x07 - Mechanical system not responding or out of adjustement" 6 "0x06 - Current above normal or grounded circuit" 5 "0x05 - Current below normal or open circuit" 4 "0x04 - Voltage below normal or short-circuit to low source" 3 "0x03 - Voltage above normal or short-circuit to high source" 2 "0x02 - Data erratic, intermittent or incorrect" 1 "0x01 - Data valid, but below normal operational range - Most severe level" 0 "0x00 - Data valid, but above normal operational range - Most severe level";
VAL_ 2360125960 EEPROM_VPS_Data 31 "0x1F - Condition exists" 30 "0x1E - Stuck Closed" 29 "0x1D - Stuck Open" 28 "0x1C - Not in neutral at Power-up" 27 "0x1B - Unable to return to neutral" 26 "0x1A - No steering" 25 "0x19 - Signal crosscheck failed" 24 "0x18 - Reserved" 23 "0x17 - Unintended Steering" 22 "0x16 - Message missing" 21 "0x15 - Data drifted low" 20 "0x14 - Data drifted high" 19 "0x13 - Received network data in error" 18 "0x12 - Data valid, but below normal operating range - Moderately severe level" 17 "0x11 - Data valid, but below normal operating range - Least severe level" 16 "0x10 - Data valid, but above normal operating range - Moderately severe level" 15 "0x0F - Data valid, but above normal operating range - Least severe level" 14 "0x0E - Special instructions" 13 "0x0D - Out of calibration" 12 "0x0C - Bad intelligent device or component" 11 "0x0B - Unknown root-cause" 10 "0x0A - Abnormal rate of change" 9 "0x09 - Abnormal update rate" 8 "0x08 - Abnormal frequency or pulse width or period" 7 "0x07 - Mechanical system not responding or out of adjustement" 6 "0x06 - Current above normal or grounded circuit" 5 "0x05 - Current below normal or open circuit" 4 "0x04 - Voltage below normal or short-circuit to low source" 3 "0x03 - Voltage above normal or short-circuit to high source" 2 "0x02 - Data erratic, intermittent or incorrect" 1 "0x01 - Data valid, but below normal operational range - Most severe level" 0 "0x00 - Data valid, but above normal operational range - Most severe level";
VAL_ 2360125960 EEPROM_Valve_Calibration_data 31 "0x1F - Condition exists" 30 "0x1E - Stuck Closed" 29 "0x1D - Stuck Open" 28 "0x1C - Not in neutral at Power-up" 27 "0x1B - Unable to return to neutral" 26 "0x1A - No steering" 25 "0x19 - Signal crosscheck failed" 24 "0x18 - Reserved" 23 "0x17 - Unintended Steering" 22 "0x16 - Message missing" 21 "0x15 - Data drifted low" 20 "0x14 - Data drifted high" 19 "0x13 - Received network data in error" 18 "0x12 - Data valid, but below normal operating range - Moderately severe level" 17 "0x11 - Data valid, but below normal operating range - Least severe level" 16 "0x10 - Data valid, but above normal operating range - Moderately severe level" 15 "0x0F - Data valid, but above normal operating range - Least severe level" 14 "0x0E - Special instructions" 13 "0x0D - Out of calibration" 12 "0x0C - Bad intelligent device or component" 11 "0x0B - Unknown root-cause" 10 "0x0A - Abnormal rate of change" 9 "0x09 - Abnormal update rate" 8 "0x08 - Abnormal frequency or pulse width or period" 7 "0x07 - Mechanical system not responding or out of adjustement" 6 "0x06 - Current above normal or grounded circuit" 5 "0x05 - Current below normal or open circuit" 4 "0x04 - Voltage below normal or short-circuit to low source" 3 "0x03 - Voltage above normal or short-circuit to high source" 2 "0x02 - Data erratic, intermittent or incorrect" 1 "0x01 - Data valid, but below normal operational range - Most severe level" 0 "0x00 - Data valid, but above normal operational range - Most severe level";
VAL_ 2360125960 EEPROM_Vehicle_geometry 31 "0x1F - Condition exists" 30 "0x1E - Stuck Closed" 29 "0x1D - Stuck Open" 28 "0x1C - Not in neutral at Power-up" 27 "0x1B - Unable to return to neutral" 26 "0x1A - No steering" 25 "0x19 - Signal crosscheck failed" 24 "0x18 - Reserved" 23 "0x17 - Unintended Steering" 22 "0x16 - Message missing" 21 "0x15 - Data drifted low" 20 "0x14 - Data drifted high" 19 "0x13 - Received network data in error" 18 "0x12 - Data valid, but below normal operating range - Moderately severe level" 17 "0x11 - Data valid, but below normal operating range - Least severe level" 16 "0x10 - Data valid, but above normal operating range - Moderately severe level" 15 "0x0F - Data valid, but above normal operating range - Least severe level" 14 "0x0E - Special instructions" 13 "0x0D - Out of calibration" 12 "0x0C - Bad intelligent device or component" 11 "0x0B - Unknown root-cause" 10 "0x0A - Abnormal rate of change" 9 "0x09 - Abnormal update rate" 8 "0x08 - Abnormal frequency or pulse width or period" 7 "0x07 - Mechanical system not responding or out of adjustement" 6 "0x06 - Current above normal or grounded circuit" 5 "0x05 - Current below normal or open circuit" 4 "0x04 - Voltage below normal or short-circuit to low source" 3 "0x03 - Voltage above normal or short-circuit to high source" 2 "0x02 - Data erratic, intermittent or incorrect" 1 "0x01 - Data valid, but below normal operational range - Most severe level" 0 "0x00 - Data valid, but above normal operational range - Most severe level";
VAL_ 2360125960 EEPROM_configuration_sectors 31 "0x1F - Condition exists" 30 "0x1E - Stuck Closed" 29 "0x1D - Stuck Open" 28 "0x1C - Not in neutral at Power-up" 27 "0x1B - Unable to return to neutral" 26 "0x1A - No steering" 25 "0x19 - Signal crosscheck failed" 24 "0x18 - Reserved" 23 "0x17 - Unintended Steering" 22 "0x16 - Message missing" 21 "0x15 - Data drifted low" 20 "0x14 - Data drifted high" 19 "0x13 - Received network data in error" 18 "0x12 - Data valid, but below normal operating range - Moderately severe level" 17 "0x11 - Data valid, but below normal operating range - Least severe level" 16 "0x10 - Data valid, but above normal operating range - Moderately severe level" 15 "0x0F - Data valid, but above normal operating range - Least severe level" 14 "0x0E - Special instructions" 13 "0x0D - Out of calibration" 12 "0x0C - Bad intelligent device or component" 11 "0x0B - Unknown root-cause" 10 "0x0A - Abnormal rate of change" 9 "0x09 - Abnormal update rate" 8 "0x08 - Abnormal frequency or pulse width or period" 7 "0x07 - Mechanical system not responding or out of adjustement" 6 "0x06 - Current above normal or grounded circuit" 5 "0x05 - Current below normal or open circuit" 4 "0x04 - Voltage below normal or short-circuit to low source" 3 "0x03 - Voltage above normal or short-circuit to high source" 2 "0x02 - Data erratic, intermittent or incorrect" 1 "0x01 - Data valid, but below normal operational range - Most severe level" 0 "0x00 - Data valid, but above normal operational range - Most severe level";
VAL_ 2360125960 EEP_Anal_Sensor_Caliber_data 31 "0x1F - Condition exists" 30 "0x1E - Stuck Closed" 29 "0x1D - Stuck Open" 28 "0x1C - Not in neutral at Power-up" 27 "0x1B - Unable to return to neutral" 26 "0x1A - No steering" 25 "0x19 - Signal crosscheck failed" 24 "0x18 - Reserved" 23 "0x17 - Unintended Steering" 22 "0x16 - Message missing" 21 "0x15 - Data drifted low" 20 "0x14 - Data drifted high" 19 "0x13 - Received network data in error" 18 "0x12 - Data valid, but below normal operating range - Moderately severe level" 17 "0x11 - Data valid, but below normal operating range - Least severe level" 16 "0x10 - Data valid, but above normal operating range - Moderately severe level" 15 "0x0F - Data valid, but above normal operating range - Least severe level" 14 "0x0E - Special instructions" 13 "0x0D - Out of calibration" 12 "0x0C - Bad intelligent device or component" 11 "0x0B - Unknown root-cause" 10 "0x0A - Abnormal rate of change" 9 "0x09 - Abnormal update rate" 8 "0x08 - Abnormal frequency or pulse width or period" 7 "0x07 - Mechanical system not responding or out of adjustement" 6 "0x06 - Current above normal or grounded circuit" 5 "0x05 - Current below normal or open circuit" 4 "0x04 - Voltage below normal or short-circuit to low source" 3 "0x03 - Voltage above normal or short-circuit to high source" 2 "0x02 - Data erratic, intermittent or incorrect" 1 "0x01 - Data valid, but below normal operational range - Most severe level" 0 "0x00 - Data valid, but above normal operational range - Most severe level";
VAL_ 2360125960 EEP_Auto_Caliber_Config_sect 31 "0x1F - Condition exists" 30 "0x1E - Stuck Closed" 29 "0x1D - Stuck Open" 28 "0x1C - Not in neutral at Power-up" 27 "0x1B - Unable to return to neutral" 26 "0x1A - No steering" 25 "0x19 - Signal crosscheck failed" 24 "0x18 - Reserved" 23 "0x17 - Unintended Steering" 22 "0x16 - Message missing" 21 "0x15 - Data drifted low" 20 "0x14 - Data drifted high" 19 "0x13 - Received network data in error" 18 "0x12 - Data valid, but below normal operating range - Moderately severe level" 17 "0x11 - Data valid, but below normal operating range - Least severe level" 16 "0x10 - Data valid, but above normal operating range - Moderately severe level" 15 "0x0F - Data valid, but above normal operating range - Least severe level" 14 "0x0E - Special instructions" 13 "0x0D - Out of calibration" 12 "0x0C - Bad intelligent device or component" 11 "0x0B - Unknown root-cause" 10 "0x0A - Abnormal rate of change" 9 "0x09 - Abnormal update rate" 8 "0x08 - Abnormal frequency or pulse width or period" 7 "0x07 - Mechanical system not responding or out of adjustement" 6 "0x06 - Current above normal or grounded circuit" 5 "0x05 - Current below normal or open circuit" 4 "0x04 - Voltage below normal or short-circuit to low source" 3 "0x03 - Voltage above normal or short-circuit to high source" 2 "0x02 - Data erratic, intermittent or incorrect" 1 "0x01 - Data valid, but below normal operational range - Most severe level" 0 "0x00 - Data valid, but above normal operational range - Most severe level";
VAL_ 2360125960 EEP_CAN_WAS_Caliber_data 31 "0x1F - Condition exists" 30 "0x1E - Stuck Closed" 29 "0x1D - Stuck Open" 28 "0x1C - Not in neutral at Power-up" 27 "0x1B - Unable to return to neutral" 26 "0x1A - No steering" 25 "0x19 - Signal crosscheck failed" 24 "0x18 - Reserved" 23 "0x17 - Unintended Steering" 22 "0x16 - Message missing" 21 "0x15 - Data drifted low" 20 "0x14 - Data drifted high" 19 "0x13 - Received network data in error" 18 "0x12 - Data valid, but below normal operating range - Moderately severe level" 17 "0x11 - Data valid, but below normal operating range - Least severe level" 16 "0x10 - Data valid, but above normal operating range - Moderately severe level" 15 "0x0F - Data valid, but above normal operating range - Least severe level" 14 "0x0E - Special instructions" 13 "0x0D - Out of calibration" 12 "0x0C - Bad intelligent device or component" 11 "0x0B - Unknown root-cause" 10 "0x0A - Abnormal rate of change" 9 "0x09 - Abnormal update rate" 8 "0x08 - Abnormal frequency or pulse width or period" 7 "0x07 - Mechanical system not responding or out of adjustement" 6 "0x06 - Current above normal or grounded circuit" 5 "0x05 - Current below normal or open circuit" 4 "0x04 - Voltage below normal or short-circuit to low source" 3 "0x03 - Voltage above normal or short-circuit to high source" 2 "0x02 - Data erratic, intermittent or incorrect" 1 "0x01 - Data valid, but below normal operational range - Most severe level" 0 "0x00 - Data valid, but above normal operational range - Most severe level";
VAL_ 2360125960 EH_Mainspool_Position_crosscheck 31 "0x1F - Condition exists" 30 "0x1E - Stuck Closed" 29 "0x1D - Stuck Open" 28 "0x1C - Not in neutral at Power-up" 27 "0x1B - Unable to return to neutral" 26 "0x1A - No steering" 25 "0x19 - Signal crosscheck failed" 24 "0x18 - Reserved" 23 "0x17 - Unintended Steering" 22 "0x16 - Message missing" 21 "0x15 - Data drifted low" 20 "0x14 - Data drifted high" 19 "0x13 - Received network data in error" 18 "0x12 - Data valid, but below normal operating range - Moderately severe level" 17 "0x11 - Data valid, but below normal operating range - Least severe level" 16 "0x10 - Data valid, but above normal operating range - Moderately severe level" 15 "0x0F - Data valid, but above normal operating range - Least severe level" 14 "0x0E - Special instructions" 13 "0x0D - Out of calibration" 12 "0x0C - Bad intelligent device or component" 11 "0x0B - Unknown root-cause" 10 "0x0A - Abnormal rate of change" 9 "0x09 - Abnormal update rate" 8 "0x08 - Abnormal frequency or pulse width or period" 7 "0x07 - Mechanical system not responding or out of adjustement" 6 "0x06 - Current above normal or grounded circuit" 5 "0x05 - Current below normal or open circuit" 4 "0x04 - Voltage below normal or short-circuit to low source" 3 "0x03 - Voltage above normal or short-circuit to high source" 2 "0x02 - Data erratic, intermittent or incorrect" 1 "0x01 - Data valid, but below normal operational range - Most severe level" 0 "0x00 - Data valid, but above normal operational range - Most severe level";
VAL_ 2360125960 EH_main_spool_monitoring 31 "0x1F - Condition exists" 30 "0x1E - Stuck Closed" 29 "0x1D - Stuck Open" 28 "0x1C - Not in neutral at Power-up" 27 "0x1B - Unable to return to neutral" 26 "0x1A - No steering" 25 "0x19 - Signal crosscheck failed" 24 "0x18 - Reserved" 23 "0x17 - Unintended Steering" 22 "0x16 - Message missing" 21 "0x15 - Data drifted low" 20 "0x14 - Data drifted high" 19 "0x13 - Received network data in error" 18 "0x12 - Data valid, but below normal operating range - Moderately severe level" 17 "0x11 - Data valid, but below normal operating range - Least severe level" 16 "0x10 - Data valid, but above normal operating range - Moderately severe level" 15 "0x0F - Data valid, but above normal operating range - Least severe level" 14 "0x0E - Special instructions" 13 "0x0D - Out of calibration" 12 "0x0C - Bad intelligent device or component" 11 "0x0B - Unknown root-cause" 10 "0x0A - Abnormal rate of change" 9 "0x09 - Abnormal update rate" 8 "0x08 - Abnormal frequency or pulse width or period" 7 "0x07 - Mechanical system not responding or out of adjustement" 6 "0x06 - Current above normal or grounded circuit" 5 "0x05 - Current below normal or open circuit" 4 "0x04 - Voltage below normal or short-circuit to low source" 3 "0x03 - Voltage above normal or short-circuit to high source" 2 "0x02 - Data erratic, intermittent or incorrect" 1 "0x01 - Data valid, but below normal operational range - Most severe level" 0 "0x00 - Data valid, but above normal operational range - Most severe level";
VAL_ 2360125960 Fault_Detection_Algorithm_Monito 31 "0x1F - Condition exists" 30 "0x1E - Stuck Closed" 29 "0x1D - Stuck Open" 28 "0x1C - Not in neutral at Power-up" 27 "0x1B - Unable to return to neutral" 26 "0x1A - No steering" 25 "0x19 - Signal crosscheck failed" 24 "0x18 - Reserved" 23 "0x17 - Unintended Steering" 22 "0x16 - Message missing" 21 "0x15 - Data drifted low" 20 "0x14 - Data drifted high" 19 "0x13 - Received network data in error" 18 "0x12 - Data valid, but below normal operating range - Moderately severe level" 17 "0x11 - Data valid, but below normal operating range - Least severe level" 16 "0x10 - Data valid, but above normal operating range - Moderately severe level" 15 "0x0F - Data valid, but above normal operating range - Least severe level" 14 "0x0E - Special instructions" 13 "0x0D - Out of calibration" 12 "0x0C - Bad intelligent device or component" 11 "0x0B - Unknown root-cause" 10 "0x0A - Abnormal rate of change" 9 "0x09 - Abnormal update rate" 8 "0x08 - Abnormal frequency or pulse width or period" 7 "0x07 - Mechanical system not responding or out of adjustement" 6 "0x06 - Current above normal or grounded circuit" 5 "0x05 - Current below normal or open circuit" 4 "0x04 - Voltage below normal or short-circuit to low source" 3 "0x03 - Voltage above normal or short-circuit to high source" 2 "0x02 - Data erratic, intermittent or incorrect" 1 "0x01 - Data valid, but below normal operational range - Most severe level" 0 "0x00 - Data valid, but above normal operational range - Most severe level";
VAL_ 2360125960 Flash_test 31 "0x1F - Condition exists" 30 "0x1E - Stuck Closed" 29 "0x1D - Stuck Open" 28 "0x1C - Not in neutral at Power-up" 27 "0x1B - Unable to return to neutral" 26 "0x1A - No steering" 25 "0x19 - Signal crosscheck failed" 24 "0x18 - Reserved" 23 "0x17 - Unintended Steering" 22 "0x16 - Message missing" 21 "0x15 - Data drifted low" 20 "0x14 - Data drifted high" 19 "0x13 - Received network data in error" 18 "0x12 - Data valid, but below normal operating range - Moderately severe level" 17 "0x11 - Data valid, but below normal operating range - Least severe level" 16 "0x10 - Data valid, but above normal operating range - Moderately severe level" 15 "0x0F - Data valid, but above normal operating range - Least severe level" 14 "0x0E - Special instructions" 13 "0x0D - Out of calibration" 12 "0x0C - Bad intelligent device or component" 11 "0x0B - Unknown root-cause" 10 "0x0A - Abnormal rate of change" 9 "0x09 - Abnormal update rate" 8 "0x08 - Abnormal frequency or pulse width or period" 7 "0x07 - Mechanical system not responding or out of adjustement" 6 "0x06 - Current above normal or grounded circuit" 5 "0x05 - Current below normal or open circuit" 4 "0x04 - Voltage below normal or short-circuit to low source" 3 "0x03 - Voltage above normal or short-circuit to high source" 2 "0x02 - Data erratic, intermittent or incorrect" 1 "0x01 - Data valid, but below normal operational range - Most severe level" 0 "0x00 - Data valid, but above normal operational range - Most severe level";
VAL_ 2360125960 Flow_command_crosscheck 31 "0x1F - Condition exists" 30 "0x1E - Stuck Closed" 29 "0x1D - Stuck Open" 28 "0x1C - Not in neutral at Power-up" 27 "0x1B - Unable to return to neutral" 26 "0x1A - No steering" 25 "0x19 - Signal crosscheck failed" 24 "0x18 - Reserved" 23 "0x17 - Unintended Steering" 22 "0x16 - Message missing" 21 "0x15 - Data drifted low" 20 "0x14 - Data drifted high" 19 "0x13 - Received network data in error" 18 "0x12 - Data valid, but below normal operating range - Moderately severe level" 17 "0x11 - Data valid, but below normal operating range - Least severe level" 16 "0x10 - Data valid, but above normal operating range - Moderately severe level" 15 "0x0F - Data valid, but above normal operating range - Least severe level" 14 "0x0E - Special instructions" 13 "0x0D - Out of calibration" 12 "0x0C - Bad intelligent device or component" 11 "0x0B - Unknown root-cause" 10 "0x0A - Abnormal rate of change" 9 "0x09 - Abnormal update rate" 8 "0x08 - Abnormal frequency or pulse width or period" 7 "0x07 - Mechanical system not responding or out of adjustement" 6 "0x06 - Current above normal or grounded circuit" 5 "0x05 - Current below normal or open circuit" 4 "0x04 - Voltage below normal or short-circuit to low source" 3 "0x03 - Voltage above normal or short-circuit to high source" 2 "0x02 - Data erratic, intermittent or incorrect" 1 "0x01 - Data valid, but below normal operational range - Most severe level" 0 "0x00 - Data valid, but above normal operational range - Most severe level";
VAL_ 2360125960 GND_level 31 "0x1F - Condition exists" 30 "0x1E - Stuck Closed" 29 "0x1D - Stuck Open" 28 "0x1C - Not in neutral at Power-up" 27 "0x1B - Unable to return to neutral" 26 "0x1A - No steering" 25 "0x19 - Signal crosscheck failed" 24 "0x18 - Reserved" 23 "0x17 - Unintended Steering" 22 "0x16 - Message missing" 21 "0x15 - Data drifted low" 20 "0x14 - Data drifted high" 19 "0x13 - Received network data in error" 18 "0x12 - Data valid, but below normal operating range - Moderately severe level" 17 "0x11 - Data valid, but below normal operating range - Least severe level" 16 "0x10 - Data valid, but above normal operating range - Moderately severe level" 15 "0x0F - Data valid, but above normal operating range - Least severe level" 14 "0x0E - Special instructions" 13 "0x0D - Out of calibration" 12 "0x0C - Bad intelligent device or component" 11 "0x0B - Unknown root-cause" 10 "0x0A - Abnormal rate of change" 9 "0x09 - Abnormal update rate" 8 "0x08 - Abnormal frequency or pulse width or period" 7 "0x07 - Mechanical system not responding or out of adjustement" 6 "0x06 - Current above normal or grounded circuit" 5 "0x05 - Current below normal or open circuit" 4 "0x04 - Voltage below normal or short-circuit to low source" 3 "0x03 - Voltage above normal or short-circuit to high source" 2 "0x02 - Data erratic, intermittent or incorrect" 1 "0x01 - Data valid, but below normal operational range - Most severe level" 0 "0x00 - Data valid, but above normal operational range - Most severe level";
VAL_ 2360125960 I2C_communication 31 "0x1F - Condition exists" 30 "0x1E - Stuck Closed" 29 "0x1D - Stuck Open" 28 "0x1C - Not in neutral at Power-up" 27 "0x1B - Unable to return to neutral" 26 "0x1A - No steering" 25 "0x19 - Signal crosscheck failed" 24 "0x18 - Reserved" 23 "0x17 - Unintended Steering" 22 "0x16 - Message missing" 21 "0x15 - Data drifted low" 20 "0x14 - Data drifted high" 19 "0x13 - Received network data in error" 18 "0x12 - Data valid, but below normal operating range - Moderately severe level" 17 "0x11 - Data valid, but below normal operating range - Least severe level" 16 "0x10 - Data valid, but above normal operating range - Moderately severe level" 15 "0x0F - Data valid, but above normal operating range - Least severe level" 14 "0x0E - Special instructions" 13 "0x0D - Out of calibration" 12 "0x0C - Bad intelligent device or component" 11 "0x0B - Unknown root-cause" 10 "0x0A - Abnormal rate of change" 9 "0x09 - Abnormal update rate" 8 "0x08 - Abnormal frequency or pulse width or period" 7 "0x07 - Mechanical system not responding or out of adjustement" 6 "0x06 - Current above normal or grounded circuit" 5 "0x05 - Current below normal or open circuit" 4 "0x04 - Voltage below normal or short-circuit to low source" 3 "0x03 - Voltage above normal or short-circuit to high source" 2 "0x02 - Data erratic, intermittent or incorrect" 1 "0x01 - Data valid, but below normal operational range - Most severe level" 0 "0x00 - Data valid, but above normal operational range - Most severe level";
VAL_ 2360125960 IMD_status_crosscheck 31 "0x1F - Condition exists" 30 "0x1E - Stuck Closed" 29 "0x1D - Stuck Open" 28 "0x1C - Not in neutral at Power-up" 27 "0x1B - Unable to return to neutral" 26 "0x1A - No steering" 25 "0x19 - Signal crosscheck failed" 24 "0x18 - Reserved" 23 "0x17 - Unintended Steering" 22 "0x16 - Message missing" 21 "0x15 - Data drifted low" 20 "0x14 - Data drifted high" 19 "0x13 - Received network data in error" 18 "0x12 - Data valid, but below normal operating range - Moderately severe level" 17 "0x11 - Data valid, but below normal operating range - Least severe level" 16 "0x10 - Data valid, but above normal operating range - Moderately severe level" 15 "0x0F - Data valid, but above normal operating range - Least severe level" 14 "0x0E - Special instructions" 13 "0x0D - Out of calibration" 12 "0x0C - Bad intelligent device or component" 11 "0x0B - Unknown root-cause" 10 "0x0A - Abnormal rate of change" 9 "0x09 - Abnormal update rate" 8 "0x08 - Abnormal frequency or pulse width or period" 7 "0x07 - Mechanical system not responding or out of adjustement" 6 "0x06 - Current above normal or grounded circuit" 5 "0x05 - Current below normal or open circuit" 4 "0x04 - Voltage below normal or short-circuit to low source" 3 "0x03 - Voltage above normal or short-circuit to high source" 2 "0x02 - Data erratic, intermittent or incorrect" 1 "0x01 - Data valid, but below normal operational range - Most severe level" 0 "0x00 - Data valid, but above normal operational range - Most severe level";
VAL_ 2360125960 Incompatible_Bootloader 31 "0x1F - Condition exists" 30 "0x1E - Stuck Closed" 29 "0x1D - Stuck Open" 28 "0x1C - Not in neutral at Power-up" 27 "0x1B - Unable to return to neutral" 26 "0x1A - No steering" 25 "0x19 - Signal crosscheck failed" 24 "0x18 - Reserved" 23 "0x17 - Unintended Steering" 22 "0x16 - Message missing" 21 "0x15 - Data drifted low" 20 "0x14 - Data drifted high" 19 "0x13 - Received network data in error" 18 "0x12 - Data valid, but below normal operating range - Moderately severe level" 17 "0x11 - Data valid, but below normal operating range - Least severe level" 16 "0x10 - Data valid, but above normal operating range - Moderately severe level" 15 "0x0F - Data valid, but above normal operating range - Least severe level" 14 "0x0E - Special instructions" 13 "0x0D - Out of calibration" 12 "0x0C - Bad intelligent device or component" 11 "0x0B - Unknown root-cause" 10 "0x0A - Abnormal rate of change" 9 "0x09 - Abnormal update rate" 8 "0x08 - Abnormal frequency or pulse width or period" 7 "0x07 - Mechanical system not responding or out of adjustement" 6 "0x06 - Current above normal or grounded circuit" 5 "0x05 - Current below normal or open circuit" 4 "0x04 - Voltage below normal or short-circuit to low source" 3 "0x03 - Voltage above normal or short-circuit to high source" 2 "0x02 - Data erratic, intermittent or incorrect" 1 "0x01 - Data valid, but below normal operational range - Most severe level" 0 "0x00 - Data valid, but above normal operational range - Most severe level";
VAL_ 2360125960 Interpolation 31 "0x1F - Condition exists" 30 "0x1E - Stuck Closed" 29 "0x1D - Stuck Open" 28 "0x1C - Not in neutral at Power-up" 27 "0x1B - Unable to return to neutral" 26 "0x1A - No steering" 25 "0x19 - Signal crosscheck failed" 24 "0x18 - Reserved" 23 "0x17 - Unintended Steering" 22 "0x16 - Message missing" 21 "0x15 - Data drifted low" 20 "0x14 - Data drifted high" 19 "0x13 - Received network data in error" 18 "0x12 - Data valid, but below normal operating range - Moderately severe level" 17 "0x11 - Data valid, but below normal operating range - Least severe level" 16 "0x10 - Data valid, but above normal operating range - Moderately severe level" 15 "0x0F - Data valid, but above normal operating range - Least severe level" 14 "0x0E - Special instructions" 13 "0x0D - Out of calibration" 12 "0x0C - Bad intelligent device or component" 11 "0x0B - Unknown root-cause" 10 "0x0A - Abnormal rate of change" 9 "0x09 - Abnormal update rate" 8 "0x08 - Abnormal frequency or pulse width or period" 7 "0x07 - Mechanical system not responding or out of adjustement" 6 "0x06 - Current above normal or grounded circuit" 5 "0x05 - Current below normal or open circuit" 4 "0x04 - Voltage below normal or short-circuit to low source" 3 "0x03 - Voltage above normal or short-circuit to high source" 2 "0x02 - Data erratic, intermittent or incorrect" 1 "0x01 - Data valid, but below normal operational range - Most severe level" 0 "0x00 - Data valid, but above normal operational range - Most severe level";
VAL_ 2360125960 Invalid_sensor_configuration 31 "0x1F - Condition exists" 30 "0x1E - Stuck Closed" 29 "0x1D - Stuck Open" 28 "0x1C - Not in neutral at Power-up" 27 "0x1B - Unable to return to neutral" 26 "0x1A - No steering" 25 "0x19 - Signal crosscheck failed" 24 "0x18 - Reserved" 23 "0x17 - Unintended Steering" 22 "0x16 - Message missing" 21 "0x15 - Data drifted low" 20 "0x14 - Data drifted high" 19 "0x13 - Received network data in error" 18 "0x12 - Data valid, but below normal operating range - Moderately severe level" 17 "0x11 - Data valid, but below normal operating range - Least severe level" 16 "0x10 - Data valid, but above normal operating range - Moderately severe level" 15 "0x0F - Data valid, but above normal operating range - Least severe level" 14 "0x0E - Special instructions" 13 "0x0D - Out of calibration" 12 "0x0C - Bad intelligent device or component" 11 "0x0B - Unknown root-cause" 10 "0x0A - Abnormal rate of change" 9 "0x09 - Abnormal update rate" 8 "0x08 - Abnormal frequency or pulse width or period" 7 "0x07 - Mechanical system not responding or out of adjustement" 6 "0x06 - Current above normal or grounded circuit" 5 "0x05 - Current below normal or open circuit" 4 "0x04 - Voltage below normal or short-circuit to low source" 3 "0x03 - Voltage above normal or short-circuit to high source" 2 "0x02 - Data erratic, intermittent or incorrect" 1 "0x01 - Data valid, but below normal operational range - Most severe level" 0 "0x00 - Data valid, but above normal operational range - Most severe level";
VAL_ 2360125960 LVDT_Sinus_signal 31 "0x1F - Condition exists" 30 "0x1E - Stuck Closed" 29 "0x1D - Stuck Open" 28 "0x1C - Not in neutral at Power-up" 27 "0x1B - Unable to return to neutral" 26 "0x1A - No steering" 25 "0x19 - Signal crosscheck failed" 24 "0x18 - Reserved" 23 "0x17 - Unintended Steering" 22 "0x16 - Message missing" 21 "0x15 - Data drifted low" 20 "0x14 - Data drifted high" 19 "0x13 - Received network data in error" 18 "0x12 - Data valid, but below normal operating range - Moderately severe level" 17 "0x11 - Data valid, but below normal operating range - Least severe level" 16 "0x10 - Data valid, but above normal operating range - Moderately severe level" 15 "0x0F - Data valid, but above normal operating range - Least severe level" 14 "0x0E - Special instructions" 13 "0x0D - Out of calibration" 12 "0x0C - Bad intelligent device or component" 11 "0x0B - Unknown root-cause" 10 "0x0A - Abnormal rate of change" 9 "0x09 - Abnormal update rate" 8 "0x08 - Abnormal frequency or pulse width or period" 7 "0x07 - Mechanical system not responding or out of adjustement" 6 "0x06 - Current above normal or grounded circuit" 5 "0x05 - Current below normal or open circuit" 4 "0x04 - Voltage below normal or short-circuit to low source" 3 "0x03 - Voltage above normal or short-circuit to high source" 2 "0x02 - Data erratic, intermittent or incorrect" 1 "0x01 - Data valid, but below normal operational range - Most severe level" 0 "0x00 - Data valid, but above normal operational range - Most severe level";
VAL_ 2360125960 LVDT_calculation 31 "0x1F - Condition exists" 30 "0x1E - Stuck Closed" 29 "0x1D - Stuck Open" 28 "0x1C - Not in neutral at Power-up" 27 "0x1B - Unable to return to neutral" 26 "0x1A - No steering" 25 "0x19 - Signal crosscheck failed" 24 "0x18 - Reserved" 23 "0x17 - Unintended Steering" 22 "0x16 - Message missing" 21 "0x15 - Data drifted low" 20 "0x14 - Data drifted high" 19 "0x13 - Received network data in error" 18 "0x12 - Data valid, but below normal operating range - Moderately severe level" 17 "0x11 - Data valid, but below normal operating range - Least severe level" 16 "0x10 - Data valid, but above normal operating range - Moderately severe level" 15 "0x0F - Data valid, but above normal operating range - Least severe level" 14 "0x0E - Special instructions" 13 "0x0D - Out of calibration" 12 "0x0C - Bad intelligent device or component" 11 "0x0B - Unknown root-cause" 10 "0x0A - Abnormal rate of change" 9 "0x09 - Abnormal update rate" 8 "0x08 - Abnormal frequency or pulse width or period" 7 "0x07 - Mechanical system not responding or out of adjustement" 6 "0x06 - Current above normal or grounded circuit" 5 "0x05 - Current below normal or open circuit" 4 "0x04 - Voltage below normal or short-circuit to low source" 3 "0x03 - Voltage above normal or short-circuit to high source" 2 "0x02 - Data erratic, intermittent or incorrect" 1 "0x01 - Data valid, but below normal operational range - Most severe level" 0 "0x00 - Data valid, but above normal operational range - Most severe level";
VAL_ 2360125960 LVDT_demod_A 31 "0x1F - Condition exists" 30 "0x1E - Stuck Closed" 29 "0x1D - Stuck Open" 28 "0x1C - Not in neutral at Power-up" 27 "0x1B - Unable to return to neutral" 26 "0x1A - No steering" 25 "0x19 - Signal crosscheck failed" 24 "0x18 - Reserved" 23 "0x17 - Unintended Steering" 22 "0x16 - Message missing" 21 "0x15 - Data drifted low" 20 "0x14 - Data drifted high" 19 "0x13 - Received network data in error" 18 "0x12 - Data valid, but below normal operating range - Moderately severe level" 17 "0x11 - Data valid, but below normal operating range - Least severe level" 16 "0x10 - Data valid, but above normal operating range - Moderately severe level" 15 "0x0F - Data valid, but above normal operating range - Least severe level" 14 "0x0E - Special instructions" 13 "0x0D - Out of calibration" 12 "0x0C - Bad intelligent device or component" 11 "0x0B - Unknown root-cause" 10 "0x0A - Abnormal rate of change" 9 "0x09 - Abnormal update rate" 8 "0x08 - Abnormal frequency or pulse width or period" 7 "0x07 - Mechanical system not responding or out of adjustement" 6 "0x06 - Current above normal or grounded circuit" 5 "0x05 - Current below normal or open circuit" 4 "0x04 - Voltage below normal or short-circuit to low source" 3 "0x03 - Voltage above normal or short-circuit to high source" 2 "0x02 - Data erratic, intermittent or incorrect" 1 "0x01 - Data valid, but below normal operational range - Most severe level" 0 "0x00 - Data valid, but above normal operational range - Most severe level";
VAL_ 2360125960 LVDT_demod_B 31 "0x1F - Condition exists" 30 "0x1E - Stuck Closed" 29 "0x1D - Stuck Open" 28 "0x1C - Not in neutral at Power-up" 27 "0x1B - Unable to return to neutral" 26 "0x1A - No steering" 25 "0x19 - Signal crosscheck failed" 24 "0x18 - Reserved" 23 "0x17 - Unintended Steering" 22 "0x16 - Message missing" 21 "0x15 - Data drifted low" 20 "0x14 - Data drifted high" 19 "0x13 - Received network data in error" 18 "0x12 - Data valid, but below normal operating range - Moderately severe level" 17 "0x11 - Data valid, but below normal operating range - Least severe level" 16 "0x10 - Data valid, but above normal operating range - Moderately severe level" 15 "0x0F - Data valid, but above normal operating range - Least severe level" 14 "0x0E - Special instructions" 13 "0x0D - Out of calibration" 12 "0x0C - Bad intelligent device or component" 11 "0x0B - Unknown root-cause" 10 "0x0A - Abnormal rate of change" 9 "0x09 - Abnormal update rate" 8 "0x08 - Abnormal frequency or pulse width or period" 7 "0x07 - Mechanical system not responding or out of adjustement" 6 "0x06 - Current above normal or grounded circuit" 5 "0x05 - Current below normal or open circuit" 4 "0x04 - Voltage below normal or short-circuit to low source" 3 "0x03 - Voltage above normal or short-circuit to high source" 2 "0x02 - Data erratic, intermittent or incorrect" 1 "0x01 - Data valid, but below normal operational range - Most severe level" 0 "0x00 - Data valid, but above normal operational range - Most severe level";
VAL_ 2360125960 MMI 31 "0x1F - Condition exists" 30 "0x1E - Stuck Closed" 29 "0x1D - Stuck Open" 28 "0x1C - Not in neutral at Power-up" 27 "0x1B - Unable to return to neutral" 26 "0x1A - No steering" 25 "0x19 - Signal crosscheck failed" 24 "0x18 - Reserved" 23 "0x17 - Unintended Steering" 22 "0x16 - Message missing" 21 "0x15 - Data drifted low" 20 "0x14 - Data drifted high" 19 "0x13 - Received network data in error" 18 "0x12 - Data valid, but below normal operating range - Moderately severe level" 17 "0x11 - Data valid, but below normal operating range - Least severe level" 16 "0x10 - Data valid, but above normal operating range - Moderately severe level" 15 "0x0F - Data valid, but above normal operating range - Least severe level" 14 "0x0E - Special instructions" 13 "0x0D - Out of calibration" 12 "0x0C - Bad intelligent device or component" 11 "0x0B - Unknown root-cause" 10 "0x0A - Abnormal rate of change" 9 "0x09 - Abnormal update rate" 8 "0x08 - Abnormal frequency or pulse width or period" 7 "0x07 - Mechanical system not responding or out of adjustement" 6 "0x06 - Current above normal or grounded circuit" 5 "0x05 - Current below normal or open circuit" 4 "0x04 - Voltage below normal or short-circuit to low source" 3 "0x03 - Voltage above normal or short-circuit to high source" 2 "0x02 - Data erratic, intermittent or incorrect" 1 "0x01 - Data valid, but below normal operational range - Most severe level" 0 "0x00 - Data valid, but above normal operational range - Most severe level";
VAL_ 2360125960 MMI_flag_crosscheck 31 "0x1F - Condition exists" 30 "0x1E - Stuck Closed" 29 "0x1D - Stuck Open" 28 "0x1C - Not in neutral at Power-up" 27 "0x1B - Unable to return to neutral" 26 "0x1A - No steering" 25 "0x19 - Signal crosscheck failed" 24 "0x18 - Reserved" 23 "0x17 - Unintended Steering" 22 "0x16 - Message missing" 21 "0x15 - Data drifted low" 20 "0x14 - Data drifted high" 19 "0x13 - Received network data in error" 18 "0x12 - Data valid, but below normal operating range - Moderately severe level" 17 "0x11 - Data valid, but below normal operating range - Least severe level" 16 "0x10 - Data valid, but above normal operating range - Moderately severe level" 15 "0x0F - Data valid, but above normal operating range - Least severe level" 14 "0x0E - Special instructions" 13 "0x0D - Out of calibration" 12 "0x0C - Bad intelligent device or component" 11 "0x0B - Unknown root-cause" 10 "0x0A - Abnormal rate of change" 9 "0x09 - Abnormal update rate" 8 "0x08 - Abnormal frequency or pulse width or period" 7 "0x07 - Mechanical system not responding or out of adjustement" 6 "0x06 - Current above normal or grounded circuit" 5 "0x05 - Current below normal or open circuit" 4 "0x04 - Voltage below normal or short-circuit to low source" 3 "0x03 - Voltage above normal or short-circuit to high source" 2 "0x02 - Data erratic, intermittent or incorrect" 1 "0x01 - Data valid, but below normal operational range - Most severe level" 0 "0x00 - Data valid, but above normal operational range - Most severe level";
VAL_ 2360125960 Overvoltage_supervisor 31 "0x1F - Condition exists" 30 "0x1E - Stuck Closed" 29 "0x1D - Stuck Open" 28 "0x1C - Not in neutral at Power-up" 27 "0x1B - Unable to return to neutral" 26 "0x1A - No steering" 25 "0x19 - Signal crosscheck failed" 24 "0x18 - Reserved" 23 "0x17 - Unintended Steering" 22 "0x16 - Message missing" 21 "0x15 - Data drifted low" 20 "0x14 - Data drifted high" 19 "0x13 - Received network data in error" 18 "0x12 - Data valid, but below normal operating range - Moderately severe level" 17 "0x11 - Data valid, but below normal operating range - Least severe level" 16 "0x10 - Data valid, but above normal operating range - Moderately severe level" 15 "0x0F - Data valid, but above normal operating range - Least severe level" 14 "0x0E - Special instructions" 13 "0x0D - Out of calibration" 12 "0x0C - Bad intelligent device or component" 11 "0x0B - Unknown root-cause" 10 "0x0A - Abnormal rate of change" 9 "0x09 - Abnormal update rate" 8 "0x08 - Abnormal frequency or pulse width or period" 7 "0x07 - Mechanical system not responding or out of adjustement" 6 "0x06 - Current above normal or grounded circuit" 5 "0x05 - Current below normal or open circuit" 4 "0x04 - Voltage below normal or short-circuit to low source" 3 "0x03 - Voltage above normal or short-circuit to high source" 2 "0x02 - Data erratic, intermittent or incorrect" 1 "0x01 - Data valid, but below normal operational range - Most severe level" 0 "0x00 - Data valid, but above normal operational range - Most severe level";
VAL_ 2360125960 PSM_task 31 "0x1F - Condition exists" 30 "0x1E - Stuck Closed" 29 "0x1D - Stuck Open" 28 "0x1C - Not in neutral at Power-up" 27 "0x1B - Unable to return to neutral" 26 "0x1A - No steering" 25 "0x19 - Signal crosscheck failed" 24 "0x18 - Reserved" 23 "0x17 - Unintended Steering" 22 "0x16 - Message missing" 21 "0x15 - Data drifted low" 20 "0x14 - Data drifted high" 19 "0x13 - Received network data in error" 18 "0x12 - Data valid, but below normal operating range - Moderately severe level" 17 "0x11 - Data valid, but below normal operating range - Least severe level" 16 "0x10 - Data valid, but above normal operating range - Moderately severe level" 15 "0x0F - Data valid, but above normal operating range - Least severe level" 14 "0x0E - Special instructions" 13 "0x0D - Out of calibration" 12 "0x0C - Bad intelligent device or component" 11 "0x0B - Unknown root-cause" 10 "0x0A - Abnormal rate of change" 9 "0x09 - Abnormal update rate" 8 "0x08 - Abnormal frequency or pulse width or period" 7 "0x07 - Mechanical system not responding or out of adjustement" 6 "0x06 - Current above normal or grounded circuit" 5 "0x05 - Current below normal or open circuit" 4 "0x04 - Voltage below normal or short-circuit to low source" 3 "0x03 - Voltage above normal or short-circuit to high source" 2 "0x02 - Data erratic, intermittent or incorrect" 1 "0x01 - Data valid, but below normal operational range - Most severe level" 0 "0x00 - Data valid, but above normal operational range - Most severe level";
VAL_ 2360125960 PVED_CLS_Spare_part 31 "0x1F - Condition exists" 30 "0x1E - Stuck Closed" 29 "0x1D - Stuck Open" 28 "0x1C - Not in neutral at Power-up" 27 "0x1B - Unable to return to neutral" 26 "0x1A - No steering" 25 "0x19 - Signal crosscheck failed" 24 "0x18 - Reserved" 23 "0x17 - Unintended Steering" 22 "0x16 - Message missing" 21 "0x15 - Data drifted low" 20 "0x14 - Data drifted high" 19 "0x13 - Received network data in error" 18 "0x12 - Data valid, but below normal operating range - Moderately severe level" 17 "0x11 - Data valid, but below normal operating range - Least severe level" 16 "0x10 - Data valid, but above normal operating range - Moderately severe level" 15 "0x0F - Data valid, but above normal operating range - Least severe level" 14 "0x0E - Special instructions" 13 "0x0D - Out of calibration" 12 "0x0C - Bad intelligent device or component" 11 "0x0B - Unknown root-cause" 10 "0x0A - Abnormal rate of change" 9 "0x09 - Abnormal update rate" 8 "0x08 - Abnormal frequency or pulse width or period" 7 "0x07 - Mechanical system not responding or out of adjustement" 6 "0x06 - Current above normal or grounded circuit" 5 "0x05 - Current below normal or open circuit" 4 "0x04 - Voltage below normal or short-circuit to low source" 3 "0x03 - Voltage above normal or short-circuit to high source" 2 "0x02 - Data erratic, intermittent or incorrect" 1 "0x01 - Data valid, but below normal operational range - Most severe level" 0 "0x00 - Data valid, but above normal operational range - Most severe level";
VAL_ 2360125960 Plus_5V 31 "0x1F - Condition exists" 30 "0x1E - Stuck Closed" 29 "0x1D - Stuck Open" 28 "0x1C - Not in neutral at Power-up" 27 "0x1B - Unable to return to neutral" 26 "0x1A - No steering" 25 "0x19 - Signal crosscheck failed" 24 "0x18 - Reserved" 23 "0x17 - Unintended Steering" 22 "0x16 - Message missing" 21 "0x15 - Data drifted low" 20 "0x14 - Data drifted high" 19 "0x13 - Received network data in error" 18 "0x12 - Data valid, but below normal operating range - Moderately severe level" 17 "0x11 - Data valid, but below normal operating range - Least severe level" 16 "0x10 - Data valid, but above normal operating range - Moderately severe level" 15 "0x0F - Data valid, but above normal operating range - Least severe level" 14 "0x0E - Special instructions" 13 "0x0D - Out of calibration" 12 "0x0C - Bad intelligent device or component" 11 "0x0B - Unknown root-cause" 10 "0x0A - Abnormal rate of change" 9 "0x09 - Abnormal update rate" 8 "0x08 - Abnormal frequency or pulse width or period" 7 "0x07 - Mechanical system not responding or out of adjustement" 6 "0x06 - Current above normal or grounded circuit" 5 "0x05 - Current below normal or open circuit" 4 "0x04 - Voltage below normal or short-circuit to low source" 3 "0x03 - Voltage above normal or short-circuit to high source" 2 "0x02 - Data erratic, intermittent or incorrect" 1 "0x01 - Data valid, but below normal operational range - Most severe level" 0 "0x00 - Data valid, but above normal operational range - Most severe level";
VAL_ 2360125960 Program_sequence_monitoring 31 "0x1F - Condition exists" 30 "0x1E - Stuck Closed" 29 "0x1D - Stuck Open" 28 "0x1C - Not in neutral at Power-up" 27 "0x1B - Unable to return to neutral" 26 "0x1A - No steering" 25 "0x19 - Signal crosscheck failed" 24 "0x18 - Reserved" 23 "0x17 - Unintended Steering" 22 "0x16 - Message missing" 21 "0x15 - Data drifted low" 20 "0x14 - Data drifted high" 19 "0x13 - Received network data in error" 18 "0x12 - Data valid, but below normal operating range - Moderately severe level" 17 "0x11 - Data valid, but below normal operating range - Least severe level" 16 "0x10 - Data valid, but above normal operating range - Moderately severe level" 15 "0x0F - Data valid, but above normal operating range - Least severe level" 14 "0x0E - Special instructions" 13 "0x0D - Out of calibration" 12 "0x0C - Bad intelligent device or component" 11 "0x0B - Unknown root-cause" 10 "0x0A - Abnormal rate of change" 9 "0x09 - Abnormal update rate" 8 "0x08 - Abnormal frequency or pulse width or period" 7 "0x07 - Mechanical system not responding or out of adjustement" 6 "0x06 - Current above normal or grounded circuit" 5 "0x05 - Current below normal or open circuit" 4 "0x04 - Voltage below normal or short-circuit to low source" 3 "0x03 - Voltage above normal or short-circuit to high source" 2 "0x02 - Data erratic, intermittent or incorrect" 1 "0x01 - Data valid, but below normal operational range - Most severe level" 0 "0x00 - Data valid, but above normal operational range - Most severe level";
VAL_ 2360125960 RAM_Test 31 "0x1F - Condition exists" 30 "0x1E - Stuck Closed" 29 "0x1D - Stuck Open" 28 "0x1C - Not in neutral at Power-up" 27 "0x1B - Unable to return to neutral" 26 "0x1A - No steering" 25 "0x19 - Signal crosscheck failed" 24 "0x18 - Reserved" 23 "0x17 - Unintended Steering" 22 "0x16 - Message missing" 21 "0x15 - Data drifted low" 20 "0x14 - Data drifted high" 19 "0x13 - Received network data in error" 18 "0x12 - Data valid, but below normal operating range - Moderately severe level" 17 "0x11 - Data valid, but below normal operating range - Least severe level" 16 "0x10 - Data valid, but above normal operating range - Moderately severe level" 15 "0x0F - Data valid, but above normal operating range - Least severe level" 14 "0x0E - Special instructions" 13 "0x0D - Out of calibration" 12 "0x0C - Bad intelligent device or component" 11 "0x0B - Unknown root-cause" 10 "0x0A - Abnormal rate of change" 9 "0x09 - Abnormal update rate" 8 "0x08 - Abnormal frequency or pulse width or period" 7 "0x07 - Mechanical system not responding or out of adjustement" 6 "0x06 - Current above normal or grounded circuit" 5 "0x05 - Current below normal or open circuit" 4 "0x04 - Voltage below normal or short-circuit to low source" 3 "0x03 - Voltage above normal or short-circuit to high source" 2 "0x02 - Data erratic, intermittent or incorrect" 1 "0x01 - Data valid, but below normal operational range - Most severe level" 0 "0x00 - Data valid, but above normal operational range - Most severe level";
VAL_ 2360125960 Road_Switch_Res_Monitoring 31 "0x1F - Condition exists" 30 "0x1E - Stuck Closed" 29 "0x1D - Stuck Open" 28 "0x1C - Not in neutral at Power-up" 27 "0x1B - Unable to return to neutral" 26 "0x1A - No steering" 25 "0x19 - Signal crosscheck failed" 24 "0x18 - Reserved" 23 "0x17 - Unintended Steering" 22 "0x16 - Message missing" 21 "0x15 - Data drifted low" 20 "0x14 - Data drifted high" 19 "0x13 - Received network data in error" 18 "0x12 - Data valid, but below normal operating range - Moderately severe level" 17 "0x11 - Data valid, but below normal operating range - Least severe level" 16 "0x10 - Data valid, but above normal operating range - Moderately severe level" 15 "0x0F - Data valid, but above normal operating range - Least severe level" 14 "0x0E - Special instructions" 13 "0x0D - Out of calibration" 12 "0x0C - Bad intelligent device or component" 11 "0x0B - Unknown root-cause" 10 "0x0A - Abnormal rate of change" 9 "0x09 - Abnormal update rate" 8 "0x08 - Abnormal frequency or pulse width or period" 7 "0x07 - Mechanical system not responding or out of adjustement" 6 "0x06 - Current above normal or grounded circuit" 5 "0x05 - Current below normal or open circuit" 4 "0x04 - Voltage below normal or short-circuit to low source" 3 "0x03 - Voltage above normal or short-circuit to high source" 2 "0x02 - Data erratic, intermittent or incorrect" 1 "0x01 - Data valid, but below normal operational range - Most severe level" 0 "0x00 - Data valid, but above normal operational range - Most severe level";
VAL_ 2360125960 SASA_Steering_sensor 31 "0x1F - Condition exists" 30 "0x1E - Stuck Closed" 29 "0x1D - Stuck Open" 28 "0x1C - Not in neutral at Power-up" 27 "0x1B - Unable to return to neutral" 26 "0x1A - No steering" 25 "0x19 - Signal crosscheck failed" 24 "0x18 - Reserved" 23 "0x17 - Unintended Steering" 22 "0x16 - Message missing" 21 "0x15 - Data drifted low" 20 "0x14 - Data drifted high" 19 "0x13 - Received network data in error" 18 "0x12 - Data valid, but below normal operating range - Moderately severe level" 17 "0x11 - Data valid, but below normal operating range - Least severe level" 16 "0x10 - Data valid, but above normal operating range - Moderately severe level" 15 "0x0F - Data valid, but above normal operating range - Least severe level" 14 "0x0E - Special instructions" 13 "0x0D - Out of calibration" 12 "0x0C - Bad intelligent device or component" 11 "0x0B - Unknown root-cause" 10 "0x0A - Abnormal rate of change" 9 "0x09 - Abnormal update rate" 8 "0x08 - Abnormal frequency or pulse width or period" 7 "0x07 - Mechanical system not responding or out of adjustement" 6 "0x06 - Current above normal or grounded circuit" 5 "0x05 - Current below normal or open circuit" 4 "0x04 - Voltage below normal or short-circuit to low source" 3 "0x03 - Voltage above normal or short-circuit to high source" 2 "0x02 - Data erratic, intermittent or incorrect" 1 "0x01 - Data valid, but below normal operational range - Most severe level" 0 "0x00 - Data valid, but above normal operational range - Most severe level";
VAL_ 2360125960 SPI_communication 31 "0x1F - Condition exists" 30 "0x1E - Stuck Closed" 29 "0x1D - Stuck Open" 28 "0x1C - Not in neutral at Power-up" 27 "0x1B - Unable to return to neutral" 26 "0x1A - No steering" 25 "0x19 - Signal crosscheck failed" 24 "0x18 - Reserved" 23 "0x17 - Unintended Steering" 22 "0x16 - Message missing" 21 "0x15 - Data drifted low" 20 "0x14 - Data drifted high" 19 "0x13 - Received network data in error" 18 "0x12 - Data valid, but below normal operating range - Moderately severe level" 17 "0x11 - Data valid, but below normal operating range - Least severe level" 16 "0x10 - Data valid, but above normal operating range - Moderately severe level" 15 "0x0F - Data valid, but above normal operating range - Least severe level" 14 "0x0E - Special instructions" 13 "0x0D - Out of calibration" 12 "0x0C - Bad intelligent device or component" 11 "0x0B - Unknown root-cause" 10 "0x0A - Abnormal rate of change" 9 "0x09 - Abnormal update rate" 8 "0x08 - Abnormal frequency or pulse width or period" 7 "0x07 - Mechanical system not responding or out of adjustement" 6 "0x06 - Current above normal or grounded circuit" 5 "0x05 - Current below normal or open circuit" 4 "0x04 - Voltage below normal or short-circuit to low source" 3 "0x03 - Voltage above normal or short-circuit to high source" 2 "0x02 - Data erratic, intermittent or incorrect" 1 "0x01 - Data valid, but below normal operational range - Most severe level" 0 "0x00 - Data valid, but above normal operational range - Most severe level";
VAL_ 2360125960 STW_sensor_Position_crosscheck 31 "0x1F - Condition exists" 30 "0x1E - Stuck Closed" 29 "0x1D - Stuck Open" 28 "0x1C - Not in neutral at Power-up" 27 "0x1B - Unable to return to neutral" 26 "0x1A - No steering" 25 "0x19 - Signal crosscheck failed" 24 "0x18 - Reserved" 23 "0x17 - Unintended Steering" 22 "0x16 - Message missing" 21 "0x15 - Data drifted low" 20 "0x14 - Data drifted high" 19 "0x13 - Received network data in error" 18 "0x12 - Data valid, but below normal operating range - Moderately severe level" 17 "0x11 - Data valid, but below normal operating range - Least severe level" 16 "0x10 - Data valid, but above normal operating range - Moderately severe level" 15 "0x0F - Data valid, but above normal operating range - Least severe level" 14 "0x0E - Special instructions" 13 "0x0D - Out of calibration" 12 "0x0C - Bad intelligent device or component" 11 "0x0B - Unknown root-cause" 10 "0x0A - Abnormal rate of change" 9 "0x09 - Abnormal update rate" 8 "0x08 - Abnormal frequency or pulse width or period" 7 "0x07 - Mechanical system not responding or out of adjustement" 6 "0x06 - Current above normal or grounded circuit" 5 "0x05 - Current below normal or open circuit" 4 "0x04 - Voltage below normal or short-circuit to low source" 3 "0x03 - Voltage above normal or short-circuit to high source" 2 "0x02 - Data erratic, intermittent or incorrect" 1 "0x01 - Data valid, but below normal operational range - Most severe level" 0 "0x00 - Data valid, but above normal operational range - Most severe level";
VAL_ 2360125960 STW_sensor_Speed_crosscheck 31 "0x1F - Condition exists" 30 "0x1E - Stuck Closed" 29 "0x1D - Stuck Open" 28 "0x1C - Not in neutral at Power-up" 27 "0x1B - Unable to return to neutral" 26 "0x1A - No steering" 25 "0x19 - Signal crosscheck failed" 24 "0x18 - Reserved" 23 "0x17 - Unintended Steering" 22 "0x16 - Message missing" 21 "0x15 - Data drifted low" 20 "0x14 - Data drifted high" 19 "0x13 - Received network data in error" 18 "0x12 - Data valid, but below normal operating range - Moderately severe level" 17 "0x11 - Data valid, but below normal operating range - Least severe level" 16 "0x10 - Data valid, but above normal operating range - Moderately severe level" 15 "0x0F - Data valid, but above normal operating range - Least severe level" 14 "0x0E - Special instructions" 13 "0x0D - Out of calibration" 12 "0x0C - Bad intelligent device or component" 11 "0x0B - Unknown root-cause" 10 "0x0A - Abnormal rate of change" 9 "0x09 - Abnormal update rate" 8 "0x08 - Abnormal frequency or pulse width or period" 7 "0x07 - Mechanical system not responding or out of adjustement" 6 "0x06 - Current above normal or grounded circuit" 5 "0x05 - Current below normal or open circuit" 4 "0x04 - Voltage below normal or short-circuit to low source" 3 "0x03 - Voltage above normal or short-circuit to high source" 2 "0x02 - Data erratic, intermittent or incorrect" 1 "0x01 - Data valid, but below normal operational range - Most severe level" 0 "0x00 - Data valid, but above normal operational range - Most severe level";
VAL_ 2360125960 SVC_Parameters 31 "0x1F - Condition exists" 30 "0x1E - Stuck Closed" 29 "0x1D - Stuck Open" 28 "0x1C - Not in neutral at Power-up" 27 "0x1B - Unable to return to neutral" 26 "0x1A - No steering" 25 "0x19 - Signal crosscheck failed" 24 "0x18 - Reserved" 23 "0x17 - Unintended Steering" 22 "0x16 - Message missing" 21 "0x15 - Data drifted low" 20 "0x14 - Data drifted high" 19 "0x13 - Received network data in error" 18 "0x12 - Data valid, but below normal operating range - Moderately severe level" 17 "0x11 - Data valid, but below normal operating range - Least severe level" 16 "0x10 - Data valid, but above normal operating range - Moderately severe level" 15 "0x0F - Data valid, but above normal operating range - Least severe level" 14 "0x0E - Special instructions" 13 "0x0D - Out of calibration" 12 "0x0C - Bad intelligent device or component" 11 "0x0B - Unknown root-cause" 10 "0x0A - Abnormal rate of change" 9 "0x09 - Abnormal update rate" 8 "0x08 - Abnormal frequency or pulse width or period" 7 "0x07 - Mechanical system not responding or out of adjustement" 6 "0x06 - Current above normal or grounded circuit" 5 "0x05 - Current below normal or open circuit" 4 "0x04 - Voltage below normal or short-circuit to low source" 3 "0x03 - Voltage above normal or short-circuit to high source" 2 "0x02 - Data erratic, intermittent or incorrect" 1 "0x01 - Data valid, but below normal operational range - Most severe level" 0 "0x00 - Data valid, but above normal operational range - Most severe level";
VAL_ 2360125960 Safe_On_Road_Monitoring 31 "0x1F - Condition exists" 30 "0x1E - Stuck Closed" 29 "0x1D - Stuck Open" 28 "0x1C - Not in neutral at Power-up" 27 "0x1B - Unable to return to neutral" 26 "0x1A - No steering" 25 "0x19 - Signal crosscheck failed" 24 "0x18 - Reserved" 23 "0x17 - Unintended Steering" 22 "0x16 - Message missing" 21 "0x15 - Data drifted low" 20 "0x14 - Data drifted high" 19 "0x13 - Received network data in error" 18 "0x12 - Data valid, but below normal operating range - Moderately severe level" 17 "0x11 - Data valid, but below normal operating range - Least severe level" 16 "0x10 - Data valid, but above normal operating range - Moderately severe level" 15 "0x0F - Data valid, but above normal operating range - Least severe level" 14 "0x0E - Special instructions" 13 "0x0D - Out of calibration" 12 "0x0C - Bad intelligent device or component" 11 "0x0B - Unknown root-cause" 10 "0x0A - Abnormal rate of change" 9 "0x09 - Abnormal update rate" 8 "0x08 - Abnormal frequency or pulse width or period" 7 "0x07 - Mechanical system not responding or out of adjustement" 6 "0x06 - Current above normal or grounded circuit" 5 "0x05 - Current below normal or open circuit" 4 "0x04 - Voltage below normal or short-circuit to low source" 3 "0x03 - Voltage above normal or short-circuit to high source" 2 "0x02 - Data erratic, intermittent or incorrect" 1 "0x01 - Data valid, but below normal operational range - Most severe level" 0 "0x00 - Data valid, but above normal operational range - Most severe level";
VAL_ 2360125960 Sensor_5V 31 "0x1F - Condition exists" 30 "0x1E - Stuck Closed" 29 "0x1D - Stuck Open" 28 "0x1C - Not in neutral at Power-up" 27 "0x1B - Unable to return to neutral" 26 "0x1A - No steering" 25 "0x19 - Signal crosscheck failed" 24 "0x18 - Reserved" 23 "0x17 - Unintended Steering" 22 "0x16 - Message missing" 21 "0x15 - Data drifted low" 20 "0x14 - Data drifted high" 19 "0x13 - Received network data in error" 18 "0x12 - Data valid, but below normal operating range - Moderately severe level" 17 "0x11 - Data valid, but below normal operating range - Least severe level" 16 "0x10 - Data valid, but above normal operating range - Moderately severe level" 15 "0x0F - Data valid, but above normal operating range - Least severe level" 14 "0x0E - Special instructions" 13 "0x0D - Out of calibration" 12 "0x0C - Bad intelligent device or component" 11 "0x0B - Unknown root-cause" 10 "0x0A - Abnormal rate of change" 9 "0x09 - Abnormal update rate" 8 "0x08 - Abnormal frequency or pulse width or period" 7 "0x07 - Mechanical system not responding or out of adjustement" 6 "0x06 - Current above normal or grounded circuit" 5 "0x05 - Current below normal or open circuit" 4 "0x04 - Voltage below normal or short-circuit to low source" 3 "0x03 - Voltage above normal or short-circuit to high source" 2 "0x02 - Data erratic, intermittent or incorrect" 1 "0x01 - Data valid, but below normal operational range - Most severe level" 0 "0x00 - Data valid, but above normal operational range - Most severe level";
VAL_ 2360125960 Soft_Error 31 "0x1F - Condition exists" 30 "0x1E - Stuck Closed" 29 "0x1D - Stuck Open" 28 "0x1C - Not in neutral at Power-up" 27 "0x1B - Unable to return to neutral" 26 "0x1A - No steering" 25 "0x19 - Signal crosscheck failed" 24 "0x18 - Reserved" 23 "0x17 - Unintended Steering" 22 "0x16 - Message missing" 21 "0x15 - Data drifted low" 20 "0x14 - Data drifted high" 19 "0x13 - Received network data in error" 18 "0x12 - Data valid, but below normal operating range - Moderately severe level" 17 "0x11 - Data valid, but below normal operating range - Least severe level" 16 "0x10 - Data valid, but above normal operating range - Moderately severe level" 15 "0x0F - Data valid, but above normal operating range - Least severe level" 14 "0x0E - Special instructions" 13 "0x0D - Out of calibration" 12 "0x0C - Bad intelligent device or component" 11 "0x0B - Unknown root-cause" 10 "0x0A - Abnormal rate of change" 9 "0x09 - Abnormal update rate" 8 "0x08 - Abnormal frequency or pulse width or period" 7 "0x07 - Mechanical system not responding or out of adjustement" 6 "0x06 - Current above normal or grounded circuit" 5 "0x05 - Current below normal or open circuit" 4 "0x04 - Voltage below normal or short-circuit to low source" 3 "0x03 - Voltage above normal or short-circuit to high source" 2 "0x02 - Data erratic, intermittent or incorrect" 1 "0x01 - Data valid, but below normal operational range - Most severe level" 0 "0x00 - Data valid, but above normal operational range - Most severe level";
VAL_ 2360125960 Software_Mismatch 31 "0x1F - Condition exists" 30 "0x1E - Stuck Closed" 29 "0x1D - Stuck Open" 28 "0x1C - Not in neutral at Power-up" 27 "0x1B - Unable to return to neutral" 26 "0x1A - No steering" 25 "0x19 - Signal crosscheck failed" 24 "0x18 - Reserved" 23 "0x17 - Unintended Steering" 22 "0x16 - Message missing" 21 "0x15 - Data drifted low" 20 "0x14 - Data drifted high" 19 "0x13 - Received network data in error" 18 "0x12 - Data valid, but below normal operating range - Moderately severe level" 17 "0x11 - Data valid, but below normal operating range - Least severe level" 16 "0x10 - Data valid, but above normal operating range - Moderately severe level" 15 "0x0F - Data valid, but above normal operating range - Least severe level" 14 "0x0E - Special instructions" 13 "0x0D - Out of calibration" 12 "0x0C - Bad intelligent device or component" 11 "0x0B - Unknown root-cause" 10 "0x0A - Abnormal rate of change" 9 "0x09 - Abnormal update rate" 8 "0x08 - Abnormal frequency or pulse width or period" 7 "0x07 - Mechanical system not responding or out of adjustement" 6 "0x06 - Current above normal or grounded circuit" 5 "0x05 - Current below normal or open circuit" 4 "0x04 - Voltage below normal or short-circuit to low source" 3 "0x03 - Voltage above normal or short-circuit to high source" 2 "0x02 - Data erratic, intermittent or incorrect" 1 "0x01 - Data valid, but below normal operational range - Most severe level" 0 "0x00 - Data valid, but above normal operational range - Most severe level";
VAL_ 2360125960 Software_initialisation 31 "0x1F - Condition exists" 30 "0x1E - Stuck Closed" 29 "0x1D - Stuck Open" 28 "0x1C - Not in neutral at Power-up" 27 "0x1B - Unable to return to neutral" 26 "0x1A - No steering" 25 "0x19 - Signal crosscheck failed" 24 "0x18 - Reserved" 23 "0x17 - Unintended Steering" 22 "0x16 - Message missing" 21 "0x15 - Data drifted low" 20 "0x14 - Data drifted high" 19 "0x13 - Received network data in error" 18 "0x12 - Data valid, but below normal operating range - Moderately severe level" 17 "0x11 - Data valid, but below normal operating range - Least severe level" 16 "0x10 - Data valid, but above normal operating range - Moderately severe level" 15 "0x0F - Data valid, but above normal operating range - Least severe level" 14 "0x0E - Special instructions" 13 "0x0D - Out of calibration" 12 "0x0C - Bad intelligent device or component" 11 "0x0B - Unknown root-cause" 10 "0x0A - Abnormal rate of change" 9 "0x09 - Abnormal update rate" 8 "0x08 - Abnormal frequency or pulse width or period" 7 "0x07 - Mechanical system not responding or out of adjustement" 6 "0x06 - Current above normal or grounded circuit" 5 "0x05 - Current below normal or open circuit" 4 "0x04 - Voltage below normal or short-circuit to low source" 3 "0x03 - Voltage above normal or short-circuit to high source" 2 "0x02 - Data erratic, intermittent or incorrect" 1 "0x01 - Data valid, but below normal operational range - Most severe level" 0 "0x00 - Data valid, but above normal operational range - Most severe level";
VAL_ 2360125960 Temperature_Sensor 31 "0x1F - Condition exists" 30 "0x1E - Stuck Closed" 29 "0x1D - Stuck Open" 28 "0x1C - Not in neutral at Power-up" 27 "0x1B - Unable to return to neutral" 26 "0x1A - No steering" 25 "0x19 - Signal crosscheck failed" 24 "0x18 - Reserved" 23 "0x17 - Unintended Steering" 22 "0x16 - Message missing" 21 "0x15 - Data drifted low" 20 "0x14 - Data drifted high" 19 "0x13 - Received network data in error" 18 "0x12 - Data valid, but below normal operating range - Moderately severe level" 17 "0x11 - Data valid, but below normal operating range - Least severe level" 16 "0x10 - Data valid, but above normal operating range - Moderately severe level" 15 "0x0F - Data valid, but above normal operating range - Least severe level" 14 "0x0E - Special instructions" 13 "0x0D - Out of calibration" 12 "0x0C - Bad intelligent device or component" 11 "0x0B - Unknown root-cause" 10 "0x0A - Abnormal rate of change" 9 "0x09 - Abnormal update rate" 8 "0x08 - Abnormal frequency or pulse width or period" 7 "0x07 - Mechanical system not responding or out of adjustement" 6 "0x06 - Current above normal or grounded circuit" 5 "0x05 - Current below normal or open circuit" 4 "0x04 - Voltage below normal or short-circuit to low source" 3 "0x03 - Voltage above normal or short-circuit to high source" 2 "0x02 - Data erratic, intermittent or incorrect" 1 "0x01 - Data valid, but below normal operational range - Most severe level" 0 "0x00 - Data valid, but above normal operational range - Most severe level";
VAL_ 2360125960 Too_many_errors 31 "0x1F - Condition exists" 30 "0x1E - Stuck Closed" 29 "0x1D - Stuck Open" 28 "0x1C - Not in neutral at Power-up" 27 "0x1B - Unable to return to neutral" 26 "0x1A - No steering" 25 "0x19 - Signal crosscheck failed" 24 "0x18 - Reserved" 23 "0x17 - Unintended Steering" 22 "0x16 - Message missing" 21 "0x15 - Data drifted low" 20 "0x14 - Data drifted high" 19 "0x13 - Received network data in error" 18 "0x12 - Data valid, but below normal operating range - Moderately severe level" 17 "0x11 - Data valid, but below normal operating range - Least severe level" 16 "0x10 - Data valid, but above normal operating range - Moderately severe level" 15 "0x0F - Data valid, but above normal operating range - Least severe level" 14 "0x0E - Special instructions" 13 "0x0D - Out of calibration" 12 "0x0C - Bad intelligent device or component" 11 "0x0B - Unknown root-cause" 10 "0x0A - Abnormal rate of change" 9 "0x09 - Abnormal update rate" 8 "0x08 - Abnormal frequency or pulse width or period" 7 "0x07 - Mechanical system not responding or out of adjustement" 6 "0x06 - Current above normal or grounded circuit" 5 "0x05 - Current below normal or open circuit" 4 "0x04 - Voltage below normal or short-circuit to low source" 3 "0x03 - Voltage above normal or short-circuit to high source" 2 "0x02 - Data erratic, intermittent or incorrect" 1 "0x01 - Data valid, but below normal operational range - Most severe level" 0 "0x00 - Data valid, but above normal operational range - Most severe level";
VAL_ 2360125960 Variable_truncation 31 "0x1F - Condition exists" 30 "0x1E - Stuck Closed" 29 "0x1D - Stuck Open" 28 "0x1C - Not in neutral at Power-up" 27 "0x1B - Unable to return to neutral" 26 "0x1A - No steering" 25 "0x19 - Signal crosscheck failed" 24 "0x18 - Reserved" 23 "0x17 - Unintended Steering" 22 "0x16 - Message missing" 21 "0x15 - Data drifted low" 20 "0x14 - Data drifted high" 19 "0x13 - Received network data in error" 18 "0x12 - Data valid, but below normal operating range - Moderately severe level" 17 "0x11 - Data valid, but below normal operating range - Least severe level" 16 "0x10 - Data valid, but above normal operating range - Moderately severe level" 15 "0x0F - Data valid, but above normal operating range - Least severe level" 14 "0x0E - Special instructions" 13 "0x0D - Out of calibration" 12 "0x0C - Bad intelligent device or component" 11 "0x0B - Unknown root-cause" 10 "0x0A - Abnormal rate of change" 9 "0x09 - Abnormal update rate" 8 "0x08 - Abnormal frequency or pulse width or period" 7 "0x07 - Mechanical system not responding or out of adjustement" 6 "0x06 - Current above normal or grounded circuit" 5 "0x05 - Current below normal or open circuit" 4 "0x04 - Voltage below normal or short-circuit to low source" 3 "0x03 - Voltage above normal or short-circuit to high source" 2 "0x02 - Data erratic, intermittent or incorrect" 1 "0x01 - Data valid, but below normal operational range - Most severe level" 0 "0x00 - Data valid, but above normal operational range - Most severe level";
VAL_ 2360125960 Vbat 31 "0x1F - Condition exists" 30 "0x1E - Stuck Closed" 29 "0x1D - Stuck Open" 28 "0x1C - Not in neutral at Power-up" 27 "0x1B - Unable to return to neutral" 26 "0x1A - No steering" 25 "0x19 - Signal crosscheck failed" 24 "0x18 - Reserved" 23 "0x17 - Unintended Steering" 22 "0x16 - Message missing" 21 "0x15 - Data drifted low" 20 "0x14 - Data drifted high" 19 "0x13 - Received network data in error" 18 "0x12 - Data valid, but below normal operating range - Moderately severe level" 17 "0x11 - Data valid, but below normal operating range - Least severe level" 16 "0x10 - Data valid, but above normal operating range - Moderately severe level" 15 "0x0F - Data valid, but above normal operating range - Least severe level" 14 "0x0E - Special instructions" 13 "0x0D - Out of calibration" 12 "0x0C - Bad intelligent device or component" 11 "0x0B - Unknown root-cause" 10 "0x0A - Abnormal rate of change" 9 "0x09 - Abnormal update rate" 8 "0x08 - Abnormal frequency or pulse width or period" 7 "0x07 - Mechanical system not responding or out of adjustement" 6 "0x06 - Current above normal or grounded circuit" 5 "0x05 - Current below normal or open circuit" 4 "0x04 - Voltage below normal or short-circuit to low source" 3 "0x03 - Voltage above normal or short-circuit to high source" 2 "0x02 - Data erratic, intermittent or incorrect" 1 "0x01 - Data valid, but below normal operational range - Most severe level" 0 "0x00 - Data valid, but above normal operational range - Most severe level";
VAL_ 2360125960 Vehicle_Speed_sensor_speed_cross 31 "0x1F - Condition exists" 30 "0x1E - Stuck Closed" 29 "0x1D - Stuck Open" 28 "0x1C - Not in neutral at Power-up" 27 "0x1B - Unable to return to neutral" 26 "0x1A - No steering" 25 "0x19 - Signal crosscheck failed" 24 "0x18 - Reserved" 23 "0x17 - Unintended Steering" 22 "0x16 - Message missing" 21 "0x15 - Data drifted low" 20 "0x14 - Data drifted high" 19 "0x13 - Received network data in error" 18 "0x12 - Data valid, but below normal operating range - Moderately severe level" 17 "0x11 - Data valid, but below normal operating range - Least severe level" 16 "0x10 - Data valid, but above normal operating range - Moderately severe level" 15 "0x0F - Data valid, but above normal operating range - Least severe level" 14 "0x0E - Special instructions" 13 "0x0D - Out of calibration" 12 "0x0C - Bad intelligent device or component" 11 "0x0B - Unknown root-cause" 10 "0x0A - Abnormal rate of change" 9 "0x09 - Abnormal update rate" 8 "0x08 - Abnormal frequency or pulse width or period" 7 "0x07 - Mechanical system not responding or out of adjustement" 6 "0x06 - Current above normal or grounded circuit" 5 "0x05 - Current below normal or open circuit" 4 "0x04 - Voltage below normal or short-circuit to low source" 3 "0x03 - Voltage above normal or short-circuit to high source" 2 "0x02 - Data erratic, intermittent or incorrect" 1 "0x01 - Data valid, but below normal operational range - Most severe level" 0 "0x00 - Data valid, but above normal operational range - Most severe level";
VAL_ 2360125960 Vehicle_speed_sensor 31 "0x1F - Condition exists" 30 "0x1E - Stuck Closed" 29 "0x1D - Stuck Open" 28 "0x1C - Not in neutral at Power-up" 27 "0x1B - Unable to return to neutral" 26 "0x1A - No steering" 25 "0x19 - Signal crosscheck failed" 24 "0x18 - Reserved" 23 "0x17 - Unintended Steering" 22 "0x16 - Message missing" 21 "0x15 - Data drifted low" 20 "0x14 - Data drifted high" 19 "0x13 - Received network data in error" 18 "0x12 - Data valid, but below normal operating range - Moderately severe level" 17 "0x11 - Data valid, but below normal operating range - Least severe level" 16 "0x10 - Data valid, but above normal operating range - Moderately severe level" 15 "0x0F - Data valid, but above normal operating range - Least severe level" 14 "0x0E - Special instructions" 13 "0x0D - Out of calibration" 12 "0x0C - Bad intelligent device or component" 11 "0x0B - Unknown root-cause" 10 "0x0A - Abnormal rate of change" 9 "0x09 - Abnormal update rate" 8 "0x08 - Abnormal frequency or pulse width or period" 7 "0x07 - Mechanical system not responding or out of adjustement" 6 "0x06 - Current above normal or grounded circuit" 5 "0x05 - Current below normal or open circuit" 4 "0x04 - Voltage below normal or short-circuit to low source" 3 "0x03 - Voltage above normal or short-circuit to high source" 2 "0x02 - Data erratic, intermittent or incorrect" 1 "0x01 - Data valid, but below normal operational range - Most severe level" 0 "0x00 - Data valid, but above normal operational range - Most severe level";
VAL_ 2360125960 Vehicle_speed_triggered_EH_Steer 31 "0x1F - Condition exists" 30 "0x1E - Stuck Closed" 29 "0x1D - Stuck Open" 28 "0x1C - Not in neutral at Power-up" 27 "0x1B - Unable to return to neutral" 26 "0x1A - No steering" 25 "0x19 - Signal crosscheck failed" 24 "0x18 - Reserved" 23 "0x17 - Unintended Steering" 22 "0x16 - Message missing" 21 "0x15 - Data drifted low" 20 "0x14 - Data drifted high" 19 "0x13 - Received network data in error" 18 "0x12 - Data valid, but below normal operating range - Moderately severe level" 17 "0x11 - Data valid, but below normal operating range - Least severe level" 16 "0x10 - Data valid, but above normal operating range - Moderately severe level" 15 "0x0F - Data valid, but above normal operating range - Least severe level" 14 "0x0E - Special instructions" 13 "0x0D - Out of calibration" 12 "0x0C - Bad intelligent device or component" 11 "0x0B - Unknown root-cause" 10 "0x0A - Abnormal rate of change" 9 "0x09 - Abnormal update rate" 8 "0x08 - Abnormal frequency or pulse width or period" 7 "0x07 - Mechanical system not responding or out of adjustement" 6 "0x06 - Current above normal or grounded circuit" 5 "0x05 - Current below normal or open circuit" 4 "0x04 - Voltage below normal or short-circuit to low source" 3 "0x03 - Voltage above normal or short-circuit to high source" 2 "0x02 - Data erratic, intermittent or incorrect" 1 "0x01 - Data valid, but below normal operational range - Most severe level" 0 "0x00 - Data valid, but above normal operational range - Most severe level";
VAL_ 2360125960 Vref_generation 31 "0x1F - Condition exists" 30 "0x1E - Stuck Closed" 29 "0x1D - Stuck Open" 28 "0x1C - Not in neutral at Power-up" 27 "0x1B - Unable to return to neutral" 26 "0x1A - No steering" 25 "0x19 - Signal crosscheck failed" 24 "0x18 - Reserved" 23 "0x17 - Unintended Steering" 22 "0x16 - Message missing" 21 "0x15 - Data drifted low" 20 "0x14 - Data drifted high" 19 "0x13 - Received network data in error" 18 "0x12 - Data valid, but below normal operating range - Moderately severe level" 17 "0x11 - Data valid, but below normal operating range - Least severe level" 16 "0x10 - Data valid, but above normal operating range - Moderately severe level" 15 "0x0F - Data valid, but above normal operating range - Least severe level" 14 "0x0E - Special instructions" 13 "0x0D - Out of calibration" 12 "0x0C - Bad intelligent device or component" 11 "0x0B - Unknown root-cause" 10 "0x0A - Abnormal rate of change" 9 "0x09 - Abnormal update rate" 8 "0x08 - Abnormal frequency or pulse width or period" 7 "0x07 - Mechanical system not responding or out of adjustement" 6 "0x06 - Current above normal or grounded circuit" 5 "0x05 - Current below normal or open circuit" 4 "0x04 - Voltage below normal or short-circuit to low source" 3 "0x03 - Voltage above normal or short-circuit to high source" 2 "0x02 - Data erratic, intermittent or incorrect" 1 "0x01 - Data valid, but below normal operational range - Most severe level" 0 "0x00 - Data valid, but above normal operational range - Most severe level";
VAL_ 2360125960 WAS_CAN_Sensor 31 "0x1F - Condition exists" 30 "0x1E - Stuck Closed" 29 "0x1D - Stuck Open" 28 "0x1C - Not in neutral at Power-up" 27 "0x1B - Unable to return to neutral" 26 "0x1A - No steering" 25 "0x19 - Signal crosscheck failed" 24 "0x18 - Reserved" 23 "0x17 - Unintended Steering" 22 "0x16 - Message missing" 21 "0x15 - Data drifted low" 20 "0x14 - Data drifted high" 19 "0x13 - Received network data in error" 18 "0x12 - Data valid, but below normal operating range - Moderately severe level" 17 "0x11 - Data valid, but below normal operating range - Least severe level" 16 "0x10 - Data valid, but above normal operating range - Moderately severe level" 15 "0x0F - Data valid, but above normal operating range - Least severe level" 14 "0x0E - Special instructions" 13 "0x0D - Out of calibration" 12 "0x0C - Bad intelligent device or component" 11 "0x0B - Unknown root-cause" 10 "0x0A - Abnormal rate of change" 9 "0x09 - Abnormal update rate" 8 "0x08 - Abnormal frequency or pulse width or period" 7 "0x07 - Mechanical system not responding or out of adjustement" 6 "0x06 - Current above normal or grounded circuit" 5 "0x05 - Current below normal or open circuit" 4 "0x04 - Voltage below normal or short-circuit to low source" 3 "0x03 - Voltage above normal or short-circuit to high source" 2 "0x02 - Data erratic, intermittent or incorrect" 1 "0x01 - Data valid, but below normal operational range - Most severe level" 0 "0x00 - Data valid, but above normal operational range - Most severe level";
VAL_ 2360125960 Wheel_angle_crosscheck 31 "0x1F - Condition exists" 30 "0x1E - Stuck Closed" 29 "0x1D - Stuck Open" 28 "0x1C - Not in neutral at Power-up" 27 "0x1B - Unable to return to neutral" 26 "0x1A - No steering" 25 "0x19 - Signal crosscheck failed" 24 "0x18 - Reserved" 23 "0x17 - Unintended Steering" 22 "0x16 - Message missing" 21 "0x15 - Data drifted low" 20 "0x14 - Data drifted high" 19 "0x13 - Received network data in error" 18 "0x12 - Data valid, but below normal operating range - Moderately severe level" 17 "0x11 - Data valid, but below normal operating range - Least severe level" 16 "0x10 - Data valid, but above normal operating range - Moderately severe level" 15 "0x0F - Data valid, but above normal operating range - Least severe level" 14 "0x0E - Special instructions" 13 "0x0D - Out of calibration" 12 "0x0C - Bad intelligent device or component" 11 "0x0B - Unknown root-cause" 10 "0x0A - Abnormal rate of change" 9 "0x09 - Abnormal update rate" 8 "0x08 - Abnormal frequency or pulse width or period" 7 "0x07 - Mechanical system not responding or out of adjustement" 6 "0x06 - Current above normal or grounded circuit" 5 "0x05 - Current below normal or open circuit" 4 "0x04 - Voltage below normal or short-circuit to low source" 3 "0x03 - Voltage above normal or short-circuit to high source" 2 "0x02 - Data erratic, intermittent or incorrect" 1 "0x01 - Data valid, but below normal operational range - Most severe level" 0 "0x00 - Data valid, but above normal operational range - Most severe level";
